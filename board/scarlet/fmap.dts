/dts-v1/;

/ {
	model = "Google Scarlet";
	config {
		hwid = "SCARLET TEST 7598";
	};
	chromeos-config {
		/* Enable factory-friendly features. */
		gbb-flag-dev-screen-short-delay;
		gbb-flag-force-dev-switch-on;
		gbb-flag-force-dev-boot-usb;
		gbb-flag-disable-fw-rollback-check;
	};
};
