## board/oak/defconfig
```kconfig
# Arch
CONFIG_ARCH_ARM=y
CONFIG_ARCH_ARM_V8=y

# Board
CONFIG_BOARD_DIR="oak"
CONFIG_BOARD_ID_ADJUSTMENT=0

# Image
CONFIG_BASE_ADDRESS=0x80000000
CONFIG_HEAP_SIZE=0x00800000
CONFIG_KERNEL_START=0x60000000

# Vboot
CONFIG_EC_SOFTWARE_SYNC=y
CONFIG_EC_SLOW_UPDATE=y
CONFIG_CROSSYSTEM_FDT=y
CONFIG_NVDATA_FLASH=y

# Kernel format
CONFIG_KERNEL_FIT=y
CONFIG_KERNEL_FIT_FDT_ADDR=0x5f800000

# Drivers
CONFIG_DRIVER_BUS_I2C_MT8173=y
CONFIG_DRIVER_BUS_I2C_CROS_EC_TUNNEL=y
CONFIG_DRIVER_BUS_I2S_MTK=y
CONFIG_DRIVER_BUS_SPI_MTK=y
CONFIG_DRIVER_EC_ANX7688=y
CONFIG_DRIVER_EC_CROS=y
CONFIG_DRIVER_EC_CROS_SPI=y
CONFIG_DRIVER_GPIO_MT8173=y
CONFIG_DRIVER_INPUT_MKBP=y
CONFIG_DRIVER_INPUT_MKBP_KEYMATRIX_STANDARD=y
CONFIG_DRIVER_INPUT_MKBP_OLD_COMMAND=y
CONFIG_DRIVER_SOUND_I2S=y
CONFIG_DRIVER_SOUND_RT5645=y
CONFIG_DRIVER_SOUND_RT5677=y
CONFIG_DRIVER_SOUND_ROUTE=y
CONFIG_DRIVER_STORAGE_MMC=y
CONFIG_DRIVER_STORAGE_MMC_MTK=y
CONFIG_DRIVER_FLASH_NOR_MT8173=y
CONFIG_DRIVER_TPM_SLB9635_I2C=y

# VIDEO
CONFIG_DRIVER_VIDEO_MTK=y
```

## board/obiwan/defconfig
```kconfig
# Arch
CONFIG_ARCH_ARM=y
CONFIG_ARCH_ARM_V8=y

# Board
CONFIG_BOARD_DIR="skywalker"
CONFIG_VARIANT_NAME="obiwan"

# Image
CONFIG_BASE_ADDRESS=0xF1000000
CONFIG_KERNEL_START=0xD0000000

# Vboot
CONFIG_EC_VBOOT_SUPPORT=y
CONFIG_EC_SLOW_UPDATE=y
CONFIG_AUXFW_SOFTWARE_SYNC=y
CONFIG_CROS_EC_PROBE_AUX_FW_INFO=y
CONFIG_CROSSYSTEM_FDT=y
CONFIG_NVDATA_FLASH=y

# Kernel format
CONFIG_KERNEL_FIT=y
CONFIG_KERNEL_FIT_FDT_ADDR=0xF0000000

# Drivers
CONFIG_DRIVER_BUS_I2C_CROS_EC_TUNNEL=y
CONFIG_DRIVER_BUS_I2C_MT8189=y
CONFIG_DRIVER_BUS_I2S_MT8189=y
CONFIG_DRIVER_SOUND_I2S=y
CONFIG_DRIVER_SOUND_ROUTE=y
CONFIG_DRIVER_SOUND_RT1015P=y
CONFIG_DRIVER_SOUND_RT5645=y
CONFIG_DRIVER_BUS_SPI_MTK=y
CONFIG_DRIVER_EC_CROS=y
CONFIG_DRIVER_EC_CROS_SPI=y
CONFIG_DRIVER_EC_RTS5453=y
CONFIG_DRIVER_EC_RTS545X_VID=0x18d1
CONFIG_DRIVER_EC_RTS545X_PID=0x5072
CONFIG_DRIVER_FLASH_MTK_SNFC=y
CONFIG_DRIVER_FLASH_SPI=y
CONFIG_DRIVER_GPIO_MT8189=y
CONFIG_DRIVER_INPUT_MKBP=y
CONFIG_DRIVER_INPUT_MKBP_KEYMATRIX_STANDARD_V30=y
CONFIG_DRIVER_STORAGE_MMC=y
CONFIG_DRIVER_STORAGE_MMC_MTK=y
CONFIG_DRIVER_STORAGE_UFS=y
CONFIG_DRIVER_STORAGE_UFS_MTK=y
CONFIG_DRIVER_TPM_GOOGLE_TI50=y
CONFIG_DRIVER_TPM_I2C=y
```

## board/orisa/defconfig
```kconfig
# Arch
CONFIG_ARCH_X86=y

# Board
CONFIG_BOARD_DIR="brya"
CONFIG_VARIANT_NAME="orisa"

# Image
CONFIG_HEAP_SIZE=0x02600000

# Vboot
CONFIG_CROSSYSTEM_ACPI=y
CONFIG_AUXFW_SOFTWARE_SYNC=y
CONFIG_EC_VBOOT_SUPPORT=y
CONFIG_EC_SLOW_UPDATE=y

# Kernel format
CONFIG_KERNEL_MULTIBOOT=y
CONFIG_KERNEL_MULTIBOOT_ZBI=y
CONFIG_KERNEL_ZIMAGE=y

# Drivers
CONFIG_DRIVER_BUS_I2C_CROS_EC_TUNNEL=y
CONFIG_DRIVER_BUS_I2C_DESIGNWARE=y
CONFIG_DRIVER_BUS_I2C_DESIGNWARE_PCI=y
CONFIG_DRIVER_EC_CROS=y
CONFIG_DRIVER_EC_CROS_LPC=y
CONFIG_DRIVER_EC_CROS_DELAY_AFTER_EC_REBOOT_MS=150
CONFIG_DRIVER_EC_RTS5453=y
CONFIG_DRIVER_FLASH_MEMMAPPED=y
CONFIG_DRIVER_GPIO_ALDERLAKE=y
CONFIG_DRIVER_INPUT_MKBP=y
CONFIG_DRIVER_INPUT_MKBP_KEYMATRIX_STANDARD_V10=y
CONFIG_DRIVER_INPUT_PS2=y
CONFIG_DRIVER_POWER_PCH=y
CONFIG_DRIVER_SOC_ALDERLAKE=y
CONFIG_DRIVER_SOC_ALDERLAKE_N=y
CONFIG_DRIVER_TPM_GOOGLE_TI50=y
CONFIG_DRIVER_TPM_I2C=y

# Audio
CONFIG_DRIVER_SOUND_HDA=y
CONFIG_DRIVER_BUS_I2S_INTEL_COMMON_I2S=y
CONFIG_DRIVER_BUS_I2S_INTEL_COMMON_MAX98357A=y
CONFIG_DRIVER_INTEL_GENERIC_AUDIO=y
CONFIG_DRIVER_SOUND_GPIO_AMP=y
CONFIG_DRIVER_SOUND_I2S=y
CONFIG_DRIVER_SOUND_ROUTE=y
CONFIG_DRIVER_SOUND_RT5645=y

# Storage
CONFIG_DRIVER_STORAGE_SDHCI_PCI=y
CONFIG_DRIVER_SDHCI=y
CONFIG_DRIVER_STORAGE_MMC=y
CONFIG_DRIVER_STORAGE_MMC_RTK=y
CONFIG_DRIVER_SOC_INTEL_PCH_EMMC=y
CONFIG_DRIVER_STORAGE_UFS_INTEL=y
CONFIG_DRIVER_STORAGE_NVME=y
CONFIG_DRIVER_STORAGE_COMMON=y

# Aux FW
CONFIG_CROS_EC_PROBE_AUX_FW_INFO=y

# USB Type-C
CONFIG_INTEL_TCSS_USE_PDC_PMC_MUX_CONFIG=y
```

## board/ovis/defconfig
```kconfig
# Arch
CONFIG_ARCH_X86=y

# Board
CONFIG_BOARD_DIR="rex"
CONFIG_VARIANT_NAME="ovis"

# Image
CONFIG_HEAP_SIZE=0x04000000

# Vboot
CONFIG_CROSSYSTEM_ACPI=y
CONFIG_AUXFW_SOFTWARE_SYNC=y
CONFIG_EC_VBOOT_SUPPORT=y
CONFIG_EC_SLOW_UPDATE=y

# Kernel format
CONFIG_KERNEL_MULTIBOOT=y
CONFIG_KERNEL_MULTIBOOT_ZBI=y
CONFIG_KERNEL_ZIMAGE=y

# Drivers
CONFIG_DRIVER_AHCI=y
CONFIG_DRIVER_BUS_I2C_CROS_EC_TUNNEL=y
CONFIG_DRIVER_BUS_I2C_DESIGNWARE=y
CONFIG_DRIVER_BUS_I2C_DESIGNWARE_PCI=y
CONFIG_DRIVER_EC_CROS=y
CONFIG_DRIVER_EC_CROS_LPC=y
CONFIG_DRIVER_FLASH_MEMMAPPED=y
CONFIG_DRIVER_GPIO_METEORLAKE=y
CONFIG_DRIVER_INPUT_MKBP=y
CONFIG_DRIVER_INPUT_MKBP_KEYMATRIX_STANDARD=y
CONFIG_DRIVER_INPUT_PS2=y
CONFIG_DRIVER_INTEL_GENERIC_AUDIO=y
CONFIG_DRIVER_POWER_PCH=y
CONFIG_DRIVER_SOC_METEORLAKE=y
CONFIG_DRIVER_TPM_GOOGLE_TI50=y
CONFIG_DRIVER_TPM_I2C=y

# Storage
CONFIG_DRIVER_STORAGE_SDHCI_PCI=y
CONFIG_DRIVER_SDHCI=y
CONFIG_DRIVER_STORAGE_MMC=y
CONFIG_DRIVER_STORAGE_NVME=y
CONFIG_DRIVER_STORAGE_COMMON=y

# Audio
CONFIG_DRIVER_BUS_I2S_INTEL_COMMON_I2S=y
CONFIG_DRIVER_SOUND_I2S=y
CONFIG_DRIVER_SOUND_ROUTE=y

# USB Type-C
CONFIG_DRIVER_USB_INTEL_TCSS=y
CONFIG_DRIVER_SOC_INTEL_PMC=y
```
