## board/glkrvp/defconfig
```kconfig
# Arch
CONFIG_ARCH_X86=y

# Board
CONFIG_BOARD_DIR="glkrvp"

# Image

# Vboot
CONFIG_EC_SOFTWARE_SYNC=y

CONFIG_CROSSYSTEM_ACPI=y
CONFIG_NV_STORAGE_CMOS=y

# Kernel format
CONFIG_KERNEL_ZIMAGE=y

# Drivers
CONFIG_DRIVER_EC_CROS=y
CONFIG_DRIVER_EC_CROS_LPC=y
CONFIG_DRIVER_FLASH_MEMMAPPED=y
CONFIG_DRIVER_INPUT_PS2=y
CONFIG_DRIVER_INPUT_USB=y
CONFIG_DRIVER_POWER_PCH=y
CONFIG_DRIVER_SDHCI=y
CONFIG_DRIVER_STORAGE_MMC=y
CONFIG_DRIVER_STORAGE_SDHCI_PCI=y
CONFIG_DRIVER_TPM_LPC=y
CONFIG_DRIVER_AHCI=y
CONFIG_DRIVER_SOC_GLK=y

#Audio
CONFIG_DRIVER_BUS_I2S_INTEL_COMMON_I2S=y
CONFIG_DRIVER_BUS_I2S_INTEL_COMMON_MAX98357A=y
CONFIG_DRIVER_SOUND_I2S=y
CONFIG_DRIVER_SOUND_MAX98357A=y
CONFIG_DRIVER_SOUND_ROUTE=y
```

## board/grunt/defconfig
```kconfig
# Arch
CONFIG_ARCH_X86=y

# Board
CONFIG_BOARD_DIR="grunt"

# Image

# Vboot
CONFIG_AUXFW_SOFTWARE_SYNC=y
CONFIG_EC_SOFTWARE_SYNC=y
CONFIG_EC_SLOW_UPDATE=y
CONFIG_TPM2_MODE=y
CONFIG_TPM_DEBUG_EXTENSIONS=y
CONFIG_NVDATA_CMOS=y
CONFIG_CROSSYSTEM_ACPI=y

# Kernel format
CONFIG_KERNEL_MULTIBOOT=y
CONFIG_KERNEL_MULTIBOOT_BOOTDATA=y
CONFIG_KERNEL_ZIMAGE=y

# Drivers
CONFIG_DRIVER_BUS_I2C_CROS_EC_TUNNEL=y
CONFIG_DRIVER_BUS_I2C_DESIGNWARE=y
CONFIG_DRIVER_EC_ANX3429=y
CONFIG_DRIVER_EC_CROS=y
CONFIG_DRIVER_EC_CROS_LPC=y
CONFIG_DRIVER_EC_PS8751=y
CONFIG_DRIVER_FLASH_MEMMAPPED=y
CONFIG_DRIVER_SOC_STONEYRIDGE=y
CONFIG_DRIVER_INPUT_PS2=y
CONFIG_DRIVER_INPUT_USB=y
CONFIG_DRIVER_POWER_FCH=y
CONFIG_DRIVER_SDHCI=y
CONFIG_DRIVER_SOUND_GPIO_I2S=y
CONFIG_DRIVER_SOUND_MAX98357A=y
CONFIG_DRIVER_SOUND_ROUTE=y
CONFIG_DRIVER_STORAGE_MMC=y
CONFIG_DRIVER_STORAGE_SDHCI_PCI=y
CONFIG_DRIVER_STORAGE_BAYHUB=y
CONFIG_DRIVER_TPM_CR50_I2C=y
```

## board/guybrush/defconfig
```kconfig
# Arch
CONFIG_ARCH_X86=y

# Board
CONFIG_BOARD_DIR="guybrush"

# Vboot
CONFIG_MOCK_TPM=y

# Drivers
CONFIG_DRIVER_FLASH_MEMMAPPED=y
```

## board/halvor/defconfig
```kconfig
# Arch
CONFIG_ARCH_X86=y

# Board
CONFIG_BOARD_DIR="volteer"

# Image
CONFIG_HEAP_SIZE=0x02600000

# Vboot
CONFIG_TPM2_MODE=y
CONFIG_CROSSYSTEM_ACPI=y
CONFIG_TPM_DEBUG_EXTENSIONS=y
CONFIG_EC_VBOOT_SUPPORT=y
CONFIG_AUXFW_SOFTWARE_SYNC=y

# Kernel format
CONFIG_KERNEL_MULTIBOOT=y
CONFIG_KERNEL_MULTIBOOT_ZBI=y
CONFIG_KERNEL_ZIMAGE=y

# Drivers
CONFIG_DRIVER_BUS_I2C_CROS_EC_TUNNEL=y
CONFIG_DRIVER_AHCI=y
CONFIG_DRIVER_BUS_I2C_DESIGNWARE=y
CONFIG_DRIVER_BUS_I2C_DESIGNWARE_PCI=y
CONFIG_DRIVER_BUS_SPI_INTEL_GSPI_VERSION_2=y
CONFIG_DRIVER_EC_CROS=y
CONFIG_DRIVER_EC_CROS_LPC=y
CONFIG_DRIVER_FLASH_MEMMAPPED=y
CONFIG_DRIVER_GPIO_TIGERLAKE=y
CONFIG_DRIVER_INPUT_PS2=y
CONFIG_DRIVER_POWER_PCH=y
CONFIG_DRIVER_SOC_TIGERLAKE=y
CONFIG_DRIVER_TPM_SPI=y
CONFIG_DRIVER_STORAGE_NVME=y

# Audio
CONFIG_VOLTEER_MAX98373_I2S_PORT=2
CONFIG_MAX98373_I2S_BOOTBEEP=y

# Auxfw
CONFIG_CROS_EC_PROBE_AUX_FW_INFO=y
```

## board/hatch/defconfig
```kconfig
# Arch
CONFIG_ARCH_X86=y

# Board
CONFIG_BOARD_DIR="hatch"

# Image
CONFIG_HEAP_SIZE=0x00600000

# Vboot
CONFIG_TPM2_MODE=y
CONFIG_EC_SOFTWARE_SYNC=y
CONFIG_AUXFW_SOFTWARE_SYNC=y
CONFIG_CROSSYSTEM_ACPI=y
CONFIG_NV_STORAGE_CMOS=y
CONFIG_TPM_DEBUG_EXTENSIONS=y

# Kernel format
CONFIG_KERNEL_MULTIBOOT=y
CONFIG_KERNEL_MULTIBOOT_BOOTDATA=y
CONFIG_KERNEL_ZIMAGE=y

# Drivers
CONFIG_DRIVER_AHCI=y
CONFIG_DRIVER_BUS_I2C_CROS_EC_TUNNEL=y
CONFIG_DRIVER_BUS_SPI_INTEL_GSPI_VERSION_2=y
CONFIG_DRIVER_EC_CROS=y
CONFIG_DRIVER_EC_CROS_LPC=y
CONFIG_DRIVER_EC_PS8751=y
CONFIG_DRIVER_FLASH_MEMMAPPED=y
CONFIG_DRIVER_INPUT_PS2=y
CONFIG_DRIVER_INPUT_USB=y
CONFIG_DRIVER_POWER_PCH=y
CONFIG_DRIVER_SDHCI=y
CONFIG_DRIVER_SOC_CANNONLAKE=y
CONFIG_DRIVER_STORAGE_MMC=y
CONFIG_DRIVER_STORAGE_NVME=y
CONFIG_DRIVER_STORAGE_SDHCI_PCI=y
CONFIG_DRIVER_TPM_SPI=y
CONFIG_DRIVER_GPIO_CANNONLAKE=y

#Audio
CONFIG_DRIVER_BUS_I2C_DESIGNWARE=y
CONFIG_DRIVER_BUS_I2C_DESIGNWARE_PCI=y
CONFIG_DRIVER_BUS_I2S_INTEL_COMMON_I2S=y
CONFIG_DRIVER_BUS_I2S_INTEL_COMMON_MAX98357A=y
CONFIG_DRIVER_SOUND_I2S=y
CONFIG_DRIVER_SOUND_MAX98357A=y
CONFIG_DRIVER_SOUND_ROUTE=y
CONFIG_DRIVER_SOUND_RT1011=y

# Aux FW
CONFIG_CROS_EC_PROBE_AUX_FW_INFO=y
```

## board/herobrine/defconfig
```kconfig
# Arch
CONFIG_ARCH_ARM=y
CONFIG_ARCH_ARM_V8=y

# Board
CONFIG_BOARD_DIR="herobrine"

# Image
CONFIG_BASE_ADDRESS=0xF1000000
CONFIG_HEAP_SIZE=0x01000000
CONFIG_KERNEL_START=0xD0000000

# Vboot
#CONFIG_MOCK_TPM is not set
CONFIG_CROSSYSTEM_FDT=y
CONFIG_NVDATA_FLASH=y
CONFIG_AUXFW_SOFTWARE_SYNC=y
CONFIG_EC_VBOOT_SUPPORT=y

# Kernel format
CONFIG_KERNEL_FIT=y
CONFIG_KERNEL_FIT_FDT_ADDR=0xF0000000

# Drivers
CONFIG_DRIVER_FLASH_SPI=y
CONFIG_DRIVER_BUS_I2C_SC7280=y
CONFIG_DRIVER_SOC_QCOM_QUP_SE=y
CONFIG_DRIVER_TPM_GOOGLE_CR50=y
CONFIG_DRIVER_TPM_I2C=y
CONFIG_DRIVER_EC_CROS=y
CONFIG_DRIVER_EC_CROS_SPI=y
CONFIG_DRIVER_EC_PS8751=y
CONFIG_DRIVER_EC_PS8751_FLASH_WINDOW=y
CONFIG_DRIVER_GPIO_SC7280=y
CONFIG_DRIVER_SOC_QCOM_SPMI=y

#eMMC/SD-card
CONFIG_DRIVER_STORAGE_MMC=y
CONFIG_DRIVER_SDHCI=y
CONFIG_DRIVER_STORAGE_SDHCI_MSM=y
CONFIG_DRIVER_STORAGE_SET_DLL_USER_CTL=y

# VIDEO
```

## board/iclrvp/defconfig
```kconfig
# Arch
CONFIG_ARCH_X86=y

# Board
CONFIG_BOARD_DIR="iclrvp"

# Vboot
CONFIG_EC_SOFTWARE_SYNC=n
CONFIG_MOCK_TPM=y

CONFIG_CROSSYSTEM_ACPI=y
CONFIG_NVDATA_CMOS=y

# Kernel format
CONFIG_KERNEL_ZIMAGE=y

# Drivers
CONFIG_DRIVER_SOC_ICELAKE=y
CONFIG_DRIVER_BUS_I2C_CROS_EC_TUNNEL=y
CONFIG_DRIVER_BUS_I2C_DESIGNWARE=y
CONFIG_DRIVER_BUS_I2C_DESIGNWARE_PCI=y
CONFIG_DRIVER_FLASH_MEMMAPPED=y
CONFIG_DRIVER_INPUT_PS2=y
CONFIG_DRIVER_INPUT_USB=y
CONFIG_DRIVER_POWER_PCH=y
CONFIG_DRIVER_SDHCI=y
CONFIG_DRIVER_STORAGE_MMC=y
CONFIG_DRIVER_STORAGE_NVME=y
CONFIG_DRIVER_STORAGE_SDHCI_PCI=y
CONFIG_DRIVER_AHCI=y
```

## board/jecht/defconfig
```kconfig
# Arch
CONFIG_ARCH_X86=y

# Board
CONFIG_BOARD="jecht"

# Image

# Vboot
CONFIG_OPROM_MATTERS=y
CONFIG_PHYSICAL_REC_SWITCH=y

CONFIG_CROSSYSTEM_ACPI=y
CONFIG_NV_STORAGE_CMOS=y

# Kernel format
CONFIG_KERNEL_ZIMAGE=y

# Drivers
CONFIG_DRIVER_AHCI=y
CONFIG_DRIVER_FLASH_MEMMAPPED=y
CONFIG_DRIVER_GPIO_LYNXPOINT_LP=y
CONFIG_DRIVER_INPUT_PS2=y
CONFIG_DRIVER_INPUT_USB=y
CONFIG_DRIVER_POWER_PCH=y
CONFIG_DRIVER_SOUND_PCAT_BEEP=y
CONFIG_DRIVER_TPM_LPC=y
```

## board/kahlee/defconfig
```kconfig
# Arch
CONFIG_ARCH_X86=y

# Board
CONFIG_BOARD="kahlee"

# Image
CONFIG_FMAP_OFFSET=0x57F000

# Vboot
CONFIG_EC_SOFTWARE_SYNC=y
CONFIG_VIRTUAL_DEV_SWITCH=y
CONFIG_NV_STORAGE_CMOS=y
CONFIG_CROSSYSTEM_ACPI=y

# Kernel format
CONFIG_KERNEL_ZIMAGE=y

# Drivers
CONFIG_DRIVER_EC_CROS=y
CONFIG_DRIVER_EC_CROS_LPC=y
CONFIG_DRIVER_FLASH_MEMMAPPED=y
CONFIG_DRIVER_GPIO_KERN=y
CONFIG_DRIVER_INPUT_PS2=y
CONFIG_DRIVER_INPUT_USB=y
CONFIG_DRIVER_POWER_FCH=y
CONFIG_DRIVER_AHCI=y
CONFIG_DRIVER_TPM_LPC=y
CONFIG_DRIVER_SOC_STONEYRIDGE=y
CONFIG_DRIVER_SOUND_HDA=y
CONFIG_DRIVER_SDHCI=y
CONFIG_DRIVER_STORAGE_MMC=y
CONFIG_DRIVER_STORAGE_SDHCI_PCI=y
```

## board/kalista/defconfig
```kconfig
# Arch
CONFIG_ARCH_X86=y

# Board
CONFIG_BOARD="kalista"
CONFIG_BOARD_DIR="fizz"

# Image
CONFIG_HEAP_SIZE=0x00600000

# Vboot
CONFIG_EC_SOFTWARE_SYNC=y
CONFIG_VIRTUAL_DEV_SWITCH=y
CONFIG_CROSSYSTEM_ACPI=y
CONFIG_NV_STORAGE_CMOS=y
CONFIG_TPM2_MODE=y
CONFIG_TPM_DEBUG_EXTENSIONS=y

# Kernel format
CONFIG_KERNEL_ZIMAGE=y
CONFIG_KERNEL_MULTIBOOT=y
CONFIG_KERNEL_MULTIBOOT_BOOTDATA=y

# Drivers
CONFIG_DRIVER_AHCI=y
CONFIG_DRIVER_BUS_I2C_DESIGNWARE=y
CONFIG_DRIVER_BUS_I2C_DESIGNWARE_PCI=y
CONFIG_DRIVER_EC_CROS=y
CONFIG_DRIVER_EC_CROS_LPC=y
CONFIG_DRIVER_FLASH_MEMMAPPED=y
CONFIG_DRIVER_INPUT_MKBP=y
CONFIG_DRIVER_INPUT_MKBP_KEYMATRIX_STANDARD=y
CONFIG_DRIVER_INPUT_USB=y
CONFIG_DRIVER_BUS_SPI_INTEL_GSPI=y
CONFIG_DRIVER_POWER_PCH=y
CONFIG_DRIVER_SDHCI=y
CONFIG_DRIVER_SOC_SKYLAKE=y
CONFIG_DRIVER_STORAGE_MMC=y
CONFIG_DRIVER_STORAGE_SDHCI_PCI=y
CONFIG_DRIVER_STORAGE_NVME=y
#CONFIG_DRIVER_TPM_CR50_I2C=y
CONFIG_DRIVER_TPM_SPI=y
CONFIG_DRIVER_TPM_CR50_REC=y

# Boot beep
CONFIG_DRIVER_SOUND_GPIO_I2S=y
CONFIG_DRIVER_SOUND_MAX98357A=y
CONFIG_DRIVER_SOUND_ROUTE=y
```

## board/kblrvp/defconfig
```kconfig
# Arch
CONFIG_ARCH_X86=y

# Board
CONFIG_BOARD="kblrvp"

# Image
CONFIG_FMAP_OFFSET=0xc10000
# Vboot
CONFIG_EC_SOFTWARE_SYNC=n
CONFIG_VIRTUAL_DEV_SWITCH=y

CONFIG_CROSSYSTEM_ACPI=y
CONFIG_NV_STORAGE_CMOS=y

# Kernel format
CONFIG_KERNEL_ZIMAGE=y

# Drivers
CONFIG_DRIVER_AHCI=y
CONFIG_DRIVER_BUS_I2C_DESIGNWARE=y
CONFIG_DRIVER_BUS_I2C_DESIGNWARE_PCI=y
CONFIG_DRIVER_FLASH_MEMMAPPED=y
CONFIG_DRIVER_INPUT_PS2=y
CONFIG_DRIVER_INPUT_USB=y
CONFIG_DRIVER_POWER_PCH=y
CONFIG_DRIVER_SDHCI=y
CONFIG_DRIVER_STORAGE_MMC=y
CONFIG_DRIVER_STORAGE_NVME=y
CONFIG_DRIVER_STORAGE_SDHCI_PCI=y
CONFIG_DRIVER_TPM_LPC=y
```

## board/kevin/defconfig
```kconfig
# Arch
CONFIG_ARCH_ARM=y
CONFIG_ARCH_ARM_V8=y

# Board
CONFIG_BOARD="kevin"

# Image
CONFIG_BASE_ADDRESS=0x18000000
CONFIG_FMAP_OFFSET=0x00300000
CONFIG_HEAP_SIZE=0x01000000
CONFIG_KERNEL_START=0x15000000

# Vboot
CONFIG_VIRTUAL_DEV_SWITCH=y

CONFIG_CROSSYSTEM_FDT=y
#CONFIG_NV_STORAGE_CROS_EC=y
CONFIG_NV_STORAGE_FAKE=y
CONFIG_MOCK_TPM=y

# Kernel format
CONFIG_KERNEL_FIT=y
CONFIG_KERNEL_FIT_FDT_ADDR=0x6400000

# Drivers
#CONFIG_DRIVER_EC_CROS=y
#CONFIG_DRIVER_EC_CROS_SPI=y

CONFIG_DRIVER_STORAGE_MMC=y
CONFIG_DRIVER_STORAGE_MMC_ROCKCHIP=y
CONFIG_DRIVER_SDHCI=y
CONFIG_DRIVER_FLASH_SPI=y
CONFIG_DRIVER_BUS_SPI_ROCKCHIP=y
CONFIG_DRIVER_GPIO_ROCKCHIP=y
#CONFIG_DRIVER_INPUT_MKBP=y
#CONFIG_DRIVER_INPUT_MKBP_KEYMATRIX_STANDARD=y
CONFIG_DRIVER_INPUT_USB=y
#CONFIG_DRIVER_TPM_SLB9635_I2C=y
```

## board/kuldax/defconfig
```kconfig
# Arch
CONFIG_ARCH_X86=y

# Board
CONFIG_BOARD_DIR="brya"
CONFIG_VARIANT_NAME="kuldax"

# Image
CONFIG_HEAP_SIZE=0x02600000

# Vboot
CONFIG_CROSSYSTEM_ACPI=y
CONFIG_AUXFW_SOFTWARE_SYNC=y
CONFIG_EC_VBOOT_SUPPORT=y

# Kernel format
CONFIG_KERNEL_MULTIBOOT=y
CONFIG_KERNEL_MULTIBOOT_ZBI=y
CONFIG_KERNEL_ZIMAGE=y

# Drivers
CONFIG_DRIVER_AHCI=y
CONFIG_DRIVER_BUS_I2C_CROS_EC_TUNNEL=y
CONFIG_DRIVER_BUS_I2C_DESIGNWARE=y
CONFIG_DRIVER_BUS_I2C_DESIGNWARE_PCI=y
CONFIG_DRIVER_EC_CROS=y
CONFIG_DRIVER_EC_CROS_LPC=y
CONFIG_DRIVER_FLASH_MEMMAPPED=y
CONFIG_DRIVER_GPIO_ALDERLAKE=y
CONFIG_DRIVER_INPUT_MKBP=y
CONFIG_DRIVER_INPUT_MKBP_KEYMATRIX_STANDARD=y
CONFIG_DRIVER_POWER_PCH=y
CONFIG_DRIVER_SOC_ALDERLAKE=y
CONFIG_DRIVER_STORAGE_NVME=y
CONFIG_DRIVER_TPM_GOOGLE_CR50=y
CONFIG_DRIVER_TPM_I2C=y
CONFIG_TPM_GOOGLE_SWITCHES=y

# Audio
CONFIG_DRIVER_BUS_I2S_INTEL_COMMON_I2S=y
CONFIG_DRIVER_SOUND_I2S=y
CONFIG_DRIVER_SOUND_ROUTE=y
CONFIG_DRIVER_SOUND_GPIO_EDGE_BUZZER=y

# USB Type-C
CONFIG_DRIVER_USB_INTEL_TCSS=y
CONFIG_DRIVER_SOC_INTEL_PMC=y
```

## board/kunimitsu/defconfig
```kconfig
# Arch
CONFIG_ARCH_X86=y

# Board
CONFIG_BOARD="kunimitsu"

# Image
CONFIG_FMAP_OFFSET=0xd10000

# Vboot
CONFIG_EC_SOFTWARE_SYNC=y
CONFIG_OPROM_MATTERS=y
CONFIG_VIRTUAL_DEV_SWITCH=y

CONFIG_CROSSYSTEM_ACPI=n
CONFIG_NV_STORAGE_CMOS=y

# Kernel format
CONFIG_KERNEL_ZIMAGE=y

# Drivers
CONFIG_DRIVER_AHCI=y
CONFIG_DRIVER_EC_CROS=y
CONFIG_DRIVER_EC_CROS_LPC=y
CONFIG_DRIVER_EC_CROS_PASSTHRU=y
CONFIG_DRIVER_FLASH_MEMMAPPED=y
CONFIG_DRIVER_GPIO_LYNXPOINT_LP=y
CONFIG_DRIVER_INPUT_PS2=y
CONFIG_DRIVER_INPUT_USB=y
CONFIG_DRIVER_POWER_PCH=y
CONFIG_MOCK_TPM=y
CONFIG_DRIVER_SDHCI=y
CONFIG_DRIVER_STORAGE_SDHCI_PCI=y
CONFIG_DRIVER_STORAGE_MMC=y
```

## board/link/defconfig
```kconfig
# Arch
CONFIG_ARCH_X86=y

# Board
CONFIG_BOARD="link"

# Image
CONFIG_FMAP_OFFSET=0x610000

# Vboot
CONFIG_EC_SOFTWARE_SYNC=y
CONFIG_OPROM_MATTERS=y
CONFIG_RO_NORMAL_SUPPORT=y
CONFIG_VIRTUAL_DEV_SWITCH=y

CONFIG_CROSSYSTEM_ACPI=y
CONFIG_NV_STORAGE_CMOS=y

# Kernel format
CONFIG_KERNEL_ZIMAGE=y

# Drivers
CONFIG_DRIVER_AHCI=y
CONFIG_DRIVER_EC_CROS=y
CONFIG_DRIVER_EC_CROS_LPC=y
CONFIG_DRIVER_FLASH_MEMMAPPED=y
CONFIG_DRIVER_GPIO_PANTHERPOINT=y
CONFIG_DRIVER_INPUT_PS2=y
CONFIG_DRIVER_INPUT_USB=y
CONFIG_DRIVER_NET_ASIX=y
CONFIG_DRIVER_POWER_PCH=y
CONFIG_DRIVER_SOUND_HDA=y
CONFIG_DRIVER_TPM_LPC=y
```

## board/lumpy/defconfig
```kconfig
# Arch
CONFIG_ARCH_X86=y

# Image
CONFIG_FMAP_OFFSET=0x610000

# Vboot
CONFIG_OPROM_MATTERS=y
CONFIG_RO_NORMAL_SUPPORT=y

CONFIG_NV_STORAGE_CMOS=y

# Kernel format
CONFIG_KERNEL_ZIMAGE=y

# Drivers
CONFIG_DRIVER_AHCI=y
CONFIG_DRIVER_CODEC_HDA=y
CONFIG_DRIVER_FLASH_MEMMAPPED=y
CONFIG_DRIVER_FLASH_MEMMAPPED_BASE=0xff800000
CONFIG_DRIVER_FLASH_MEMMAPPED_SIZE=0x800000
CONFIG_DRIVER_GPIO_PCH=y
CONFIG_DRIVER_INPUT_PS2=y
CONFIG_DRIVER_INPUT_USB=y
CONFIG_DRIVER_POWER_PCH=y
CONFIG_DRIVER_TPM_LPC=y
```

## board/majolica/defconfig
```kconfig
# Arch
CONFIG_ARCH_X86=y

# Board
CONFIG_BOARD_DIR="majolica"

# Image
CONFIG_HEAP_SIZE=0x01000000

# Vboot
CONFIG_EC_VBOOT_SUPPORT=n
CONFIG_AUXFW_SOFTWARE_SYNC=n
CONFIG_MOCK_TPM=y
CONFIG_NVDATA_CMOS=y
CONFIG_CROSSYSTEM_ACPI=y

# Kernel format
CONFIG_KERNEL_MULTIBOOT=y
CONFIG_KERNEL_MULTIBOOT_BOOTDATA=y
CONFIG_KERNEL_ZIMAGE=y

# Drivers
CONFIG_DRIVER_BUS_I2C_DESIGNWARE=y
CONFIG_DRIVER_FLASH_MEMMAPPED=y
CONFIG_DRIVER_SOC_CEZANNE=y
CONFIG_DRIVER_INPUT_PS2=y
CONFIG_DRIVER_POWER_FCH=y
CONFIG_DRIVER_STORAGE_NVME=y

# Cezanne uses 32 MiB + ~2 MiB for coreboot so place the kernel at 64 MiB
CONFIG_KERNEL_START=0x4000000

# Timestamp
CONFIG_TIMESTAMP_RAW=n

# Diag
CONFIG_DIAGNOSTIC_UI=n
```

## board/mancomb/defconfig
```kconfig
# Arch
CONFIG_ARCH_X86=y

# Board
CONFIG_BOARD_DIR="mancomb"

# Image
CONFIG_HEAP_SIZE=0x01000000

# Vboot
CONFIG_AUXFW_SOFTWARE_SYNC=y
#TODO: Re-enable EC_VBOOT_SUPPORT later.
#CONFIG_EC_VBOOT_SUPPORT=y
CONFIG_EC_SLOW_UPDATE=y
CONFIG_TPM2_MODE=y
CONFIG_TPM_DEBUG_EXTENSIONS=y
CONFIG_NVDATA_CMOS=y
CONFIG_CROSSYSTEM_ACPI=y

# Kernel format
CONFIG_KERNEL_MULTIBOOT=y
CONFIG_KERNEL_MULTIBOOT_ZBI=y
CONFIG_KERNEL_ZIMAGE=y

# Drivers
CONFIG_DRIVER_BUS_I2C_CROS_EC_TUNNEL=y
CONFIG_DRIVER_BUS_I2C_DESIGNWARE=y
CONFIG_DRIVER_EC_ANX3429=y
CONFIG_DRIVER_EC_CROS=y
CONFIG_DRIVER_EC_CROS_LPC=y
CONFIG_DRIVER_EC_PS8751=y
CONFIG_DRIVER_FLASH_MEMMAPPED=y
CONFIG_DRIVER_SOC_CEZANNE=y
CONFIG_DRIVER_POWER_FCH=y
CONFIG_DRIVER_SDHCI=y
CONFIG_DRIVER_SOUND_GPIO_EDGE_BUZZER=y
CONFIG_DRIVER_STORAGE_MMC=y
CONFIG_DRIVER_STORAGE_NVME=y
CONFIG_DRIVER_STORAGE_SDHCI_PCI=y
CONFIG_DRIVER_STORAGE_BAYHUB=y
CONFIG_DRIVER_TPM_CR50_I2C=y

# Cezanne uses 32 MiB + ~2 MiB for coreboot so place the kernel at 64 MiB
CONFIG_KERNEL_START=0x4000000

# Timestamp
CONFIG_TIMESTAMP_RAW=n
```

## board/mistral/defconfig
```kconfig
# Arch
CONFIG_ARCH_ARM=y
CONFIG_ARCH_ARM_V8=y

# Board
CONFIG_BOARD_DIR="mistral"

# Image
CONFIG_BASE_ADDRESS=0xB1000000
CONFIG_HEAP_SIZE=0x01000000
CONFIG_KERNEL_START=0x8B000000

# Vboot
CONFIG_TPM2_MODE=y
#CONFIG_MOCK_TPM is not set
CONFIG_DRIVER_TPM=y
CONFIG_DRIVER_TPM_SPI=y
CONFIG_DRIVER_TPM_CR50_SWITCHES=y
CONFIG_CROSSYSTEM_FDT=y
CONFIG_NV_STORAGE_FLASH=y

# Kernel format
CONFIG_KERNEL_FIT=y
CONFIG_KERNEL_FIT_FDT_ADDR=0xB0000000

# Drivers
CONFIG_HEADLESS=y
#CONFIG_DRIVER_TPM_SPI is not set
CONFIG_DRIVER_FLASH_SPI=y
CONFIG_DRIVER_BUS_I2C_QCS405=y
#eMMC/SD-card
CONFIG_DRIVER_STORAGE_MMC=y
CONFIG_DRIVER_SDHCI=y
CONFIG_DRIVER_STORAGE_SDHCI_MSM=y

CONFIG_DRIVER_GPIO_QCS405=y
CONFIG_DRIVER_BUS_SPI_QCS405=y
# VIDEO
CONFIG_DRIVER_VIDEO_LP5562=y
```

## board/nocturne/defconfig
```kconfig
# Arch
CONFIG_ARCH_X86=y

# Board
CONFIG_BOARD="nocturne"

# Image
CONFIG_HEAP_SIZE=0x00600000

# Vboot
CONFIG_CROSSYSTEM_ACPI=y
CONFIG_EC_SOFTWARE_SYNC=y
CONFIG_NV_STORAGE_CMOS=y
CONFIG_TPM_DEBUG_EXTENSIONS=y
CONFIG_TPM2_MODE=y
CONFIG_VIRTUAL_DEV_SWITCH=y

# Kernel format
CONFIG_KERNEL_MULTIBOOT=y
CONFIG_KERNEL_MULTIBOOT_BOOTDATA=y
CONFIG_KERNEL_ZIMAGE=y

# Drivers
CONFIG_DRIVER_BUS_I2C_DESIGNWARE=y
CONFIG_DRIVER_BUS_I2C_DESIGNWARE_PCI=y
CONFIG_DRIVER_BUS_SPI_INTEL_GSPI=y
CONFIG_DRIVER_EC_CROS=y
CONFIG_DRIVER_EC_CROS_LPC=y
CONFIG_DRIVER_FLASH_MEMMAPPED=y
CONFIG_DRIVER_INPUT_USB=y
CONFIG_DRIVER_POWER_PCH=y
CONFIG_DRIVER_SDHCI=y
CONFIG_DRIVER_SOC_SKYLAKE=y
CONFIG_DRIVER_SOUND_MAX98373=y
CONFIG_DRIVER_STORAGE_MMC=y
CONFIG_DRIVER_STORAGE_SDHCI_PCI=y
CONFIG_DRIVER_TPM_SPI=y
```
