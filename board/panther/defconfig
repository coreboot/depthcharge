## board/panther/defconfig
```kconfig
# Arch
CONFIG_ARCH_X86=y

# Board
CONFIG_BOARD="panther"

# Image
CONFIG_FMAP_OFFSET=0x610000

# Vboot
CONFIG_OPROM_MATTERS=y
CONFIG_PHYSICAL_REC_SWITCH=y
CONFIG_RO_NORMAL_SUPPORT=y
CONFIG_VIRTUAL_DEV_SWITCH=y

CONFIG_CROSSYSTEM_ACPI=y
CONFIG_NV_STORAGE_CMOS=y

# Kernel format
CONFIG_KERNEL_ZIMAGE=y

# Drivers
CONFIG_DRIVER_AHCI=y
CONFIG_DRIVER_FLASH_MEMMAPPED=y
CONFIG_DRIVER_GPIO_LYNXPOINT_LP=y
CONFIG_DRIVER_INPUT_PS2=y
CONFIG_DRIVER_INPUT_USB=y
CONFIG_DRIVER_NET_ASIX=y
CONFIG_DRIVER_POWER_PCH=y
CONFIG_DRIVER_SOUND_PCAT_BEEP=y
CONFIG_DRIVER_TPM_LPC=y
```

## board/peach_pit/defconfig
```kconfig
# Arch
CONFIG_ARCH_ARM=y

# Board
CONFIG_BOARD="peach_pit"

# Image
CONFIG_BASE_ADDRESS=0x23000000
CONFIG_FMAP_OFFSET=0x00100000
CONFIG_HEAP_SIZE=0x00600000
CONFIG_KERNEL_START=0x22000000

# Vboot
CONFIG_EC_SOFTWARE_SYNC=y
CONFIG_RO_NORMAL_SUPPORT=y
CONFIG_VIRTUAL_DEV_SWITCH=y

CONFIG_CROSSYSTEM_FDT=y
CONFIG_NV_STORAGE_CROS_EC=y

# Kernel format
CONFIG_KERNEL_FIT=y
CONFIG_KERNEL_FIT_COMPAT="google,pit-rev3"
CONFIG_KERNEL_FIT_FDT_ADDR=0x3ff00000

# Drivers
CONFIG_DRIVER_BUS_I2C_EXYNOS5_USI=y
CONFIG_DRIVER_BUS_I2S_EXYNOS5=y
CONFIG_DRIVER_BUS_SPI_EXYNOS5=y
CONFIG_DRIVER_EC_CROS=y
CONFIG_DRIVER_EC_CROS_SPI=y
CONFIG_DRIVER_FLASH_SPI=y
CONFIG_DRIVER_GPIO_EXYNOS5420=y
CONFIG_DRIVER_INPUT_MKBP=y
CONFIG_DRIVER_INPUT_MKBP_KEYMATRIX_STANDARD=y
CONFIG_DRIVER_INPUT_USB=y
CONFIG_DRIVER_NET_ASIX=y
CONFIG_DRIVER_POWER_EXYNOS=y
CONFIG_DRIVER_SOUND_I2S=y
CONFIG_DRIVER_SOUND_MAX98095=y
CONFIG_DRIVER_SOUND_ROUTE=y
CONFIG_DRIVER_STORAGE_MMC=y
CONFIG_DRIVER_STORAGE_MMC_DW=y
CONFIG_DRIVER_STORAGE_MMC_DW_EXYNOS=y
CONFIG_DRIVER_TPM_SLB9635_I2C=y
CONFIG_DRIVER_VIDEO_EXYNOS5=y
CONFIG_DRIVER_VIDEO_EXYNOS5_BASE=0x14400000
```

## board/piglin/defconfig
```kconfig
# Arch
CONFIG_ARCH_ARM=y
CONFIG_ARCH_ARM_V8=y

# Board
CONFIG_BOARD_DIR="herobrine"

# Image
CONFIG_BASE_ADDRESS=0xF1000000
CONFIG_HEAP_SIZE=0x01000000
CONFIG_KERNEL_START=0xD0000000

# Vboot
CONFIG_MOCK_TPM=y
CONFIG_TPM2_MODE=y
CONFIG_CROSSYSTEM_FDT=y
CONFIG_NVDATA_FLASH=y
CONFIG_TPM_DEBUG_EXTENSIONS=y

# Kernel format
CONFIG_KERNEL_FIT=y
CONFIG_KERNEL_FIT_FDT_ADDR=0xF0000000

# Drivers
#CONFIG_DRIVER_TPM_I2C is not set
CONFIG_DRIVER_FLASH_SPI=y
CONFIG_DRIVER_GPIO_SC7280=y
CONFIG_DRIVER_SOC_QCOM_SPMI=y

#eMMC/SD-card
CONFIG_DRIVER_STORAGE_MMC=y
CONFIG_DRIVER_SDHCI=y
CONFIG_DRIVER_STORAGE_SDHCI_MSM=y
CONFIG_DRIVER_STORAGE_SET_DLL_USER_CTL=y

# VIDEO
```

## board/poppy/defconfig
```kconfig
# Arch
CONFIG_ARCH_X86=y

# Board
CONFIG_BOARD="poppy"

# Image
CONFIG_FMAP_OFFSET=0x00C10000
CONFIG_HEAP_SIZE=0x00600000

# Vboot
CONFIG_EC_SOFTWARE_SYNC=y
CONFIG_VIRTUAL_DEV_SWITCH=y
CONFIG_CROSSYSTEM_ACPI=y
CONFIG_NV_STORAGE_CMOS=y

# Kernel format
CONFIG_KERNEL_ZIMAGE=y

# Drivers
CONFIG_DRIVER_BUS_I2C_DESIGNWARE=y
CONFIG_DRIVER_BUS_I2C_DESIGNWARE_PCI=y
CONFIG_DRIVER_EC_CROS=y
CONFIG_DRIVER_EC_CROS_LPC=y
CONFIG_DRIVER_FLASH_MEMMAPPED=y
CONFIG_DRIVER_INPUT_USB=y
CONFIG_DRIVER_POWER_PCH=y
CONFIG_DRIVER_SDHCI=y
CONFIG_DRIVER_SOC_SKYLAKE=y
CONFIG_DRIVER_STORAGE_MMC=y
CONFIG_DRIVER_STORAGE_SDHCI_PCI=y
```

## board/primus/defconfig
```kconfig
# Arch
CONFIG_ARCH_X86=y

# Board
CONFIG_BOARD_DIR="brya"
CONFIG_VARIANT_NAME="primus"

# Image
CONFIG_HEAP_SIZE=0x02600000

# Vboot
CONFIG_TPM2_MODE=y
CONFIG_CROSSYSTEM_ACPI=y
CONFIG_TPM_DEBUG_EXTENSIONS=y
CONFIG_AUXFW_SOFTWARE_SYNC=y
CONFIG_EC_VBOOT_SUPPORT=y
CONFIG_VBOOT_X86_SHA256_ACCELERATION=y

# Kernel format
CONFIG_KERNEL_MULTIBOOT=y
CONFIG_KERNEL_MULTIBOOT_ZBI=y
CONFIG_KERNEL_ZIMAGE=y

# Drivers
CONFIG_DRIVER_AHCI=y
CONFIG_DRIVER_BUS_I2C_CROS_EC_TUNNEL=y
CONFIG_DRIVER_BUS_I2C_DESIGNWARE=y
CONFIG_DRIVER_BUS_I2C_DESIGNWARE_PCI=y
CONFIG_DRIVER_EC_CROS=y
CONFIG_DRIVER_EC_CROS_LPC=y
CONFIG_DRIVER_FLASH_MEMMAPPED=y
CONFIG_DRIVER_GPIO_ALDERLAKE=y
CONFIG_DRIVER_INPUT_PS2=y
CONFIG_DRIVER_POWER_PCH=y
CONFIG_DRIVER_SOC_ALDERLAKE=y
CONFIG_DRIVER_STORAGE_NVME=y
CONFIG_DRIVER_TPM_CR50_I2C=y

# Audio
CONFIG_DRIVER_BUS_I2S_INTEL_COMMON_I2S=y
CONFIG_DRIVER_SOUND_I2S=y
CONFIG_DRIVER_SOUND_ROUTE=y

# USB Type-C
CONFIG_DRIVER_USB_INTEL_TCSS=y
CONFIG_DRIVER_SOC_INTEL_PMC=y
```

## board/puff/defconfig
```kconfig
# Arch
CONFIG_ARCH_X86=y

# Board
CONFIG_BOARD_DIR="puff"

# Image
CONFIG_HEAP_SIZE=0x02600000

# Vboot
CONFIG_TPM2_MODE=y
CONFIG_EC_VBOOT_SUPPORT=y
CONFIG_AUXFW_SOFTWARE_SYNC=y
CONFIG_CROSSYSTEM_ACPI=y
CONFIG_NVDATA_CMOS=y
CONFIG_TPM_DEBUG_EXTENSIONS=y

# Kernel format
CONFIG_KERNEL_MULTIBOOT=y
CONFIG_KERNEL_MULTIBOOT_ZBI=y
CONFIG_KERNEL_ZIMAGE=y

# Drivers
CONFIG_DRIVER_AHCI=y
CONFIG_DRIVER_BUS_I2C_CROS_EC_TUNNEL=y
CONFIG_DRIVER_BUS_SPI_INTEL_GSPI_VERSION_2=y
CONFIG_DRIVER_EC_CROS=y
CONFIG_DRIVER_EC_CROS_LPC=y
CONFIG_DRIVER_EC_PS8751=y
CONFIG_DRIVER_FLASH_FAST_SPI=y
CONFIG_DRIVER_INPUT_MKBP=y
CONFIG_DRIVER_INPUT_MKBP_KEYMATRIX_STANDARD=y
CONFIG_DRIVER_POWER_PCH=y
CONFIG_DRIVER_SDHCI=y
CONFIG_DRIVER_SOC_CANNONLAKE=y
CONFIG_DRIVER_SOUND_GPIO_EDGE_BUZZER=y
CONFIG_DRIVER_STORAGE_MMC=y
CONFIG_DRIVER_STORAGE_NVME=y
CONFIG_DRIVER_STORAGE_SDHCI_PCI=y
CONFIG_DRIVER_TPM_CR50_SWITCHES=y
CONFIG_DRIVER_TPM_SPI=y
CONFIG_DRIVER_GPIO_CANNONLAKE=y

# Audio
CONFIG_DRIVER_BUS_I2C_DESIGNWARE=y
CONFIG_DRIVER_BUS_I2C_DESIGNWARE_PCI=y
CONFIG_DRIVER_BUS_I2S_INTEL_COMMON_I2S=y
CONFIG_DRIVER_BUS_I2S_INTEL_COMMON_MAX98357A=y
CONFIG_DRIVER_SOUND_I2S=y
CONFIG_DRIVER_SOUND_ROUTE=y
CONFIG_DRIVER_SOUND_RT1015=y

# Auxfw
CONFIG_CROS_EC_PROBE_AUX_FW_INFO=y
```

## board/purin/defconfig
```kconfig
# Arch
CONFIG_ARCH_ARM=y

# Board
CONFIG_BOARD="purin"

# Image
CONFIG_BASE_ADDRESS=0x60400000
CONFIG_FMAP_OFFSET=0x00080000
CONFIG_HEAP_SIZE=0x01000000
CONFIG_KERNEL_START=0x63000000

# Vboot
CONFIG_VIRTUAL_DEV_SWITCH=y

CONFIG_CROSSYSTEM_FDT=y

# Kernel format
CONFIG_KERNEL_FIT=y
CONFIG_KERNEL_FIT_FDT_ADDR=0x63800000

# Drivers
CONFIG_DRIVER_FLASH_SPI=y
CONFIG_DRIVER_BUS_SPI_BCM_QSPI=y
CONFIG_DRIVER_INPUT_USB=y
CONFIG_DRIVER_TPM_SLB9635_I2C=y
CONFIG_DRIVER_BUS_I2C_CYGNUS=y
CONFIG_DRIVER_STORAGE_MTD_STREAM=y
CONFIG_DRIVER_STORAGE_MTD_BCM_NAND=y
CONFIG_DRIVER_STORAGE_SPI_GPT=y

CONFIG_HEADLESS=y
CONFIG_NV_STORAGE_FLASH=y
```

## board/rainier/defconfig
```kconfig
# Arch
CONFIG_ARCH_ARM=y
CONFIG_ARCH_ARM_V8=y

# Board
CONFIG_BOARD_DIR="gru"

# Image
CONFIG_BASE_ADDRESS=0x40000000
CONFIG_HEAP_SIZE=0x01000000
CONFIG_KERNEL_START=0x20000000

# Vboot
CONFIG_TPM2_MODE=y
CONFIG_EC_SOFTWARE_SYNC=y

CONFIG_CROSSYSTEM_FDT=y
CONFIG_NVDATA_FLASH=y

# Kernel format
CONFIG_KERNEL_FIT=y
CONFIG_KERNEL_FIT_FDT_ADDR=0x1f800000

# Drivers
CONFIG_DRIVER_BUS_I2S_ROCKCHIP=y
CONFIG_DRIVER_BUS_SPI_ROCKCHIP=y
CONFIG_DRIVER_EC_CROS=y
CONFIG_DRIVER_EC_CROS_SPI=y
CONFIG_DRIVER_EC_CROS_SPI_WAKEUP_DELAY_US=100
CONFIG_DRIVER_FLASH_SPI=y
CONFIG_DRIVER_GPIO_RK3399=y
CONFIG_DRIVER_INPUT_MKBP=y
CONFIG_DRIVER_INPUT_MKBP_KEYMATRIX_STANDARD=y
CONFIG_DRIVER_SOUND_I2S=y
CONFIG_DRIVER_SOUND_MAX98357A=y
CONFIG_DRIVER_SOUND_ROUTE=y
CONFIG_DRIVER_STORAGE_DWMMC_RK3399=y
CONFIG_DRIVER_STORAGE_MMC=y
CONFIG_DRIVER_STORAGE_SDHCI_RK3399=y
CONFIG_DRIVER_TPM_SPI=y
CONFIG_DRIVER_VIDEO_EC_PWM_BACKLIGHT=y
CONFIG_DRIVER_VIDEO_RK3399=y

# Rainier is derived from Scarlet, therefore shares many components
# and pinouts.
CONFIG_GRU_SCARLET=y
```

## board/rotor/defconfig
```kconfig
# Arch
CONFIG_ARCH_ARM=y
CONFIG_ARCH_ARM_V8=y

# Board
CONFIG_BOARD="rotor"

# Image
CONFIG_BASE_ADDRESS=0x0C080000

# FMAP_OFFSET
CONFIG_FMAP_OFFSET=0x00100000

CONFIG_HEAP_SIZE=0x00600000

# Kernel Start
CONFIG_KERNEL_START=0x04080000

# Vboot
CONFIG_VIRTUAL_DEV_SWITCH=y

CONFIG_CROSSYSTEM_FDT=y
CONFIG_MOCK_TPM=y

CONFIG_NV_STORAGE_FAKE=y

# Kernel format
CONFIG_KERNEL_FIT=y
CONFIG_KERNEL_FIT_FDT_ADDR=0x08080000

# Drivers
CONFIG_DRIVER_FLASH_SPI=y
CONFIG_DRIVER_FLASH_MEMMAPPED=y
```

## board/rowan/defconfig
```kconfig
# Arch
CONFIG_ARCH_ARM=y
CONFIG_ARCH_ARM_V8=y

# Board
CONFIG_BOARD="rowan"
CONFIG_BOARD_DIR="oak"
CONFIG_BOARD_ID_ADJUSTMENT=15

# Image
CONFIG_BASE_ADDRESS=0x80000000
CONFIG_HEAP_SIZE=0x00800000
CONFIG_KERNEL_START=0x60000000

# Vboot
CONFIG_VIRTUAL_DEV_SWITCH=y
CONFIG_EC_SOFTWARE_SYNC=y
CONFIG_EC_SLOW_UPDATE=y
CONFIG_CROSSYSTEM_FDT=y
CONFIG_NV_STORAGE_FLASH=y
CONFIG_TPM2_MODE=y
CONFIG_TPM_DEBUG_EXTENSIONS=y

# Kernel format
CONFIG_KERNEL_FIT=y
CONFIG_KERNEL_FIT_FDT_ADDR=0x5f800000

# Drivers
CONFIG_DRIVER_BUS_I2C_MT8173=y
CONFIG_DRIVER_BUS_I2C_CROS_EC_TUNNEL=y
CONFIG_DRIVER_BUS_I2S_MT8173=y
CONFIG_DRIVER_BUS_SPI_MTK=y
CONFIG_DRIVER_EC_ANX7688=y
CONFIG_DRIVER_EC_CROS=y
CONFIG_DRIVER_EC_CROS_SPI=y
CONFIG_DRIVER_GPIO_MT8173=y
CONFIG_DRIVER_INPUT_USB=y
CONFIG_DRIVER_SOUND_I2S=y
CONFIG_DRIVER_SOUND_RT5645=y
CONFIG_DRIVER_SOUND_RT5677=y
CONFIG_DRIVER_SOUND_ROUTE=y
CONFIG_DRIVER_STORAGE_MMC=y
CONFIG_DRIVER_STORAGE_MMC_MTK=y
CONFIG_DRIVER_FLASH_NOR_MT8173=y
CONFIG_DRIVER_TPM_CR50_I2C=y

# VIDEO
CONFIG_DRIVER_VIDEO_MEDIATEK=y
CONFIG_OAK_MIPI_DISPLAY=y
```

## board/samus/defconfig
```kconfig
# Arch
CONFIG_ARCH_X86=y

# Board
CONFIG_BOARD="samus"

# Image
CONFIG_FMAP_OFFSET=0x610000

# Vboot
CONFIG_EC_SOFTWARE_SYNC=y
CONFIG_OPROM_MATTERS=y
CONFIG_VIRTUAL_DEV_SWITCH=y

CONFIG_CROSSYSTEM_ACPI=y
CONFIG_NV_STORAGE_CMOS=y

# Kernel format
CONFIG_KERNEL_ZIMAGE=y

# Drivers
CONFIG_DRIVER_AHCI=y
CONFIG_DRIVER_BUS_I2C_DESIGNWARE=y
CONFIG_DRIVER_BUS_I2S_BROADWELL=y
CONFIG_DRIVER_BUS_I2S_BROADWELL_ALC5677=y
CONFIG_DRIVER_EC_CROS=y
CONFIG_DRIVER_EC_CROS_LPC=y
CONFIG_DRIVER_EC_CROS_PASSTHRU=y
CONFIG_DRIVER_FLASH_MEMMAPPED=y
CONFIG_DRIVER_GPIO_LYNXPOINT_LP=y
CONFIG_DRIVER_INPUT_PS2=y
CONFIG_DRIVER_INPUT_USB=y
CONFIG_DRIVER_POWER_PCH=y
CONFIG_DRIVER_SOUND_I2S=y
CONFIG_DRIVER_SOUND_ROUTE=y
CONFIG_DRIVER_SOUND_RT5677=y
CONFIG_DRIVER_TPM_LPC=y
CONFIG_DRIVER_VIDEO_INTEL_I915=y
```

## board/sarien/defconfig
```kconfig
# Arch
CONFIG_ARCH_X86=y

# Board
CONFIG_BOARD_DIR="sarien"

# Image
CONFIG_HEAP_SIZE=0x02600000

# Vboot
CONFIG_TPM2_MODE=y
CONFIG_CROSSYSTEM_ACPI=y
CONFIG_NVDATA_CMOS=y
CONFIG_TPM_DEBUG_EXTENSIONS=y
CONFIG_EC_VBOOT_SUPPORT=y
CONFIG_EC_SLOW_UPDATE=y

# Kernel format
CONFIG_KERNEL_MULTIBOOT=y
CONFIG_KERNEL_MULTIBOOT_ZBI=y
CONFIG_KERNEL_ZIMAGE=y

# Drivers
CONFIG_DRIVER_AHCI=y
CONFIG_DRIVER_BUS_I2C_DESIGNWARE=y
CONFIG_DRIVER_BUS_I2C_DESIGNWARE_PCI=y
CONFIG_DRIVER_EC_WILCO=y
CONFIG_DRIVER_FLASH_FAST_SPI=y
CONFIG_DRIVER_GPIO_CANNONLAKE=y
CONFIG_DRIVER_INPUT_PS2=y
CONFIG_DRIVER_POWER_PCH=y
CONFIG_DRIVER_SDHCI=y
CONFIG_DRIVER_SOC_CANNONLAKE=y
CONFIG_DRIVER_SOUND_HDA=y
CONFIG_DRIVER_STORAGE_BAYHUB=y
CONFIG_DRIVER_STORAGE_MMC=y
CONFIG_DRIVER_STORAGE_NVME=y
CONFIG_DRIVER_STORAGE_SDHCI_PCI=y
CONFIG_DRIVER_TPM_CR50_I2C=y
CONFIG_DRIVER_TPM_CR50_SWITCHES=y
```

## board/senor/defconfig
```kconfig
# Arch
CONFIG_ARCH_ARM=y
CONFIG_ARCH_ARM_V8=y

# Board
CONFIG_BOARD_DIR="senor"

# Image
CONFIG_BASE_ADDRESS=0xF1000000
CONFIG_HEAP_SIZE=0x01000000
CONFIG_KERNEL_START=0xD0000000

# Vboot
CONFIG_MOCK_TPM=y
CONFIG_TPM2_MODE=y
CONFIG_CROSSYSTEM_FDT=y
CONFIG_NVDATA_FLASH=y
CONFIG_TPM_DEBUG_EXTENSIONS=y

# Kernel format
CONFIG_KERNEL_FIT=y
CONFIG_KERNEL_FIT_FDT_ADDR=0xF0000000

# Drivers
CONFIG_DRIVER_TPM_SPI=y
CONFIG_DRIVER_FLASH_SPI=y
CONFIG_DRIVER_BUS_I2C_SC7280=y
CONFIG_DRIVER_GPIO_SC7280=y
CONFIG_DRIVER_SOC_QCOM_SPMI=y
CONFIG_DRIVER_BUS_QSPI_SC7280=y
CONFIG_DRIVER_BUS_SPI_QUP_SC7280=y
CONFIG_DRIVER_SOC_QCOM_QUP_SE=y
CONFIG_DRIVER_BUS_I2C_SC7180=y

#eMMC/SD-card
CONFIG_DRIVER_STORAGE_MMC=y
CONFIG_DRIVER_SDHCI=y
CONFIG_DRIVER_STORAGE_SDHCI_MSM=y

#NVMe
CONFIG_DRIVER_STORAGE_NVME=y

# VIDEO
```

## board/shadowmountain/defconfig
```kconfig
# Arch
CONFIG_ARCH_X86=y

# Board
CONFIG_BOARD_DIR="shadowmountain"

# Image
CONFIG_HEAP_SIZE=0x02600000

# Vboot
CONFIG_TPM2_MODE=y
CONFIG_DRIVER_TPM_SPI=y
CONFIG_CROSSYSTEM_ACPI=y
CONFIG_EC_VBOOT_SUPPORT=n

# Kernel format
CONFIG_KERNEL_MULTIBOOT=y
CONFIG_KERNEL_MULTIBOOT_ZBI=y
CONFIG_KERNEL_ZIMAGE=y

# Drivers
CONFIG_DRIVER_BUS_I2C_CROS_EC_TUNNEL=y
CONFIG_DRIVER_AHCI=y
CONFIG_DRIVER_BUS_SPI_INTEL_GSPI_VERSION_2=y
CONFIG_DRIVER_EC_CROS=y
CONFIG_DRIVER_EC_CROS_LPC=y
CONFIG_DRIVER_EC_PS8751=y
CONFIG_DRIVER_FLASH_MEMMAPPED=y
CONFIG_DRIVER_GPIO_ALDERLAKE=y
CONFIG_DRIVER_INPUT_PS2=y
CONFIG_DRIVER_POWER_PCH=y
CONFIG_DRIVER_SOC_ALDERLAKE=y
CONFIG_DRIVER_TPM_SPI=y
CONFIG_DRIVER_STORAGE_NVME=y
CONFIG_DRIVER_SDHCI=y
CONFIG_DRIVER_STORAGE_GENESYSLOGIC=y
CONFIG_DRIVER_STORAGE_MMC=y
CONFIG_DRIVER_STORAGE_SDHCI_PCI=y

# Audio
CONFIG_DRIVER_BUS_I2C_DESIGNWARE=y
CONFIG_DRIVER_BUS_I2C_DESIGNWARE_PCI=y
CONFIG_SHADOWMOUNTAIN_MAX98373_I2S_PORT=1
CONFIG_MAX98373_I2S_BOOTBEEP=y
```

## board/skyrim/defconfig
```kconfig
# Arch
CONFIG_ARCH_X86=y

# Board
CONFIG_BOARD_DIR="skyrim"
CONFIG_VARIANT_NAME="skyrim"

# Image
CONFIG_HEAP_SIZE=0x01000000

# Vboot
CONFIG_AUXFW_SOFTWARE_SYNC=n
CONFIG_EC_VBOOT_SUPPORT=y
CONFIG_NVDATA_CMOS=y
CONFIG_CROSSYSTEM_ACPI=y

# Kernel format
CONFIG_KERNEL_MULTIBOOT=y
CONFIG_KERNEL_MULTIBOOT_ZBI=y
CONFIG_KERNEL_ZIMAGE=y

# Drivers
CONFIG_DRIVER_BUS_I2C_DESIGNWARE=y
CONFIG_DRIVER_EC_CROS=y
CONFIG_DRIVER_EC_CROS_LPC=y
CONFIG_DRIVER_FLASH_MEMMAPPED=y
CONFIG_DRIVER_SOC_MENDOCINO=y
CONFIG_DRIVER_INPUT_MKBP=y
CONFIG_DRIVER_INPUT_MKBP_KEYMATRIX_STANDARD=y
CONFIG_DRIVER_INPUT_PS2=y
CONFIG_DRIVER_POWER_FCH=y
CONFIG_DRIVER_STORAGE_NVME=y
CONFIG_DRIVER_TPM_GOOGLE_CR50=y
CONFIG_DRIVER_TPM_I2C=y
CONFIG_DRIVER_STORAGE_MMC=y
CONFIG_DRIVER_STORAGE_MMC_RTK=y
CONFIG_DRIVER_STORAGE_COMMON=y

# Mendocino uses 32 MiB + ~2 MiB for coreboot so place the kernel at 64 MiB
CONFIG_KERNEL_START=0x4000000

# Timestamp
CONFIG_TIMESTAMP_RAW=n

# Audio beep
CONFIG_DRIVER_SOUND_AMD_ACP_V2=y
CONFIG_DRIVER_SOUND_GPIO_AMP=y
CONFIG_DRIVER_SOUND_ROUTE=y
CONFIG_DRIVER_SOUND_RT1019=y
CONFIG_DRIVER_SOUND_RT5682S=y
```

## board/skywalker/defconfig
```kconfig
# Arch
CONFIG_ARCH_ARM=y
CONFIG_ARCH_ARM_V8=y

# Board
CONFIG_BOARD_DIR="skywalker"

# Image
CONFIG_BASE_ADDRESS=0xF1000000
CONFIG_KERNEL_START=0xD0000000

# Vboot
CONFIG_EC_VBOOT_SUPPORT=y
CONFIG_EC_SLOW_UPDATE=y
CONFIG_CROSSYSTEM_FDT=y
CONFIG_NVDATA_FLASH=y

# Kernel format
CONFIG_KERNEL_FIT=y
CONFIG_KERNEL_FIT_FDT_ADDR=0xF0000000

# Drivers
CONFIG_DRIVER_BUS_I2C_CROS_EC_TUNNEL=y
CONFIG_DRIVER_BUS_SPI_MTK=y
CONFIG_DRIVER_EC_CROS=y
CONFIG_DRIVER_EC_CROS_SPI=y
CONFIG_DRIVER_FLASH_MTK_SNFC=y
CONFIG_DRIVER_FLASH_SPI=y
CONFIG_DRIVER_GPIO_MT8189=y
CONFIG_DRIVER_STORAGE_MMC=y
CONFIG_DRIVER_STORAGE_MMC_MTK=y
CONFIG_DRIVER_STORAGE_UFS=y
CONFIG_DRIVER_STORAGE_UFS_MTK=y

# TODO: Remove this when TPM is ready
CONFIG_MOCK_TPM=y
```

## board/smaug/defconfig
```kconfig
# Arch
CONFIG_ARCH_ARM=y
CONFIG_ARCH_ARM_V8=y

# Board
CONFIG_BOARD_DIR="smaug"

# Boot
CONFIG_ANDROID_DT_FIXUP=y

# Image
CONFIG_BASE_ADDRESS=0xd4000000
CONFIG_HEAP_SIZE=0x04000000
CONFIG_KERNEL_START=0xa0000000

# Vboot
CONFIG_EC_VBOOT_SUPPORT=y
CONFIG_CROSSYSTEM_FDT=y
CONFIG_NVDATA_FLASH=y

# Kernel format
CONFIG_KERNEL_FIT=y
CONFIG_KERNEL_FIT_FDT_ADDR=0x9f800000

# Drivers
CONFIG_DRIVER_BUS_I2C_TEGRA=y
CONFIG_DRIVER_BUS_I2S_TEGRA=y
CONFIG_DRIVER_BUS_SPI_TEGRA=y
CONFIG_DRIVER_DMA_TEGRA_APB=y
CONFIG_DRIVER_EC_CROS=y
CONFIG_DRIVER_EC_CROS_I2C=y
CONFIG_DRIVER_FLASH_SPI=y
CONFIG_DRIVER_GPIO_TEGRA=y
CONFIG_DRIVER_POWER_MAX77620=y
CONFIG_DRIVER_STORAGE_MMC=y
CONFIG_DRIVER_STORAGE_MMC_TEGRA=y
CONFIG_DRIVER_TPM_SLB9635_I2C=y
CONFIG_DRIVER_SOUND_I2S=y
CONFIG_DRIVER_SOUND_RT5677=y
CONFIG_DRIVER_SOUND_ROUTE=y
CONFIG_DRIVER_SOUND_TEGRA_AUDIO_HUB=y
CONFIG_DRIVER_VIDEO_TEGRA210=y
```
