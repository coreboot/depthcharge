## board/snappy/defconfig
```kconfig
# Arch
CONFIG_ARCH_X86=y

# Board
CONFIG_BOARD="snappy"
CONFIG_BOARD_DIR="reef"

# Image
CONFIG_FMAP_OFFSET=0x00204000

# Vboot
CONFIG_EC_SOFTWARE_SYNC=y
CONFIG_TPM2_MODE=y
CONFIG_TPM_DEBUG_EXTENSIONS=y
CONFIG_VIRTUAL_DEV_SWITCH=y

CONFIG_CROSSYSTEM_ACPI=y
CONFIG_NV_STORAGE_CMOS=y

# Kernel format
CONFIG_KERNEL_ZIMAGE=y

# Drivers
CONFIG_DRIVER_BUS_I2C_DESIGNWARE=y
CONFIG_DRIVER_BUS_I2C_DESIGNWARE_PCI=y
CONFIG_DRIVER_EC_CROS=y
CONFIG_DRIVER_EC_CROS_LPC=y
CONFIG_DRIVER_FLASH_MEMMAPPED=y
CONFIG_DRIVER_INPUT_PS2=y
CONFIG_DRIVER_INPUT_USB=y
CONFIG_DRIVER_POWER_PCH=y
CONFIG_DRIVER_SDHCI=y
CONFIG_DRIVER_STORAGE_MMC=y
CONFIG_DRIVER_STORAGE_SDHCI_PCI=y
CONFIG_DRIVER_SOC_APOLLOLAKE=y
CONFIG_DRIVER_TPM_CR50_I2C=y

#Audio

CONFIG_DRIVER_BUS_I2S_APOLLOLAKE=y
CONFIG_DRIVER_BUS_I2S_APOLLOLAKE_MAX98357A=y
CONFIG_DRIVER_SOUND_I2S=y
CONFIG_DRIVER_SOUND_MAX98357A=y
CONFIG_DRIVER_SOUND_ROUTE=y
```

## board/soraka/defconfig
```kconfig
# Arch
CONFIG_ARCH_X86=y

# Board
CONFIG_BOARD_DIR="poppy"

# Image
CONFIG_HEAP_SIZE=0x00600000

# Vboot
CONFIG_EC_VBOOT_SUPPORT=y
CONFIG_EC_SLOW_UPDATE=y
CONFIG_CROSSYSTEM_ACPI=y
CONFIG_NVDATA_CMOS=y
CONFIG_TPM2_MODE=y
CONFIG_TPM_DEBUG_EXTENSIONS=y

# Kernel format
CONFIG_KERNEL_ZIMAGE=y
CONFIG_KERNEL_MULTIBOOT=y
CONFIG_KERNEL_MULTIBOOT_ZBI=y

# Drivers
CONFIG_DRIVER_BUS_I2C_DESIGNWARE=y
CONFIG_DRIVER_BUS_I2C_DESIGNWARE_PCI=y
CONFIG_DRIVER_EC_CROS=y
CONFIG_DRIVER_EC_CROS_LPC=y
CONFIG_DRIVER_FLASH_MEMMAPPED=y
CONFIG_DRIVER_INPUT_MKBP=y
CONFIG_DRIVER_INPUT_MKBP_KEYMATRIX_STANDARD=y
CONFIG_DRIVER_BUS_SPI_INTEL_GSPI=y
CONFIG_DRIVER_SOUND_GPIO_I2S=y
CONFIG_DRIVER_SOUND_MAX98927=y
CONFIG_DRIVER_SOUND_ROUTE=y
CONFIG_DRIVER_POWER_PCH=y
CONFIG_DRIVER_SDHCI=y
CONFIG_DRIVER_SOC_SKYLAKE=y
CONFIG_DRIVER_STORAGE_MMC=y
CONFIG_DRIVER_STORAGE_SDHCI_PCI=y
CONFIG_DRIVER_TPM_CR50_I2C=y
```

## board/storm/defconfig
```kconfig
# Arch
CONFIG_ARCH_ARM=y

# Board
CONFIG_BOARD="storm"

# Documentation/arm/Booting says:
#  The kernel should be placed in the first 128MiB of RAM. It is recommended
#  that it is loaded above 32MiB in order to avoid the need to relocate prior
#  to decompression, which will make the boot process slightly faster.
# KERNEL_START is where the (compressed) kernel blob is loaded.

# Image
CONFIG_BASE_ADDRESS=0x55000000
CONFIG_FMAP_OFFSET=0x00300000
CONFIG_HEAP_SIZE=0x02800000
CONFIG_KERNEL_START=0x44000000

# Vboot
CONFIG_VIRTUAL_DEV_SWITCH=y
CONFIG_USB_BOOT_ON_DEV=y

CONFIG_CROSSYSTEM_FDT=y

# Kernel format
CONFIG_KERNEL_FIT=y
CONFIG_KERNEL_FIT_FDT_ADDR=0x54000000
CONFIG_KERNEL_LEGACY=y

# Drivers
CONFIG_DRIVER_BUS_I2C_IPQ806X=y
CONFIG_DRIVER_BUS_SPI_IPQ806X=y
CONFIG_DRIVER_FLASH_SPI=y
CONFIG_DRIVER_GPIO_IPQ_806X=y
CONFIG_DRIVER_INPUT_USB=y
CONFIG_DRIVER_NET_IPQ806X=y
CONFIG_DRIVER_POWER_IPQ806X=y
CONFIG_DRIVER_SOUND_IPQ806X=y
CONFIG_DRIVER_SOUND_ROUTE=y
CONFIG_DRIVER_STORAGE_IPQ_806X=y
CONFIG_DRIVER_STORAGE_MMC=y
CONFIG_DRIVER_TPM_SLB9635_I2C=y
CONFIG_DRIVER_VIDEO_WW_RING=y

CONFIG_HEADLESS=y
CONFIG_NV_STORAGE_FLASH=y

CONFIG_MACHID=0x1260
CONFIG_ATAG_BASE=0x5f000000

CONFIG_DRIVER_STORAGE_MTD_STREAM=y
CONFIG_DRIVER_STORAGE_SPI_GPT=y
CONFIG_DRIVER_STORAGE_MTD_IPQ_NAND=y
```

## board/tglrvp/defconfig
```kconfig
# Arch
CONFIG_ARCH_X86=y

# Board
CONFIG_BOARD_DIR="tglrvp"

# Image
CONFIG_HEAP_SIZE=0x00600000

# Vboot
#CONFIG_VIRTUAL_DEV_SWITCH=y
CONFIG_CROSSYSTEM_ACPI=y
CONFIG_NV_STORAGE_CMOS=y
CONFIG_MOCK_TPM=y

# Kernel format
CONFIG_KERNEL_MULTIBOOT=y
CONFIG_KERNEL_MULTIBOOT_BOOTDATA=y
CONFIG_KERNEL_ZIMAGE=y

# Drivers
CONFIG_DRIVER_AHCI=y
CONFIG_DRIVER_FLASH_MEMMAPPED=y
CONFIG_DRIVER_INPUT_PS2=y
CONFIG_DRIVER_POWER_PCH=y
CONFIG_DRIVER_SOC_CANNONLAKE=y
CONFIG_DRIVER_STORAGE_NVME=y
```

## board/trogdor/defconfig
```kconfig
# Arch
CONFIG_ARCH_ARM=y
CONFIG_ARCH_ARM_V8=y

# Board
CONFIG_BOARD_DIR="trogdor"

# Image
CONFIG_BASE_ADDRESS=0xF1000000
CONFIG_HEAP_SIZE=0x01800000
CONFIG_KERNEL_START=0xD0000000

# Vboot
#CONFIG_MOCK_TPM is not set
CONFIG_TPM2_MODE=y
CONFIG_CROSSYSTEM_FDT=y
CONFIG_NVDATA_FLASH=y
CONFIG_EC_SOFTWARE_SYNC=y
CONFIG_AUXFW_SOFTWARE_SYNC=y
CONFIG_CROS_EC_PROBE_AUX_FW_INFO=y

# Kernel format
CONFIG_KERNEL_FIT=y
CONFIG_KERNEL_FIT_FDT_ADDR=0xF0000000

# Drivers
CONFIG_DRIVER_TPM_SPI=y
CONFIG_DRIVER_EC_CROS=y
CONFIG_DRIVER_EC_CROS_SPI=y
CONFIG_DRIVER_EC_PS8751=y
CONFIG_DRIVER_FLASH_SPI=y
CONFIG_DRIVER_INPUT_MKBP=y
CONFIG_DRIVER_INPUT_MKBP_KEYMATRIX_STANDARD=y
CONFIG_DRIVER_BUS_QSPI_SC7180=y
CONFIG_DRIVER_BUS_I2C_CROS_EC_TUNNEL=y
CONFIG_DRIVER_BUS_I2C_SC7180=y
CONFIG_DRIVER_STORAGE_MMC=y
CONFIG_DRIVER_SDHCI=y
CONFIG_DRIVER_STORAGE_SDHCI_MSM=y
CONFIG_DRIVER_BUS_SPI_QCOM_SPI_QUP=y
CONFIG_DRIVER_SOC_QCOM_QUP_SE=y
CONFIG_DRIVER_GPIO_SC7180=y
CONFIG_DRIVER_SOUND_ROUTE=y
CONFIG_DRIVER_SOUND_MAX98357A=y
CONFIG_DRIVER_SOUND_I2S=y
CONFIG_DRIVER_BUS_I2S_SC7180=y

# VIDEO
CONFIG_DRIVER_VIDEO_EC_PWM_BACKLIGHT=y
CONFIG_DRIVER_VIDEO_SC7180=y
```

## board/urara/defconfig
```kconfig
CONFIG_ARCH_MIPS=y
CONFIG_BASE_ADDRESS=0x0F000000
CONFIG_BOARD="urara"
CONFIG_DRIVER_BUS_I2C_IMGTEC=y
CONFIG_DRIVER_BUS_SPI_IMGTEC=y
CONFIG_DRIVER_FLASH=y
CONFIG_DRIVER_FLASH_SPI=y
CONFIG_DRIVER_GPIO_IMGTEC_PISTACHIO=y
CONFIG_DRIVER_STORAGE_MTD_SPI_NAND=y
CONFIG_DRIVER_STORAGE_MTD_STREAM=y
CONFIG_DRIVER_STORAGE_SPI_GPT=y
CONFIG_DRIVER_TPM_SLB9635_I2C=y
CONFIG_FMAP_OFFSET=0xe0000
CONFIG_HEADLESS=y
CONFIG_HEAP_SIZE=0x00800000
CONFIG_KERNEL_FIT=y
CONFIG_KERNEL_FIT_FDT_ADDR=0x00ff0000
CONFIG_KERNEL_START=0x01000000
CONFIG_LDSCRIPT_ARCH=y
CONFIG_NV_STORAGE_FLASH=y
```

## board/veyron_rialto/defconfig
```kconfig
# Arch
CONFIG_ARCH_ARM=y

# Board
CONFIG_BOARD_DIR="veyron_rialto"

# Image
CONFIG_BASE_ADDRESS=0x23000000
CONFIG_HEAP_SIZE=0x01000000
CONFIG_KERNEL_START=0x02000000

# Vboot
CONFIG_CUSTOM_MUSIC=y
CONFIG_PHYSICAL_REC_SWITCH=y
CONFIG_USB_BOOT_ON_DEV=y

CONFIG_CROSSYSTEM_FDT=y
CONFIG_NVDATA_FLASH=y
CONFIG_HEADLESS=y


#CONFIG_MOCK_TPM=y

# Kernel format
CONFIG_KERNEL_FIT=y
CONFIG_KERNEL_FIT_FDT_ADDR=0x1f800000

# Drivers
CONFIG_DRIVER_GPIO_RK3288=y
CONFIG_DRIVER_BUS_I2C_ROCKCHIP=y
CONFIG_DRIVER_BUS_SPI_ROCKCHIP=y
CONFIG_DRIVER_BUS_I2S_ROCKCHIP=y
CONFIG_DRIVER_FLASH_SPI=y
CONFIG_DRIVER_POWER_RK808=y
CONFIG_DRIVER_INPUT_USB=y
CONFIG_DRIVER_STORAGE_MMC=y
CONFIG_DRIVER_STORAGE_DWMMC_RK3288=y
CONFIG_DRIVER_TPM_SLB9635_I2C=y
```

## board/veyron_romy/defconfig
```kconfig
# Arch
CONFIG_ARCH_ARM=y

# Board
CONFIG_BOARD="veyron_romy"

# Image
CONFIG_BASE_ADDRESS=0x43000000
CONFIG_FMAP_OFFSET=0x00100000
CONFIG_HEAP_SIZE=0x01000000
CONFIG_KERNEL_START=0x2000000

# Vboot
CONFIG_VIRTUAL_DEV_SWITCH=y

CONFIG_CROSSYSTEM_FDT=y
CONFIG_NV_STORAGE_FLASH=y


#CONFIG_MOCK_TPM=y

# Kernel format
CONFIG_KERNEL_FIT=y
CONFIG_KERNEL_FIT_FDT_ADDR=0x6400000

# Drivers
CONFIG_DRIVER_GPIO_ROCKCHIP=y
CONFIG_DRIVER_BUS_I2C_ROCKCHIP=y
CONFIG_DRIVER_BUS_SPI_ROCKCHIP=y
CONFIG_DRIVER_BUS_I2S_ROCKCHIP=y
CONFIG_DRIVER_FLASH_SPI=y
CONFIG_DRIVER_POWER_RK808=y
CONFIG_DRIVER_INPUT_USB=y
CONFIG_DRIVER_SOUND_I2S=y
CONFIG_DRIVER_SOUND_MAX98090=y
CONFIG_DRIVER_SOUND_ROUTE=y
CONFIG_DRIVER_STORAGE_MMC=y
CONFIG_DRIVER_STORAGE_MMC_ROCKCHIP=y
CONFIG_DRIVER_TPM_SLB9635_I2C=y
CONFIG_DRIVER_VIDEO_ROCKCHIP=y
```
