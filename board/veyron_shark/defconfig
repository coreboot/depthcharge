## board/veyron_shark/defconfig
```kconfig
# Arch
CONFIG_ARCH_ARM=y

# Board
CONFIG_BOARD="veyron_shark"
CONFIG_BOARD_DIR="veyron_shark"

# Boot
CONFIG_ANDROID_DT_FIXUP=y

# Image
CONFIG_BASE_ADDRESS=0x43000000
CONFIG_FMAP_OFFSET=0x00100000
CONFIG_HEAP_SIZE=0x01000000
CONFIG_KERNEL_START=0x2000000
CONFIG_KERNEL_SIZE=0x8000000

# Vboot
CONFIG_EC_SOFTWARE_SYNC=y
CONFIG_VIRTUAL_DEV_SWITCH=y

CONFIG_CROSSYSTEM_FDT=y
CONFIG_NV_STORAGE_CROS_EC=y


#CONFIG_MOCK_TPM=y

# Kernel format
CONFIG_KERNEL_FIT=y
CONFIG_KERNEL_FIT_FDT_ADDR=0x6400000

# Drivers
CONFIG_DRIVER_GPIO_RK3288=y
CONFIG_DRIVER_BUS_I2C_ROCKCHIP=y
CONFIG_DRIVER_BUS_SPI_ROCKCHIP=y
CONFIG_DRIVER_BUS_I2S_ROCKCHIP=y
CONFIG_DRIVER_EC_CROS=y
CONFIG_DRIVER_EC_CROS_SPI=y
CONFIG_DRIVER_EC_CROS_SPI_WAKEUP_DELAY_US=100
CONFIG_DRIVER_FLASH_SPI=y
CONFIG_DRIVER_POWER_RK808=y
CONFIG_DRIVER_INPUT_MKBP=y
CONFIG_DRIVER_INPUT_MKBP_KEYMATRIX_STANDARD=y
CONFIG_DRIVER_INPUT_MKBP_OLD_COMMAND=y
CONFIG_DRIVER_INPUT_USB=y
CONFIG_DRIVER_SOUND_I2S=y
CONFIG_DRIVER_SOUND_MAX98090=y
CONFIG_DRIVER_SOUND_ROUTE=y
CONFIG_DRIVER_STORAGE_MMC=y
CONFIG_DRIVER_STORAGE_DWMMC_RK3288=y
CONFIG_DRIVER_TPM_SLB9635_I2C=y
CONFIG_DRIVER_VIDEO_RK3288=y

# Fastboot
CONFIG_FASTBOOT_MODE=y
CONFIG_FASTBOOT_USBVID=0x18d1
CONFIG_FASTBOOT_USBDID=0x4e30
CONFIG_FASTBOOT_EP_IN=8
CONFIG_FASTBOOT_EP_OUT=8
```

## board/volteer/defconfig
```kconfig
# Arch
CONFIG_ARCH_X86=y

# Board
CONFIG_BOARD_DIR="volteer"

# Image
CONFIG_HEAP_SIZE=0x02600000

# Vboot
CONFIG_TPM2_MODE=y
CONFIG_CROSSYSTEM_ACPI=y
CONFIG_TPM_DEBUG_EXTENSIONS=y
CONFIG_EC_VBOOT_SUPPORT=y
CONFIG_AUXFW_SOFTWARE_SYNC=y

# Kernel format
CONFIG_KERNEL_MULTIBOOT=y
CONFIG_KERNEL_MULTIBOOT_BOOTDATA=y
CONFIG_KERNEL_ZIMAGE=y

# Drivers
CONFIG_DRIVER_BUS_I2C_CROS_EC_TUNNEL=y
CONFIG_DRIVER_AHCI=y
CONFIG_DRIVER_BUS_SPI_INTEL_GSPI_VERSION_2=y
CONFIG_DRIVER_EC_CROS=y
CONFIG_DRIVER_EC_CROS_LPC=y
CONFIG_DRIVER_EC_PS8751=y
CONFIG_DRIVER_FLASH_MEMMAPPED=y
CONFIG_DRIVER_GPIO_TIGERLAKE=y
CONFIG_DRIVER_INPUT_PS2=y
CONFIG_DRIVER_POWER_PCH=y
CONFIG_DRIVER_SOC_TIGERLAKE=y
CONFIG_DRIVER_TPM_SPI=y
CONFIG_DRIVER_STORAGE_NVME=y
CONFIG_DRIVER_SDHCI=y
CONFIG_DRIVER_STORAGE_GENESYSLOGIC=y
CONFIG_DRIVER_STORAGE_MMC=y
CONFIG_DRIVER_STORAGE_SDHCI_PCI=y

# Audio
CONFIG_DRIVER_BUS_I2S_INTEL_COMMON_I2S=y
CONFIG_DRIVER_BUS_I2S_INTEL_COMMON_MAX98357A=y
CONFIG_DRIVER_SOUND_GPIO_AMP=y
CONFIG_DRIVER_SOUND_I2S=y
CONFIG_DRIVER_SOUND_ROUTE=y

# Auxfw
CONFIG_CROS_EC_PROBE_AUX_FW_INFO=y
```

## board/wilco/defconfig
```kconfig
# Arch
CONFIG_ARCH_X86=y

# Board
CONFIG_BOARD="wilco"

# Image
CONFIG_HEAP_SIZE=0x00600000

# Vboot
CONFIG_TPM2_MODE=y
CONFIG_VIRTUAL_DEV_SWITCH=y
CONFIG_CROSSYSTEM_ACPI=y
CONFIG_NV_STORAGE_CMOS=y

# Kernel format
CONFIG_KERNEL_MULTIBOOT=y
CONFIG_KERNEL_MULTIBOOT_BOOTDATA=y
CONFIG_KERNEL_ZIMAGE=y

# Drivers
CONFIG_DRIVER_AHCI=y
CONFIG_DRIVER_FLASH_MEMMAPPED=y
CONFIG_DRIVER_INPUT_PS2=y
CONFIG_DRIVER_INPUT_USB=y
CONFIG_DRIVER_POWER_PCH=y
CONFIG_DRIVER_SOC_SKYLAKE=y
CONFIG_DRIVER_STORAGE_NVME=y
CONFIG_DRIVER_TPM_LPC=y
```

## board/zork/defconfig
```kconfig
# Arch
CONFIG_ARCH_X86=y

# Board
CONFIG_BOARD_DIR="zork"

# Image
CONFIG_HEAP_SIZE=0x04000000

# Vboot
CONFIG_AUXFW_SOFTWARE_SYNC=y
CONFIG_EC_SOFTWARE_SYNC=y
CONFIG_EC_SLOW_UPDATE=y
CONFIG_TPM2_MODE=y
CONFIG_TPM_DEBUG_EXTENSIONS=y
CONFIG_NVDATA_CMOS=y
CONFIG_CROSSYSTEM_ACPI=y

# Kernel format
CONFIG_KERNEL_MULTIBOOT=y
CONFIG_KERNEL_MULTIBOOT_BOOTDATA=y
CONFIG_KERNEL_ZIMAGE=y

# Drivers
CONFIG_DRIVER_BUS_I2C_CROS_EC_TUNNEL=y
CONFIG_DRIVER_BUS_I2C_DESIGNWARE=y
CONFIG_DRIVER_EC_ANX3429=y
CONFIG_DRIVER_EC_CROS=y
CONFIG_DRIVER_EC_CROS_LPC=y
CONFIG_DRIVER_EC_PS8751=y
CONFIG_DRIVER_FLASH_MEMMAPPED=y
CONFIG_DRIVER_SOC_PICASSO=y
CONFIG_DRIVER_INPUT_PS2=y
CONFIG_DRIVER_POWER_FCH=y
CONFIG_DRIVER_SDHCI=y
CONFIG_DRIVER_SOUND_GPIO_I2S=y
CONFIG_DRIVER_SOUND_MAX98357A=y
CONFIG_DRIVER_SOUND_ROUTE=y
CONFIG_DRIVER_SOUND_RT1015=y
CONFIG_DRIVER_SOUND_RT5682=y
CONFIG_DRIVER_STORAGE_MMC=y
CONFIG_DRIVER_STORAGE_NVME=y
CONFIG_DRIVER_STORAGE_SDHCI_PCI=y
CONFIG_DRIVER_STORAGE_BAYHUB=y
CONFIG_DRIVER_TPM_CR50_I2C=y

# Picasso uses 32 MiB + ~2 MiB for coreboot so place the kernel at 64 MiB
CONFIG_KERNEL_START=0x4000000
```

## src/Kconfig
```kconfig
##
## Copyright 2012 Google Inc.  All rights reserved.
##
## This program is free software; you can redistribute it and/or modify
## it under the terms of the GNU General Public License as published by
## the Free Software Foundation; version 2 of the License.
##
## This program is distributed in the hope that it will be useful,
## but WITHOUT ANY WARRANTY; without even the implied warranty of
## MERCHANTABILITY or FITNESS FOR A PARTICULAR PURPOSE.  See the
## GNU General Public License for more details.

mainmenu "Depthcharge configuration"

choice
	prompt "Architecture"
	help
	  The architecture depthcharge will run on.

config ARCH_X86
	bool "X86"

config ARCH_ARM
	bool "ARM"
	select KERNEL_FIT

endchoice

choice
	prompt "ARM Version"
	depends on ARCH_ARM
	default ARCH_ARM_V7
	help
	  Version for ARM Arch

config ARCH_ARM_V7
	bool "ARMv7"

config ARCH_ARM_V8
	bool "ARMv8"

endchoice

source src/base/Kconfig
source src/board/Kconfig
source src/boot/Kconfig
source src/debug/Kconfig
source src/fastboot/Kconfig

menu "UIP network stack"
source src/net/Kconfig
endmenu

menu "Netboot"
source src/netboot/Kconfig
endmenu

menu "Image layout"
source src/image/Kconfig
endmenu

menu "Vboot"
source src/vboot/Kconfig
endmenu

menu "Drivers"
source src/drivers/Kconfig
endmenu
```

## src/base/Kconfig
```kconfig
##
## Copyright 2013 Google Inc.  All rights reserved.
##
## This program is free software; you can redistribute it and/or modify
## it under the terms of the GNU General Public License as published by
## the Free Software Foundation; version 2 of the License.
##
## This program is distributed in the hope that it will be useful,
## but WITHOUT ANY WARRANTY; without even the implied warranty of
## MERCHANTABILITY or FITNESS FOR A PARTICULAR PURPOSE.  See the
## GNU General Public License for more details.

config TIMESTAMP_RAW
	bool
	default ARCH_X86

config HEADLESS
       bool "Allow headless mode of operation"
       default n
       help
        "Set to 'y' for devices without display screens"
```

## src/board/Kconfig
```kconfig
##
## Copyright 2013 Google Inc.  All rights reserved.
##
## This program is free software; you can redistribute it and/or modify
## it under the terms of the GNU General Public License as published by
## the Free Software Foundation; version 2 of the License.
##
## This program is distributed in the hope that it will be useful,
## but WITHOUT ANY WARRANTY; without even the implied warranty of
## MERCHANTABILITY or FITNESS FOR A PARTICULAR PURPOSE.  See the
## GNU General Public License for more details.

menu "Board"

config BOARD_DIR
	string "Board directory"

if BOARD_DIR = "auron"
source src/board/auron/Kconfig
endif
if BOARD_DIR = "bayleybay"
source src/board/bayleybay/Kconfig
endif
if BOARD_DIR = "bolt"
source src/board/bolt/Kconfig
endif
if BOARD_DIR = "trogdor"
source src/board/trogdor/Kconfig
endif
if BOARD_DIR = "cheza"
source src/board/cheza/Kconfig
endif
if BOARD_DIR = "mistral"
source src/board/mistral/Kconfig
endif
if BOARD_DIR = "cyan"
source src/board/cyan/Kconfig
endif
if BOARD_DIR = "daisy"
source src/board/daisy/Kconfig
endif
if BOARD_DIR = "dedede"
source "src/board/dedede/Kconfig"
endif
if BOARD_DIR = "falco"
source src/board/falco/Kconfig
endif
if BOARD_DIR = "foster"
source src/board/foster/Kconfig
endif
if BOARD_DIR = "gizmo"
source src/board/gizmo/Kconfig
endif
if BOARD_DIR = "glados"
source src/board/glados/Kconfig
endif
if BOARD_DIR = "gru"
source src/board/gru/Kconfig
endif
if BOARD_DIR = "grunt"
source src/board/grunt/Kconfig
endif
if BOARD_DIR = "jecht"
source src/board/jecht/Kconfig
endif
if BOARD_DIR = "kukui"
source src/board/kukui/Kconfig
endif
if BOARD_DIR = "link"
source src/board/link/Kconfig
endif
if BOARD_DIR = "nyan"
source src/board/nyan/Kconfig
endif
if BOARD_DIR = "nyan_big"
source src/board/nyan_big/Kconfig
endif
if BOARD_DIR = "nyan_blaze"
source src/board/nyan_blaze/Kconfig
endif
if BOARD_DIR = "oak"
source src/board/oak/Kconfig
endif
if BOARD_DIR = "panther"
source src/board/panther/Kconfig
endif
if BOARD_DIR = "peach_pit"
source src/board/peach_pit/Kconfig
endif
if BOARD_DIR = "peppy"
source src/board/peppy/Kconfig
endif
if BOARD_DIR = "rambi"
source src/board/rambi/Kconfig
endif
if BOARD_DIR = "rush"
source src/board/rush/Kconfig
endif
if BOARD_DIR = "rush_ryu"
source src/board/rush_ryu/Kconfig
endif
if BOARD_DIR = "samus"
source src/board/samus/Kconfig
endif
if BOARD_DIR = "slippy"
source src/board/slippy/Kconfig
endif
if BOARD_DIR = "smaug"
source src/board/smaug/Kconfig
endif
if BOARD_DIR = "storm"
source src/board/storm/Kconfig
endif
if BOARD_DIR = "cyclone"
source src/board/cyclone/Kconfig
endif
if BOARD_DIR = "strago"
source src/board/strago/Kconfig
endif
if BOARD_DIR = "urara"
source src/board/urara/Kconfig
endif
if BOARD_DIR = "veyron"
source src/board/veyron/Kconfig
endif
if BOARD_DIR = "veyron_rialto"
source src/board/veyron_rialto/Kconfig
endif
if BOARD_DIR = "veyron_shark"
source src/board/veyron_shark/Kconfig
endif
if BOARD_DIR = "volteer"
source src/board/volteer/Kconfig
endif
endmenu
```

## src/board/adlrvp/Kconfig
```kconfig
##
## Copyright (C) 2020 Intel Corporation.
##
## This program is free software; you can redistribute it and/or modify
## it under the terms of the GNU General Public License as published by
## the Free Software Foundation; version 2 of the License.
##
## This program is distributed in the hope that it will be useful,
## but WITHOUT ANY WARRANTY; without even the implied warranty of
## MERCHANTABILITY or FITNESS FOR A PARTICULAR PURPOSE.  See the
## GNU General Public License for more details.

config ADLRVP_MAX98373_I2S_PORT
	int "Set the I2S port number"
	range 1 2
	default 1
	depends on DRIVER_SOUND_MAX98373
	help
	 This is the I2S port number routed to MAX98373.

config MAX98373_I2S_BOOTBEEP
	bool "Max98373 I2S Boot beep"
	select DRIVER_BUS_I2S_INTEL_COMMON_I2S
	select DRIVER_SOUND_I2S
	select DRIVER_SOUND_MAX98373
	select DRIVER_SOUND_ROUTE
	default n
```

## src/board/bluey/Kconfig
```kconfig
## SPDX-License-Identifier: GPL-2.0

config MAINBOARD_SKIP_CONT_SPLASH_REGION_UPDATE
	bool "Don't modify continuous splash node"
	default n
	help
	  Select this option to avoid updates to the continuous splash
	  screen region device tree node.
```

## src/board/dedede/Kconfig
```kconfig
##
## Copyright 2021 Google Inc.  All rights reserved.
##
## This program is free software; you can redistribute it and/or modify
## it under the terms of the GNU General Public License as published by
## the Free Software Foundation; version 2 of the License.
##
## This program is distributed in the hope that it will be useful,
## but WITHOUT ANY WARRANTY; without even the implied warranty of
## MERCHANTABILITY or FITNESS FOR A PARTICULAR PURPOSE.  See the
## GNU General Public License for more details.

config DEFAULT_AMP_SOURCE
	int "Default amplifier source identifier"
	default 1
	help
	  This configuration is used to specify the id of the default amplifier
	  used in the board. By default, MAX98360A amplifier is used.
```

## src/board/gru/Kconfig
```kconfig
##
## Copyright 2016 Rockchip Inc.  All rights reserved.
##
## This program is free software; you can redistribute it and/or modify
## it under the terms of the GNU General Public License as published by
## the Free Software Foundation; version 2 of the License.
##
## This program is distributed in the hope that it will be useful,
## but WITHOUT ANY WARRANTY; without even the implied warranty of
## MERCHANTABILITY or FITNESS FOR A PARTICULAR PURPOSE.  See the
## GNU General Public License for more details.
##

config GRU_USB2_BOOT_REQUIRED
        bool "Enable USB2 boot for a Gru derivative"
        default false
	help
	  Set this to true if this board requires booting off USB2 interface(s).
config GRU_SPEAKER_VOLUME
	int "Set speaker volume as other value if the board needs"
	default 16000

config GRU_SCARLET
	bool "Scarlet-based variant"
	default false
	help
	  Scarlet is an RK3399-based board but contains many board-specific
	  departures in terms of components and pinout. This option is for
	  Scarlet and other boards derived from it.
```

## src/board/grunt/Kconfig
```kconfig
## This program is free software; you can redistribute it and/or modify
## it under the terms of the GNU General Public License as published by
## the Free Software Foundation; version 2 of the License.
##
## This program is distributed in the hope that it will be useful,
## but WITHOUT ANY WARRANTY; without even the implied warranty of
## MERCHANTABILITY or FITNESS FOR A PARTICULAR PURPOSE.  See the
## GNU General Public License for more details.

config FORCE_BH720_SDHCI
	bool "Force using BH720 for SDHCI"
	default false
	help
	  Ensures that the correct device is used for the SD Host Controller
	  Interface is used for boards that don't have strapping pins set
	  appropriately.
```

## src/board/kukui/Kconfig
```kconfig
##
## Copyright 2018 Google Inc.  All rights reserved.
##
## This program is free software; you can redistribute it and/or modify
## it under the terms of the GNU General Public License as published by
## the Free Software Foundation; version 2 of the License.
##
## This program is distributed in the hope that it will be useful,
## but WITHOUT ANY WARRANTY; without even the implied warranty of
## MERCHANTABILITY or FITNESS FOR A PARTICULAR PURPOSE.  See the
## GNU General Public License for more details.

config BOARD_KUKUI
	bool "Kukui"
	default false
	help
	  Setting this option to enable board specific options for Kukui.

config BOARD_FLAPJACK
	bool "Flapjack"
	default false
	help
	  Flapjack is derivative board from Kukui. Setting this option to
	  enable board specific options.
```

## src/board/oak/Kconfig
```kconfig
##
## Copyright 2013 Google Inc.  All rights reserved.
##
## This program is free software; you can redistribute it and/or modify
## it under the terms of the GNU General Public License as published by
## the Free Software Foundation; version 2 of the License.
##
## This program is distributed in the hope that it will be useful,
## but WITHOUT ANY WARRANTY; without even the implied warranty of
## MERCHANTABILITY or FITNESS FOR A PARTICULAR PURPOSE.  See the
## GNU General Public License for more details.

# All Oak-derivatives count their board IDs as 0 being equivalent to Oak rev6.
config BOARD_ID_ADJUSTMENT
	int "Amount to add to the board ID to get an equivalent Oak ID."
	default 7
```
