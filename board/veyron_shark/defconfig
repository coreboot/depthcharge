## src/board/shadowmountain/Kconfig
```kconfig
##
## Copyright 2020 Google Inc.  All rights reserved.
##
## This program is free software; you can redistribute it and/or modify
## it under the terms of the GNU General Public License as published by
## the Free Software Foundation; version 2 of the License.
##
## This program is distributed in the hope that it will be useful,
## but WITHOUT ANY WARRANTY; without even the implied warranty of
## MERCHANTABILITY or FITNESS FOR A PARTICULAR PURPOSE.  See the
## GNU General Public License for more details.

config SHADOWMOUNTAIN_MAX98373_I2S_PORT
	int "Set the I2S port number"
	range 1 2
	default 1
	depends on DRIVER_SOUND_MAX98373
	help
	  This is the I2S port number routed to MAX98373.

config SHADOWMOUNTAIN_USBC_PORT_0_USB3_NUM
	int
	range 0 3
	default 0
	help
	  This is the SoC TCP port number routed to Type-C port C0.

config SHADOWMOUNTAIN_USBC_PORT_0_USB2_NUM
	int
	range 1 10
	default 9
	help
	  This is the SoC USB2 port number routed to Type-C port C0.
	  Default of 9 holds true for:
	    shadowmountain

config SHADOWMOUNTAIN_USBC_PORT_1_USB3_NUM
	int
	range 0 3
	default 1
	help
	  This is the SoC TCP port number routed to Type-C port C1.

config SHADOWMOUNTAIN_USBC_PORT_1_USB2_NUM
	int
	range 1 10
	default 4
	help
	  This is the SoC USB2 port number routed to Type-C port C1.
	  Default of 4 holds true for:
	    shadowmountain

config MAX98373_I2S_BOOTBEEP
	bool "Max98373 I2S Boot beep"
	select DRIVER_BUS_I2S_INTEL_COMMON_I2S
	select DRIVER_SOUND_I2S
	select DRIVER_SOUND_MAX98373
	select DRIVER_SOUND_ROUTE
	default n
```

## src/board/volteer/Kconfig
```kconfig
##
## Copyright 2020 Google Inc.  All rights reserved.
##
## This program is free software; you can redistribute it and/or modify
## it under the terms of the GNU General Public License as published by
## the Free Software Foundation; version 2 of the License.
##
## This program is distributed in the hope that it will be useful,
## but WITHOUT ANY WARRANTY; without even the implied warranty of
## MERCHANTABILITY or FITNESS FOR A PARTICULAR PURPOSE.  See the
## GNU General Public License for more details.

config VOLTEER_MAX98373_I2S_PORT
	int "Set the I2S port number"
	range 1 2
	default 1
	depends on DRIVER_SOUND_MAX98373
	help
	  This is the I2S port number routed to MAX98373.

config VOLTEER_USBC_PORT_0_USB3_NUM
	int
	range 0 3
	default 0
	help
	  This is the SoC TCP port number routed to Type-C port C0.

config VOLTEER_USBC_PORT_0_USB2_NUM
	int "Set the USBC port 0 USB2 number"
	range 1 10
	default 9
	help
	  This is the SoC USB2 port number routed to Type-C port C0.
	  Default of 9 holds true for:
	    malefor
	    volteer
	    trondo
	    voxel

config VOLTEER_USBC_PORT_1_USB3_NUM
	int
	range 0 3
	default 1
	help
	  This is the SoC TCP port number routed to Type-C port C1.

config VOLTEER_USBC_PORT_1_USB2_NUM
	int "Set the USBC port 1 USB2 number"
	range 1 10
	default 4
	help
	  This is the SoC USB2 port number routed to Type-C port C1.
	  Default of 4 holds true for:
	    malefor
	    volteer
	    trondo
	    voxel

config MAX98373_I2S_BOOTBEEP
	bool "Max98373 I2S Boot beep"
	select DRIVER_BUS_I2S_INTEL_COMMON_I2S
	select DRIVER_SOUND_I2S
	select DRIVER_SOUND_MAX98373
	select DRIVER_SOUND_ROUTE
	default n
```

## src/boot/Kconfig
```kconfig
##
## Copyright 2013 Google LLC
##
## This program is free software; you can redistribute it and/or modify
## it under the terms of the GNU General Public License as published by
## the Free Software Foundation; version 2 of the License.
##
## This program is distributed in the hope that it will be useful,
## but WITHOUT ANY WARRANTY; without even the implied warranty of
## MERCHANTABILITY or FITNESS FOR A PARTICULAR PURPOSE.  See the
## GNU General Public License for more details.

choice
	prompt "Kernel format"
	default KERNEL_DUMMY
	help
	  The format the kernel is stored in on disk.

	config KERNEL_ZIMAGE
	bool "zimage"
	depends on ARCH_X86

	config KERNEL_FIT
	bool "FIT"

	config KERNEL_DUMMY
	bool "dummy"
endchoice

config KERNEL_LEGACY
	bool "Allow alternative(legacy) kernels"
	default n

config KERNEL_MULTIBOOT
	bool "Allow alternative(multiboot) kernels"
	default n

config KERNEL_MULTIBOOT_ZBI
	bool "Allow alternative(multiboot-wrapped zbi) kernels"
	default n

config MACHID
	hex "Machine ID to pass to the kernel"
	depends on KERNEL_LEGACY
	default 0x0
	help
	  On some platforms this value could be discovered at run time.

config ATAG_BASE
	hex "Address in DRAM where to place ATAGs"
	depends on KERNEL_LEGACY
	depends on ARCH_ARM
	default 0x0

config ARM64_SKIP_PHYS_KASLR
	bool "Skip kernel physical address randomization"
	depends on ARCH_ARM_V8
	default n
	help
	  Disable kernel physical address randomization (KASLR) in the
	  bootloader. By default, Depthcharge will select a random
	  2MiB-aligned memory slot for the kernel using a seed from the TPM.
	  Enabling this will force the kernel to be loaded at the first
	  available valid physical address (Slot 0). This is safer than the
	  legacy method as it always respects reserved memory regions.

config KERNEL_FDT_ADDR
	hex "Device tree load address."
	default 0x0
	help
	  Where to put the updated device tree when booting the kernel. The
	  area reserved by this is 8MB.

	  ==== Placement guide (also see kernel/Documentation/<arch>/boot*) ====
	  arm32: Somewhere between 128MB and 512MB from the start of RAM. Do not
	  overlap DMA_COHERENT area (from coreboot memlayout)!
	  arm64: Within the first 512MB of RAM, but as far away from the start
	  of RAM as possible (i.e. ideally at 504MB).

config BOOTCONFIG
	bool "Support for bootconfig"
	default n
	help
	  Enable support for bootconfig feature which is another way to provide
	  key=value parameters to the kernel besides commandline.

config ANDROID_PVMFW
	bool "Support for loading pvmfw into memory"
	default n
	select CLEAR_DATA
	help
	  Enables loading pvmfw from AVB partition into memory and providing
	  location and size information to Linux kernel.

	  This option can be temporarily disabled for bring up purposes.

config CLEAR_DATA
	bool "Clear potentially sensitive data before jump to kernel"
	default n
	help
	  Enable clearing .data, .bss, .stack sections and DMA heap before jumping
	  to the kernel.

config ANDROID_PKVM_DRNG_SEED
	bool "Support for preparing seed for pKVM Deterministric TRNG"
	default y
	depends on ARCH_ARM
	depends on ANDROID_PVMFW
	help
	  Enables preparation of initial seed for pKVM Deterministric TRNG
	  implementation. The seed is generated using TPM GetRandom and stored
	  in system memory.
	  This option can be temporarily disabled for bring up purposes.

config ANDROID_MTE
	bool "MTE bootloader support"
	depends on ARCH_ARM_V8
	default n
	help
	  By enabling this option, depthcharge reads MTE control values from the
	  the kernel command line and misc partition and sets the relevant
	  kernel cmdline accordingly.
```

## src/debug/cli/Kconfig
```kconfig
##
## Copyright 2014 Google Inc.  All rights reserved.
##
## This program is free software; you can redistribute it and/or modify
## it under the terms of the GNU General Public License as published by
## the Free Software Foundation; version 2 of the License.
##
## This program is distributed in the hope that it will be useful,
## but WITHOUT ANY WARRANTY; without even the implied warranty of
## MERCHANTABILITY or FITNESS FOR A PARTICULAR PURPOSE.  See the
## GNU General Public License for more details.

config CLI
	bool "Command line interface"
	default n
	help
	  Enable this to have depthcharge stop at the command line prompt
	  instead of directly booting the OS.

config SYS_PROMPT
	string "Console prompt"
	default "dpch: "
	depends on CLI
```

## src/drivers/Kconfig
```kconfig
##
## Copyright 2013 Google Inc.  All rights reserved.
##
## This program is free software; you can redistribute it and/or modify
## it under the terms of the GNU General Public License as published by
## the Free Software Foundation; version 2 of the License.
##
## This program is distributed in the hope that it will be useful,
## but WITHOUT ANY WARRANTY; without even the implied warranty of
## MERCHANTABILITY or FITNESS FOR A PARTICULAR PURPOSE.  See the
## GNU General Public License for more details.

source src/drivers/bus/Kconfig
source src/drivers/dma/Kconfig
source src/drivers/ec/anx3429/Kconfig
source src/drivers/ec/anx7688/Kconfig
source src/drivers/ec/ps8751/Kconfig
source src/drivers/ec/cros/Kconfig
source src/drivers/ec/wilco/Kconfig
source src/drivers/flash/Kconfig
source src/drivers/gpio/Kconfig
source src/drivers/input/Kconfig
source src/drivers/net/Kconfig
source src/drivers/power/Kconfig
source src/drivers/soc/Kconfig
source src/drivers/sound/Kconfig
source src/drivers/storage/Kconfig
source src/drivers/tpm/Kconfig
source src/drivers/video/Kconfig
```

## src/drivers/bus/Kconfig
```kconfig
##
## Copyright 2013 Google Inc.  All rights reserved.
##
## This program is free software; you can redistribute it and/or modify
## it under the terms of the GNU General Public License as published by
## the Free Software Foundation; version 2 of the License.
##
## This program is distributed in the hope that it will be useful,
## but WITHOUT ANY WARRANTY; without even the implied warranty of
## MERCHANTABILITY or FITNESS FOR A PARTICULAR PURPOSE.  See the
## GNU General Public License for more details.

source src/drivers/bus/i2c/Kconfig
source src/drivers/bus/i2s/Kconfig
source src/drivers/bus/spi/Kconfig
source src/drivers/bus/usb/Kconfig
source src/drivers/bus/soundwire/Kconfig
```

## src/drivers/bus/i2c/Kconfig
```kconfig
##
## Copyright 2013-2025 Google LLC
##
## This program is free software; you can redistribute it and/or modify
## it under the terms of the GNU General Public License as published by
## the Free Software Foundation; version 2 of the License.
##
## This program is distributed in the hope that it will be useful,
## but WITHOUT ANY WARRANTY; without even the implied warranty of
## MERCHANTABILITY or FITNESS FOR A PARTICULAR PURPOSE.  See the
## GNU General Public License for more details.

config DRIVER_BUS_I2C_S3C24X0
	bool "Exynos S3C24X0 I2C driver"
	default n

config DRIVER_BUS_I2C_EXYNOS5_USI
	bool "Exynos USI based I2C driver"
	default n

config DRIVER_BUS_I2C_TEGRA
	bool "Tegra I2C driver"
	default n

config DRIVER_BUS_I2C_DESIGNWARE
	bool "Designware I2C driver"
	default n

config DRIVER_BUS_I2C_DESIGNWARE_PCI
	bool "Designware I2C driver for PCI device"
	default n

config DRIVER_BUS_I2C_IPQ806X
	bool "Qualcomm IPQ806x I2C driver"
	default n

config DRIVER_BUS_I2C_IPQ40XX
	bool "QCA IPQ40xx I2C driver"
	default n

config DRIVER_BUS_I2C_QCS405
	bool "QCS405 I2C driver"
	default n

config DRIVER_BUS_I2C_ROCKCHIP
	bool "Rockchip I2C driver"

config DRIVER_BUS_I2C_MT8173
	bool "MediaTek MT8173 I2C driver"
	default n

config DRIVER_BUS_I2C_MT8183
	bool "MediaTek MT8183 I2C driver"
	default n

config DRIVER_BUS_I2C_MT8186
	bool "MediaTek MT8186 I2C driver"
	default n

config DRIVER_BUS_I2C_MT8188
	bool "MediaTek MT8188 I2C driver"
	default n

config DRIVER_BUS_I2C_MT8189
	bool "MediaTek MT8189 I2C driver"
	default n

config DRIVER_BUS_I2C_MT8196
	bool "MediaTek MT8196 I2C driver"
	default n

config DRIVER_BUS_I2C_CYGNUS
	bool "Cygnus I2C driver"
	default n

config DRIVER_BUS_I2C_ARMADA38X
	bool "Marvell Armada38x I2C driver"
	default n

config DRIVER_BUS_I2C_CROS_EC_TUNNEL
	bool "Chrome OS EC tunnel I2C driver"
	depends on DRIVER_EC_CROS
	default n

config DRIVER_BUS_I2C_QCOM_QUP
	bool "Qualcomm QUP I2C driver"
	default n

config DRIVER_BUS_I2C_TRANSFER_TIMEOUT_US
	int "I2C transfer timeout in microseconds"
	default 500000
	help
	  Timeout for a read/write transfers on the I2C bus, that is, the
	  maximum time a device could stretch clock bits before the transfer
	  is aborted and an error returned.
```

## src/drivers/bus/i2s/Kconfig
```kconfig
##
## Copyright 2013 Google Inc.  All rights reserved.
##
## This program is free software; you can redistribute it and/or modify
## it under the terms of the GNU General Public License as published by
## the Free Software Foundation; version 2 of the License.
##
## This program is distributed in the hope that it will be useful,
## but WITHOUT ANY WARRANTY; without even the implied warranty of
## MERCHANTABILITY or FITNESS FOR A PARTICULAR PURPOSE.  See the
## GNU General Public License for more details.

config DRIVER_BUS_I2S_EXYNOS5
	bool "Exynos5 I2S driver"
	default n

config DRIVER_BUS_I2S_MTK
	bool "MediaTek I2S driver"
	default n

config DRIVER_BUS_I2S_TEGRA
	bool "Tegra I2S driver"
	default n

config DRIVER_BUS_I2S_ROCKCHIP
	bool "Rockchip I2S driver"
	default n

config DRIVER_BUS_I2S_SC7180
	bool "SC7180 I2S driver"
	default n

source "src/drivers/bus/i2s/baytrail/Kconfig"
source "src/drivers/bus/i2s/broadwell/Kconfig"
source "src/drivers/bus/i2s/braswell/Kconfig"
source "src/drivers/bus/i2s/intel_common/Kconfig"
```

## src/drivers/bus/i2s/braswell/Kconfig
```kconfig
##
## Copyright 2015 Google Inc.  All rights reserved.
##
## This program is free software; you can redistribute it and/or modify
## it under the terms of the GNU General Public License as published by
## the Free Software Foundation; version 2 of the License.
##
## This program is distributed in the hope that it will be useful,
## but WITHOUT ANY WARRANTY; without even the implied warranty of
## MERCHANTABILITY or FITNESS FOR A PARTICULAR PURPOSE.  See the
## GNU General Public License for more details.

config DRIVER_BUS_I2S_BRASWELL
	bool "Braswell I2S driver"
	default n

config DRIVER_BUS_I2S_BRASWELL_MAX98090
	bool "Braswell/MAX98090 I2S driver"
	depends on DRIVER_BUS_I2S_BRASWELL
	default n
```

## src/drivers/bus/i2s/broadwell/Kconfig
```kconfig
##
## Copyright 2015 Google Inc.  All rights reserved.
##
## This program is free software; you can redistribute it and/or modify
## it under the terms of the GNU General Public License as published by
## the Free Software Foundation; version 2 of the License.
##
## This program is distributed in the hope that it will be useful,
## but WITHOUT ANY WARRANTY; without even the implied warranty of
## MERCHANTABILITY or FITNESS FOR A PARTICULAR PURPOSE.  See the
## GNU General Public License for more details.

config DRIVER_BUS_I2S_BROADWELL
	bool "Broadwell I2S driver"
	default n

config DRIVER_BUS_I2S_BROADWELL_ALC5677
	bool "Broadwell I2S configuration for ALC5677 Codec"
	depends on DRIVER_BUS_I2S_BROADWELL
	default n
```

## src/drivers/bus/i2s/intel_common/Kconfig
```kconfig
##
## Copyright (c) 2019, Intel Corporation.
## Copyright 2019 Google Inc.  All rights reserved.
##
## This program is free software; you can redistribute it and/or modify
## it under the terms of the GNU General Public License as published by
## the Free Software Foundation; version 2 of the License.
##
## This program is distributed in the hope that it will be useful,
## but WITHOUT ANY WARRANTY; without even the implied warranty of
## MERCHANTABILITY or FITNESS FOR A PARTICULAR PURPOSE.  See the
## GNU General Public License for more details.

config DRIVER_BUS_I2S_INTEL_COMMON_I2S
	bool "Common I2S driver for Intel platforms"
	default n

config DRIVER_BUS_I2S_INTEL_COMMON_MAX98357A
	bool "Common Max98357a I2S driver"
	depends on DRIVER_BUS_I2S_INTEL_COMMON_I2S
	default n

config INTEL_COMMON_I2S_CAVS_1_8
	bool "Intel cAVS1.8 specification"
	default n

config INTEL_COMMON_I2S_CAVS_1_5
	bool "Intel cAVS1.5 specification"
	default n

config INTEL_COMMON_I2S_CAVS_2_0
        bool "Intel cAVS2.0 specification"
        default n

config INTEL_COMMON_I2S_CAVS_2_5
        bool "Intel cAVS2.5 specification"
        default n
```
