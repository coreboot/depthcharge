## src/drivers/soc/cse/Kconfig
```kconfig
config DRIVER_SOC_INTEL_CSE
	bool "Intel CSE driver"
	default n
	help
	  Driver for communication with Converged Security Engine (CSE)
	  over Host Embedded Controller Interface (HECI).

if DRIVER_SOC_INTEL_CSE
config SOC_INTEL_CSE_DISABLE_HECI1_AT_PRE_BOOT
	bool "Disable HECI1 at the end of boot"
	help
	  This config decides the state of HECI1(CSE) device at the end of boot.
	  Mainboard users to select this config to make HECI1 `function disable`
	  prior to handing off to payload.

config SOC_INTEL_CSE_HECI1_DISABLE_USING_PMC_IPC
	bool "Disable HECI1 using PMC IPC"
	select DRIVER_SOC_INTEL_PMC
	help
	  Use this config to allow common CSE block to make HECI1 function disable
	  using PMC IPC command `0xA9`. From TGL PCH onwards, disabling heci1
	  device using PMC IPC doesn't required to run the operation in SMM.

config SOC_INTEL_STORE_ISH_FW_VERSION
	bool "Retrieve ISH Version from CSE FPT"
	default n
	depends on SOC_INTEL_CSE_LITE_SKU
	help
	  This configuration option stores ISH version in CBMEM area.
	  This information can be used to identify the currently running ISH firmware
	  version.

	  ISH BUP is sitting inside the CSE firmware partition. The way to retrieve the
	  ISH version is by sending the HECI command to read the CSE FPT. The cost of sending
	  HECI command to read the CSE FPT is significant (~200ms) hence, the idea is to
	  read the CSE RW version on every cold reset (to cover the CSE update scenarios)
	  and store into CBMEM to avoid the cost of resending the HECI command in all
	  consecutive warm boots.

	  Later boot stages can just read the CBMEM ID to retrieve the ISH version.

	  Additionally, ensure this feature is platform specific hence, only enabled
	  for the platform that would like to store the ISH version into the CBMEM and
	  parse to perform some additional work.

config SOC_INTEL_CSE_FW_PARTITION_CMOS_OFFSET
	int "CMOS offset to store CSE FW info"
	default 68
	depends on SOC_INTEL_CSE_LITE_SKU
	help
	  This configuration option stores the starting offset of cse fw partition versions in
	  CMOS memory. The offset should be byte aligned and must leave enough memory to store
	  required firmware partition versions.

config SOC_INTEL_CSE_SEND_EOP_BY_PAYLOAD
	bool "Send End-Of-Post (EOP)"
	help
	  Use this config to send End Of Post (EOP) using payload.

config SOC_INTEL_CSE_LITE_SKU
	bool "CSE Lite SKU"
	help
	 Enables CSE Lite SKU

config SOC_INTEL_CSE_RW_UPDATE
	bool "Enable the CSE RW Update Feature"
	default n
	depends on SOC_INTEL_CSE_LITE_SKU
	help
	 This config will enable CSE RW firmware update feature and also will be used ensure
	 all the required configs are provided by mainboard.

config SOC_INTEL_CSE_LITE_PSR
	bool "Intel CSE Platform Service Record"
	default n
	depends on SOC_INTEL_CSE_LITE_SKU
	help
	 Select this config if Platform Service Record(PSR) is supported by the platform. This
	 config is applicable only for Lite SKU, where PSR data backup is required prior to a
	 CSE firmware downgrade during which CSE data is cleared. PSR services in CSE FW is
	 enabled only post DRAM init and the command to backup PSR data is also supported only
	 post DRAM init. Hence platform that selects PSR would need to perform CSE firmware sync
	 in ramstage.

config SOC_INTEL_CSE_LITE_SYNC_BY_PAYLOAD
	bool "Sync CSE RW Partition"
	depends on SOC_INTEL_CSE_LITE_SKU
	select SOC_INTEL_CSE_RW_UPDATE
	help
	 Use this option if CSE RW update needs to be triggered during payload.

config SOC_INTEL_CSE_SUB_PART_UPDATE
	bool "Enable the CSE sub-partition update Feature"
	default n
	depends on SOC_INTEL_CSE_LITE_SKU
	help
	 This config will enable CSE sub-partition firmware update feature and also will be used to
	 ensure all the required configs are provided by mainboard.

config SOC_INTEL_CSE_PRE_CPU_RESET_TELEMETRY
	bool "Intel CSE telemetry"
	default n
	depends on SOC_INTEL_CSE_LITE_SKU
	help
	  Mainboard user to select this Kconfig in order to capture pre-cpu
	  reset boot performance telemetry data.

config SOC_INTEL_CSE_PRE_CPU_RESET_TELEMETRY_V1
	bool "Intel CSE telemetry version 1"
	select SOC_INTEL_CSE_PRE_CPU_RESET_TELEMETRY
	depends on SOC_INTEL_CSE_LITE_SKU
	help
	  This config will make mainboard use version 1 of the CSE timestamp
	  definitions, it can be used for Alder Lake and Raptor Lake (all SKUs).

config SOC_INTEL_CSE_PRE_CPU_RESET_TELEMETRY_V2
	bool "Intel CSE telemetry version 2"
	select SOC_INTEL_CSE_PRE_CPU_RESET_TELEMETRY
	depends on SOC_INTEL_CSE_LITE_SKU
	help
	  This config will make mainboard use version 2 of the CSE timestamp
	  definitions, it can be used for Meteor Lake M/P onwards.

config SOC_INTEL_COMMON_BLOCK_ME_SPEC_12
	bool "Intel ME spec 12"
	help
	  This config will enable 'ME specification version 12'. It will ensure ME specific
	  declaration and uses of required data structures for Host firmware status registers.

config SOC_INTEL_COMMON_BLOCK_ME_SPEC_13
	bool "Intel ME spec 13"
	help
	  This config will enable 'ME specification version 13'. It will ensure ME specific
	  declaration and uses of required data structures for Host firmware status registers.

config SOC_INTEL_COMMON_BLOCK_ME_SPEC_15
	bool "Intel ME spec 15"
	help
	  This config will enable 'ME specification version 15'. It will ensure ME specific
	  declaration and uses of required data structures for Host firmware status registers.

config SOC_INTEL_COMMON_BLOCK_ME_SPEC_16
	bool "Intel ME spec 16"
	help
	  This config will enable 'ME specification version 16'. It will ensure ME specific
	  declaration and uses of required data structures for Host firmware status registers.

config SOC_INTEL_COMMON_BLOCK_ME_SPEC_18
	bool "Intel ME spec 18"
	help
	  This config will enable 'ME specification version 18'. It will ensure ME specific
	  declaration and uses of required data structures for Host firmware status registers.

config SOC_INTEL_COMMON_BLOCK_ME_SPEC_21
	bool "Intel ME spec 21"
	help
	  This config will enable 'ME specification version 21'. It will ensure ME specific
	  declaration and uses of required data structures for Host firmware status registers.
	  This version of ME is compatible with ME version 18 in terms of Host firmware
	  status registers.

config ME_SPEC
	int
	default 12 if SOC_INTEL_COMMON_BLOCK_ME_SPEC_12
	default 13 if SOC_INTEL_COMMON_BLOCK_ME_SPEC_13
	default 15 if SOC_INTEL_COMMON_BLOCK_ME_SPEC_15
	default 16 if SOC_INTEL_COMMON_BLOCK_ME_SPEC_16
	default 18 if SOC_INTEL_COMMON_BLOCK_ME_SPEC_18 || SOC_INTEL_COMMON_BLOCK_ME_SPEC_21
	help
	  This config holds the ME spec version if defined.

config MAX_HECI_DEVICES
	int "Maximum number of HECI devices"
	default 3

endif
```

## src/drivers/soc/pmic/Kconfig
```kconfig
## SPDX-License-Identifier: GPL-2.0-only OR MIT

config DRIVER_SOC_MTK_PMIF
	bool "MediaTek PMIF (PMIC Arbiter Interface) driver"
	default n
```
