## src/drivers/hid/Kconfig
```kconfig
##
## Copyright 2016 Google Inc.
##
## This program is free software; you can redistribute it and/or
## modify it under the terms of the GNU General Public License as
## published by the Free Software Foundation; either version 2 of
## the License, or (at your option) any later version.
##
## This program is distributed in the hope that it will be useful,
## but WITHOUT ANY WARRANTY; without even the implied warranty of
## MERCHANTABILITY or FITNESS FOR A PARTICULAR PURPOSE.	 See the
## GNU General Public License for more details.

config DRIVER_HID_I2C
	bool "HID over I2C driver"
	default n
	help
	  HID over I2C driver

config DRIVER_HID_VIRTUAL_KEYBOARD
	bool "HID virtual keyboard"
	default n
	help
	  HID virtual keyboard support

config DRIVER_HID_VKB_KEY_DELAY_MS
	int "VKB key delay in ms"
	default 200
	help
	  VKB key delay in ms
```

## src/drivers/input/Kconfig
```kconfig
##
## Copyright 2013 Google Inc.  All rights reserved.
##
## This program is free software; you can redistribute it and/or modify
## it under the terms of the GNU General Public License as published by
## the Free Software Foundation; version 2 of the License.
##
## This program is distributed in the hope that it will be useful,
## but WITHOUT ANY WARRANTY; without even the implied warranty of
## MERCHANTABILITY or FITNESS FOR A PARTICULAR PURPOSE.  See the
## GNU General Public License for more details.

config DRIVER_INPUT_PS2
	bool "PS2 keyboard"
	default n
	help
	  Keyboard input through an i8042/PS2 keyboard controller as found on
	  traditional PCs. The actual support is provided by libpayload, this
	  just makes it an input source as far as depthcharge is concerned.

config DRIVER_INPUT_MKBP
	bool "ChromeOS EC based keyboard"
	default n
	help
	  A simplified keymatrix keyboard implemented with the ChromeOS EC.

config DRIVER_INPUT_PSEUDO
	bool "ChromeOS Pseudo keyboard"
	default n
	help
	  A pseudo keyboard driver for embedded systems with other forms of input.

source src/drivers/input/mkbp/Kconfig
```

## src/drivers/input/mkbp/Kconfig
```kconfig
##
## Copyright 2013 Google Inc.  All rights reserved.
##
## This program is free software; you can redistribute it and/or modify
## it under the terms of the GNU General Public License as published by
## the Free Software Foundation; version 2 of the License.
##
## This program is distributed in the hope that it will be useful,
## but WITHOUT ANY WARRANTY; without even the implied warranty of
## MERCHANTABILITY or FITNESS FOR A PARTICULAR PURPOSE.  See the
## GNU General Public License for more details.

config DRIVER_INPUT_MKBP_OLD_COMMAND
       bool "Old method of retrieving keyscans via the ChromeOS EC MKBP."
       default n
       help
         In older ChromeOS EC images, the MKBP FIFO only contains key matrix
         changes.  Therefore, retrieving the MKBP state will always be a key
         matrix and the EC_CMD_MKBP_STATE host command is supported.  This is
         not the case for newer EC images.

source "src/drivers/input/mkbp/keymatrix/Kconfig"
source "src/drivers/input/mkbp/layout/Kconfig"
```

## src/drivers/input/mkbp/keymatrix/Kconfig
```kconfig
##
## Copyright 2013 Google Inc.  All rights reserved.
##
## This program is free software; you can redistribute it and/or modify
## it under the terms of the GNU General Public License as published by
## the Free Software Foundation; version 2 of the License.
##
## This program is distributed in the hope that it will be useful,
## but WITHOUT ANY WARRANTY; without even the implied warranty of
## MERCHANTABILITY or FITNESS FOR A PARTICULAR PURPOSE.  See the
## GNU General Public License for more details.

choice
	prompt "MKBP keymatrix"
	depends on DRIVER_INPUT_MKBP
	help
	  Maps the keymatrix expressed in columns and rows into scancodes.

config DRIVER_INPUT_MKBP_KEYMATRIX_STANDARD
	bool "Standard ChromeOS"

endchoice
```

## src/drivers/input/mkbp/layout/Kconfig
```kconfig
##
## Copyright 2013 Google Inc.  All rights reserved.
##
## This program is free software; you can redistribute it and/or modify
## it under the terms of the GNU General Public License as published by
## the Free Software Foundation; version 2 of the License.
##
## This program is distributed in the hope that it will be useful,
## but WITHOUT ANY WARRANTY; without even the implied warranty of
## MERCHANTABILITY or FITNESS FOR A PARTICULAR PURPOSE.  See the
## GNU General Public License for more details.

choice
	prompt "MKBP keyboard layout"
	depends on DRIVER_INPUT_MKBP
	default DRIVER_INPUT_MKBP_LAYOUT_US
	help
	  Maps scancodes into ASCII values.

config DRIVER_INPUT_MKBP_LAYOUT_US
	bool "US"

config DRIVER_INPUT_MKBP_LAYOUT_DE
	bool "DE"

endchoice
```

## src/drivers/net/Kconfig
```kconfig
##
## Copyright 2013 Google Inc.  All rights reserved.
##
## This program is free software; you can redistribute it and/or modify
## it under the terms of the GNU General Public License as published by
## the Free Software Foundation; version 2 of the License.
##
## This program is distributed in the hope that it will be useful,
## but WITHOUT ANY WARRANTY; without even the implied warranty of
## MERCHANTABILITY or FITNESS FOR A PARTICULAR PURPOSE.  See the
## GNU General Public License for more details.

config DRIVER_NET_ASIX
	bool "ASIX USB network dongle"
	default n

config DRIVER_NET_IPQ806X
	bool "IPQ806x ethernet controller"
	default n
```

## src/drivers/power/Kconfig
```kconfig
##
## Copyright 2013 Google Inc.  All rights reserved.
##
## This program is free software; you can redistribute it and/or modify
## it under the terms of the GNU General Public License as published by
## the Free Software Foundation; version 2 of the License.
##
## This program is distributed in the hope that it will be useful,
## but WITHOUT ANY WARRANTY; without even the implied warranty of
## MERCHANTABILITY or FITNESS FOR A PARTICULAR PURPOSE.  See the
## GNU General Public License for more details.

config DRIVER_POWER_AS3722
	bool "AS3722 PMIC power management"
	default n
	help
	  Reboot or power off using the AS3722 PMIC.

config DRIVER_POWER_EXYNOS
	bool "Exynos SOC power management"
	default n
	depends on ARCH_ARM
	help
	  Reboot or power off using registers in an Exynos SOC.

config DRIVER_POWER_PCH
	bool "Intel chipset power management"
	default n
	depends on ARCH_X86
	help
	  Reboot or power off using registers in the Intel chipset.

config DRIVER_POWER_FCH
	bool "AMD chipset power management"
	default n
	depends on ARCH_X86
	help
	  Reboot or power off using registers in the AMD chipset.

config DRIVER_POWER_TPS65913
	bool "TPS65913 PMIC power management"
	default n
	help
	  Reboot or power off using the TPS65913 PMIC.

config DRIVER_POWER_MAX77620
	bool "MAX77620 PMIC power management"
	default n
	help
	  Reboot or power off using the MAX77620 PMIC.

config DRIVER_POWER_RK808
	bool "RK808 PMIC power management"
	default n
	help
	  power off using the RK808 PMIC.

config DRIVER_POWER_IPQ806X
	bool "IPQ806X PMIC power management"
	default n
	help
	  Reboot or power off using the IPQ806X internals.

config DRIVER_POWER_IPQ40XX
	bool "IPQ40XX power management"
	default n
	help
	  Reboot or power off using registers in the SoC.

config DRIVER_POWER_ARMADA38X
        bool "ARMADA38X PMIC power management"
        default n
        help
          Reboot using the ARMADA38X internals.
```

## src/drivers/soc/Kconfig
```kconfig
##
## Copyright 2016 Google Inc.  All rights reserved.
##
## This program is free software; you can redistribute it and/or modify
## it under the terms of the GNU General Public License as published by
## the Free Software Foundation; version 2 of the License.
##
## This program is distributed in the hope that it will be useful,
## but WITHOUT ANY WARRANTY; without even the implied warranty of
## MERCHANTABILITY or FITNESS FOR A PARTICULAR PURPOSE.  See the
## GNU General Public License for more details.
##

config DRIVER_SOC_SKYLAKE
	bool "Skylake SoC driver"
	default n
	select DRIVER_GPIO_SKYLAKE

config DRIVER_SOC_APOLLOLAKE
	bool "Apollolake SoC driver"
	default n
	select DRIVER_GPIO_APOLLOLAKE
	select INTEL_COMMON_I2S_CAVS_1_5

config DRIVER_SOC_CANNONLAKE
	bool "Cannonlake SoC driver"
	default n
	select INTEL_COMMON_I2S_CAVS_1_8

config DRIVER_SOC_STONEYRIDGE
	bool "Stoney Ridge SoC driver"
	default n
	select DRIVER_GPIO_KERN

config DRIVER_SOC_PICASSO
	bool "Picasso & Pollock SoC driver"
	default n
	select DRIVER_GPIO_KERN

config DRIVER_SOC_GLK
	bool "Glk SoC driver"
	default n
	select DRIVER_GPIO_APOLLOLAKE
	select INTEL_COMMON_I2S_CAVS_1_5

config DRIVER_SOC_ICELAKE
	bool "Icelake SoC driver"
	default n
	select DRIVER_GPIO_ICELAKE

config DRIVER_SOC_QCOM_QUP_SE
	bool "Qcom QUPV3 common driver"
	default n

config DRIVER_SOC_QCOM_SPMI
	bool "Qualcomm SPMI arbitrator driver"
	default n
	help
	  You ordinarily shouldn't need this unless you need to hack voltage
	  regulators in depthcharge to work around hardware issues.

config DRIVER_SOC_JASPERLAKE
	bool "Jasperlake SoC driver"
	default n
	select DRIVER_GPIO_JASPERLAKE
	select INTEL_COMMON_I2S_CAVS_2_0

config DRIVER_SOC_INTEL_PMC
	bool
	default n
	help
	  A driver for Intel's PMC IPC API.

config DRIVER_SOC_INTEL_PMC_DEBUG
	bool "Enable Intel PMC driver debugging"
	default n
	depends on DRIVER_SOC_INTEL_PMC

config DRIVER_SOC_TIGERLAKE
	bool "Tigerlake SoC driver"
	default n
	select DRIVER_GPIO_TIGERLAKE
	select INTEL_COMMON_I2S_CAVS_2_5
	select DRIVER_USB_INTEL_TCSS if DRIVER_EC_CROS
	select DRIVER_USB_INTEL_TCSS_DEBUG if DRIVER_EC_CROS
	select DRIVER_SOC_INTEL_PMC
	select DRIVER_SOC_INTEL_PMC_DEBUG

config DRIVER_SOC_ALDERLAKE
	bool "Alderlake SoC driver"
	default n
	select DRIVER_GPIO_ALDERLAKE
	select INTEL_COMMON_I2S_CAVS_2_5
	select DRIVER_USB_INTEL_TCSS if DRIVER_EC_CROS
	select DRIVER_USB_INTEL_TCSS_DEBUG if DRIVER_EC_CROS
	select DRIVER_SOC_INTEL_PMC
	select DRIVER_SOC_INTEL_PMC_DEBUG

config DRIVER_SOC_CEZANNE
	bool "Cezanne SoC driver"
	default n
	select DRIVER_GPIO_KERN
```
