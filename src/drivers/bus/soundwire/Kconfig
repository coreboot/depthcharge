## src/drivers/bus/soundwire/Kconfig
```kconfig
# SPDX-License-Identifier: GPL-2.0
# Copyright (c) 2020, Intel Corporation.
# Copyright 2020-2026 Google LLC.

config DRIVER_BUS_SOUNDWIRE
	bool "Soundwire driver"
	default n

config DRIVER_BUS_SOUNDWIRE_INTEL
	bool "Soundwire driver for Intel platforms"
	default y if DRIVER_BUS_SOUNDWIRE

config INTEL_COMMON_SNDW_CAVS_2_5
	bool "Intel cavs 2.5 specification"
	default n

config INTEL_COMMON_SOUNDWIRE_ACE_1_x
	bool "Intel ACE 1.x specification"
	default n

config INTEL_COMMON_SOUNDWIRE_ACE_3_x
	bool "Intel ACE 3.x specification"
	default n
```

## src/drivers/bus/spi/Kconfig
```kconfig
##
## Copyright 2013 Google Inc.  All rights reserved.
##
## This program is free software; you can redistribute it and/or modify
## it under the terms of the GNU General Public License as published by
## the Free Software Foundation; version 2 of the License.
##
## This program is distributed in the hope that it will be useful,
## but WITHOUT ANY WARRANTY; without even the implied warranty of
## MERCHANTABILITY or FITNESS FOR A PARTICULAR PURPOSE.  See the
## GNU General Public License for more details.

config DRIVER_BUS_SPI_BITBANG
	bool "Bitbanging SPI driver"
	default n

config DRIVER_BUS_SPI_EXYNOS5
	bool "Exynos5 SPI driver"
	default n

config DRIVER_BUS_SPI_INTEL_GSPI
	bool "Intel GSPI driver"
	default n

config DRIVER_BUS_SPI_INTEL_GSPI_VERSION_2
	bool "Intel GSPI driver - v2(CS_CONTROL quirks for CNL)"
	default n
	select DRIVER_BUS_SPI_INTEL_GSPI

config DRIVER_BUS_SPI_IPQ806X
	bool "Ipq806x SPI driver"
	default n

config DRIVER_BUS_SPI_IPQ40XX
	bool "IPQ40XX SPI driver"
	default n

config DRIVER_BUS_SPI_QCS405
	bool "QCS405 SPI driver"
	default n

config DRIVER_BUS_SPI_ROCKCHIP
	bool "RK3288 SPI driver"
	default n

config DRIVER_BUS_SPI_TEGRA
	bool "Tegra SPI driver"
	depends on DRIVER_DMA_TEGRA_APB
	default n

config DRIVER_BUS_SPI_BCM_QSPI
	bool "BCM58305 SPI driver"
	default n

config DRIVER_BUS_SPI_MTK
	bool "MTK SPI driver"
	default n

config DRIVER_BUS_SPI_ARMADA38X_SPI
	bool "ARMADA38X SPI driver"
	default n

config DRIVER_BUS_QSPI_SC7180
	bool "SC7180 SPI driver"
	default n

config DRIVER_BUS_SPI_QCOM_SPI_QUP
	bool "SC7180 QUPV3 SPI driver"
	default n
	depends on DRIVER_SOC_QCOM_QUP_SE
```

## src/drivers/bus/usb/Kconfig
```kconfig
##
## Copyright 2013 Google LLC
##
## This program is free software; you can redistribute it and/or modify
## it under the terms of the GNU General Public License as published by
## the Free Software Foundation; version 2 of the License.
##
## This program is distributed in the hope that it will be useful,
## but WITHOUT ANY WARRANTY; without even the implied warranty of
## MERCHANTABILITY or FITNESS FOR A PARTICULAR PURPOSE.  See the
## GNU General Public License for more details.

config DRIVER_LYNXPOINT_NO_EHCI
	bool "Disable Intel Lynxpoint EHCI"
	default n
	depends on ARCH_X86
	help
	  This driver will issue an SMI callback to coreboot that will
	  route all USB ports to the XHCI controller and disable the EHCI
	  controller to save power.

config DRIVER_USB_INTEL_TCSS
	bool "Enable Intel TCSS driver"
	default n
	depends on DRIVER_EC_CROS
	depends on DRIVER_SOC_INTEL_PMC
	help
	  Select this to enable support for the Intel USB Type-C subsystem
	  (TCSS). A board_tcss_get_port_mapping() function must be provided to
	  determine the system port mapping. Currently, this driver is
	  applicable to Tiger Lake and Alder Lake systems.

config DRIVER_USB_INTEL_TCSS_DEBUG
	bool "Enable Intel TCSS driver debugging"
	default n
	depends on DRIVER_USB_INTEL_TCSS

config DRIVER_USB_AP_MUX_CONTROL_CROS
	bool "Enable AP control of type-C muxes through CrOS EC"
	default n
	depends on DRIVER_EC_CROS

config DRIVER_USB_AP_MUX_CONTROL_CROS_DEBUG
	bool "Enable debugging for AP control of type-C muxes through CrOS EC"
	default n
	depends on DRIVER_USB_AP_MUX_CONTROL_CROS

config INTEL_TCSS_USE_PDC_PMC_MUX_CONFIG
	bool "Enable TCSS PDC PMC Mux configuration"
	default n
	help
	  Select this to indicate PDC<->PMC direct connection. PDC communicates directly to PMC
	  to configure the mux and there is no need to query the EC to get port mapping and send
	  commands to PMC to configure the mux.
```

## src/drivers/ec/anx3429/Kconfig
```kconfig
##
## Copyright 2017 Google Inc.  All rights reserved.
##
## This program is free software; you can redistribute it and/or modify
## it under the terms of the GNU General Public License as published by
## the Free Software Foundation; version 2 of the License.
##
## This program is distributed in the hope that it will be useful,
## but WITHOUT ANY WARRANTY; without even the implied warranty of
## MERCHANTABILITY or FITNESS FOR A PARTICULAR PURPOSE.  See the
## GNU General Public License for more details.

config DRIVER_EC_ANX3429
	bool "ANX3429 TCPC"
	default n
	help
	  Add support for ANX3429 TCPC
```

## src/drivers/ec/anx3447/Kconfig
```kconfig
## SPDX-License-Identifier: GPL-2.0

config DRIVER_EC_ANX3447
	bool "ANX3447 TCPC"
	depends on DRIVER_EC_CROS
	default n
	help
	  Add support for ANX3447 TCPC
```

## src/drivers/ec/anx7510/Kconfig
```kconfig
## SPDX-License-Identifier: GPL-2.0

config DRIVER_EC_ANX7510
	bool "ANX7510 DP2HDMI"
	depends on DRIVER_EC_CROS
	default n
	help
	  Add support for ANX7510 video bridge firmware update
```

## src/drivers/ec/anx7688/Kconfig
```kconfig
##
## Copyright 2016 Google Inc.  All rights reserved.
##
## This program is free software; you can redistribute it and/or modify
## it under the terms of the GNU General Public License as published by
## the Free Software Foundation; version 2 of the License.
##
## This program is distributed in the hope that it will be useful,
## but WITHOUT ANY WARRANTY; without even the implied warranty of
## MERCHANTABILITY or FITNESS FOR A PARTICULAR PURPOSE.  See the
## GNU General Public License for more details.

config DRIVER_EC_ANX7688
	bool "ANX7688 TCPC and HDMI->DP converter"
	default n
	help
	  Add support for ANX7688 TCPC and HDMI->DP converter
```

## src/drivers/ec/ccgxxf/Kconfig
```kconfig
config DRIVER_EC_CCGXXF
	bool "Cypress CCGXXF USB Type-C Power Delivery Controller"
	help
	  Add firmware upgrade support for Cypress USB Type-C Power Delivery
	  Controller CCGXXF.
```

## src/drivers/ec/chromeos/Kconfig
```kconfig
## This file is part of the coreboot project.
##
## Copyright 2013 Google Inc.  All rights reserved.
##
## This program is free software; you can redistribute it and/or modify
## it under the terms of the GNU General Public License as published by
## the Free Software Foundation; version 2 of the License.
##
## This program is distributed in the hope that it will be useful,
## but WITHOUT ANY WARRANTY; without even the implied warranty of
## MERCHANTABILITY or FITNESS FOR A PARTICULAR PURPOSE.  See the
## GNU General Public License for more details.
##
## You should have received a copy of the GNU General Public License
## along with this program; if not, write to the Free Software
## Foundation, Inc., 51 Franklin St, Fifth Floor, Boston, MA 02110-1301 USA

config DRIVER_MKBP
	bool "Enable support for the ChromeOS EC"
	default n

choice
	prompt "ChromeOS EC bus"
	default DRIVER_MKBP_LPC
	depends on DRIVER_MKBP
	help
	  The type of bus the ChromeOS EC is connected with.

config DRIVER_MKBP_LPC
	bool "LPC"

config DRIVER_MKBP_I2C
	bool "I2C (currently untested)"

config DRIVER_MKBP_SPI
	bool "SPI (currently unimplemented)"

endchoice

config DRIVER_MKBP_I2C_ADDR
	hex "ChromeOS EC I2C address"
	depends on DRIVER_MKBP_I2C
	help
	  The address of the ChromeOS EC on its I2C bus.
```

## src/drivers/ec/ps8751/Kconfig
```kconfig
##
## Copyright 2017 Google Inc.  All rights reserved.
##
## This program is free software; you can redistribute it and/or modify
## it under the terms of the GNU General Public License as published by
## the Free Software Foundation; version 2 of the License.
##
## This program is distributed in the hope that it will be useful,
## but WITHOUT ANY WARRANTY; without even the implied warranty of
## MERCHANTABILITY or FITNESS FOR A PARTICULAR PURPOSE.  See the
## GNU General Public License for more details.

config DRIVER_EC_PS8751
	bool "PS8751 TCPC"
	default n
	help
	  Add support for PS8751 TCPC

if DRIVER_EC_PS8751

config DRIVER_EC_PS8751_FLASH_WINDOW
	bool "PS8XXX flash window access over I2C"
	default n
	help
	  Enables an alternate scheme for accessing the internal flash
	  of PS8xxx series TCPCs to achieve 10x faster firmware
	  updates. The TCPC presents a 256 byte window onto the internal
	  flash that can be used to read/write its content. For most
	  PS8xxx family members, the I2C bus must operate at 400 kHz (or
	  below) for this to work reliably, so this feature depends on
	  being able to adjust the I2C bus speed at runtime, so make
	  sure this capability is supported by the EC.

config DRIVER_EC_PS8751_I2C_SPEED_CONTROL
	bool "PS8xxx I2C bus speed control"
	default y if DRIVER_EC_PS8751_FLASH_WINDOW
	default n
	help
	  Enable controlling the I2C bus speed between the EC and the
	  TCPC. This is needed to potentially decrease the bus speed to
	  400 KHz to support the window based firmware update scheme.
	  If the I2C bus is normally configured to run at (or below) 400
	  KHz, this is not required.

endif # DRIVER_EC_PS8751
```

## src/drivers/ec/rts5453/Kconfig
```kconfig
##
## Copyright 2023 Google LLC
##
## This program is free software; you can redistribute it and/or modify
## it under the terms of the GNU General Public License as published by
## the Free Software Foundation; version 2 of the License.
##
## This program is distributed in the hope that it will be useful,
## but WITHOUT ANY WARRANTY; without even the implied warranty of
## MERCHANTABILITY or FITNESS FOR A PARTICULAR PURPOSE.  See the
## GNU General Public License for more details.

config DRIVER_EC_RTS5453
	bool "RTS5453 PDC"
	depends on DRIVER_EC_CROS
	default n
	help
	  Add support to update the firmware for Realtek RTS5453 PDC

config DRIVER_EC_RTS545X_VID
	hex "RTS5453 VID"
	depends on DRIVER_EC_RTS5453
	default 0x18d1
	help
	  Vendor ID of RTS5453 chip

config DRIVER_EC_RTS545X_PID
	hex "RTS5453 PID"
	depends on DRIVER_EC_RTS5453
	default 0x5065
	help
	  Product ID of RTS5453 chip

config DRIVER_EC_IS_RTS545X_VB
	bool "RTS5453-VB PDC"
	depends on DRIVER_EC_RTS5453
	default n
	help
	  Identifier for the RTS545X VB chip is on device
```

## src/drivers/ec/tps6699x/Kconfig
```kconfig
##
## Copyright 2024 Google LLC
##
## This program is free software; you can redistribute it and/or modify
## it under the terms of the GNU General Public License as published by
## the Free Software Foundation; version 2 of the License.
##
## This program is distributed in the hope that it will be useful,
## but WITHOUT ANY WARRANTY; without even the implied warranty of
## MERCHANTABILITY or FITNESS FOR A PARTICULAR PURPOSE.  See the
## GNU General Public License for more details.

config DRIVER_EC_TPS6699X
	bool "TPS6699X PDC"
	depends on DRIVER_EC_CROS
	default n
	help
	  Add support to update the firmware for TI TPS6699X PDC

if DRIVER_EC_TPS6699X

config DRIVER_EC_TPS6699X_I2C_SPEED_KHZ
	int "I2C clock speed, in kHz"
	default 1000
	help
	  The update driver can order the EC to adjust the I2C clock speed
	  used for communication with the PDC. The original clock speed is
	  captured and restored after the procedure completes. Set this to
	  0 to disable bus speed adjustment.

config DRIVER_EC_TPS6699X_FORCE_UPDATE
	bool "Force TPS6699x firmware update"
	default n
	help
	  If enabled, force the driver to always update the PDC FW, even if
	  the incoming version matches the current version. Used for
	  debugging. Note: this will block system boot due to the constant
	  updating and rebooting of the system.

endif
```

## src/drivers/ec/wilco/Kconfig
```kconfig
# SPDX-License-Identifier: GPL-2.0
#
# Copyright 2019 Google LLC
#
# Depthcharge driver for the Wilco Embedded Controller.
#

config DRIVER_EC_WILCO
	bool "Enable support for the Chrome OS Wilco EC"
	default n
	select AUXFW_SOFTWARE_SYNC
```

## src/drivers/flash/Kconfig
```kconfig
##
## Copyright 2013 Google Inc.  All rights reserved.
##
## This program is free software; you can redistribute it and/or modify
## it under the terms of the GNU General Public License as published by
## the Free Software Foundation; version 2 of the License.
##
## This program is distributed in the hope that it will be useful,
## but WITHOUT ANY WARRANTY; without even the implied warranty of
## MERCHANTABILITY or FITNESS FOR A PARTICULAR PURPOSE.  See the
## GNU General Public License for more details.

config DRIVER_FLASH_FAST_SPI
	bool "Intel Fast SPI flash"
	select DRIVER_FLASH
	default n

config DRIVER_FLASH_MEMMAPPED
	bool "Memory mapped flash"
	select DRIVER_FLASH
	default n

config DRIVER_FLASH_MTK_SNFC
	bool "Mediatek SPI-NOR flash controller (SNFC)"
	select DRIVER_FLASH
	default n

config DRIVER_FLASH_ICH7
	bool "Intel I/O Controller Hub 7 flash"
	depends on ARCH_X86
	select DRIVER_FLASH
	select DRIVER_FLASH_ICH_BASE
	default n

config DRIVER_FLASH_ICH9
	bool "Intel I/O Controller Hub 9 flash"
	depends on ARCH_X86
	select DRIVER_FLASH
	select DRIVER_FLASH_ICH_BASE
	default n

config DRIVER_FLASH_SPI
	bool "SPI based flash"
	select DRIVER_FLASH
	default n

config DRIVER_FLASH_ICH_BASE
	bool
	default n

config DRIVER_FLASH
	bool
	default n

config DRIVER_CBFS_FLASH
	bool "Glue code to bind libcbfs to depthcharge's flash"
	default y
```

## src/drivers/gpio/Kconfig
```kconfig
##
## Copyright 2013 Google Inc.  All rights reserved.
##
## This program is free software; you can redistribute it and/or modify
## it under the terms of the GNU General Public License as published by
## the Free Software Foundation; version 2 of the License.
##
## This program is distributed in the hope that it will be useful,
## but WITHOUT ANY WARRANTY; without even the implied warranty of
## MERCHANTABILITY or FITNESS FOR A PARTICULAR PURPOSE.  See the
## GNU General Public License for more details.

config DRIVER_GPIO_BAYTRAIL
	bool "Intel Baytrail PCH GPIO driver"
	default n
	select DRIVER_GPIO_PCH

config DRIVER_GPIO_BRASWELL
	bool "Intel Braswell GPIO driver"
	default n

config DRIVER_GPIO_EXYNOS5250
	bool "Exynos 5250 GPIO driver"
	default n
	depends on ARCH_ARM

config DRIVER_GPIO_EXYNOS5420
	bool "Exynos 5420 GPIO driver"
	default n
	depends on ARCH_ARM

config DRIVER_GPIO_IMGTEC_PISTACHIO
	bool "IMGTEC GPIO driver"
	default n
	depends on ARCH_MIPS

config DRIVER_GPIO_IPQ_806X
	bool "Qualcomm IPQ806X GPIO driver"
	default n
	depends on ARCH_ARM

config DRIVER_GPIO_IPQ40XX
	bool "QCA IPQ40XX GPIO driver"
	default n
	depends on ARCH_ARM

config DRIVER_GPIO_LYNXPOINT_LP
	bool "Intel Lynxpoint LP PCH GPIO driver"
	default n
	depends on ARCH_X86

config DRIVER_GPIO_MT8173
	bool "MediaTek MT8173 GPIO driver"
	default n
	depends on ARCH_ARM

config DRIVER_GPIO_PANTHERPOINT
	bool "Intel Pantherpoint PCH GPIO driver"
	default n
	select DRIVER_GPIO_PCH

config DRIVER_GPIO_PCH
	bool
	default n
	depends on ARCH_X86

config DRIVER_GPIO_RK3288
	bool "Rk3288 GPIO driver"
	default n
	select DRIVER_GPIO_ROCKCHIP

config DRIVER_GPIO_RK3399
	bool "Rk3399 GPIO driver"
	default n
	select DRIVER_GPIO_ROCKCHIP

config DRIVER_GPIO_ROCKCHIP
	bool
	default n
	depends on ARCH_ARM

config DRIVER_GPIO_SKYLAKE
	bool "Intel Skylake GPIO driver"
	default n

config DRIVER_GPIO_TEGRA
	bool "Tegra GPIO driver"
	default n
```
