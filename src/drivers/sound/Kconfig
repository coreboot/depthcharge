## src/drivers/sound/Kconfig
```kconfig
##
## Copyright 2013 Google Inc.  All rights reserved.
##
## This program is free software; you can redistribute it and/or modify
## it under the terms of the GNU General Public License as published by
## the Free Software Foundation; version 2 of the License.
##
## This program is distributed in the hope that it will be useful,
## but WITHOUT ANY WARRANTY; without even the implied warranty of
## MERCHANTABILITY or FITNESS FOR A PARTICULAR PURPOSE.  See the
## GNU General Public License for more details.

config DRIVER_SOUND_GPIO_I2S
	bool "I2S driver based on bit-bang GPIO"
	default n

config DRIVER_SOUND_GPIO_PDM
	bool "PDM driver based on bit-bang GPIO"
	default n

config DRIVER_SOUND_GPIO_BUZZER
	bool "A buzzer controlled by gpio value"
	default n

config DRIVER_SOUND_GPIO_EDGE_BUZZER
	bool "A buzzer that is gpio edge triggered"
	default n

config DRIVER_SOUND_HDA
	bool "HDA codec driver"
	default n

config DRIVER_SOUND_I2S
	bool "Generic I2S sound support"
	default n

config DRIVER_SOUND_IPQ806X
	bool "IPQ806x sound driver"
	default n

config DRIVER_SOUND_MAX98090
	bool "MAX98090 codec driver"
	default n

config DRIVER_SOUND_MAX98095
	bool "MAX98095 codec driver"
	default n

config DRIVER_SOUND_MAX98357A
	bool "MAX98357A codec driver"
	default n

config DRIVER_SOUND_MAX98373
	bool "MAX98373 codec driver"
	default n

config DRIVER_SOUND_MAX98390
	bool "MAX98390 codec driver"
	default n

config DRIVER_SOUND_MAX98927
	bool "MAX98927 codec driver"
	default n

config DRIVER_SOUND_PCAT_BEEP
	bool "Legacy PC AT beep driver"
	default n

config DRIVER_SOUND_RT1011
	bool "RT1011 codec driver"
	default n

config DRIVER_SOUND_RT1015
	bool "RT1015 speaker amp driver"
	default n

config DRIVER_SOUND_RT5645
	bool "RT5645 codec driver"
	default n

config DRIVER_SOUND_RT5677
	bool "RT5677 codec driver"
	default n

config DRIVER_SOUND_RT5682
	bool "RT5682 codec driver"
	default n

config DRIVER_SOUND_ROUTE
	bool "Sound route container"
	default n

config DRIVER_SOUND_SSM4567
	bool "Analog Devices SSM4567 codec driver"
	default n

config DRIVER_SOUND_TEGRA_AUDIO_HUB
	bool "Tegra Audio Hub driver"
	default n
```

## src/drivers/storage/Kconfig
```kconfig
##
## Copyright 2013 Google Inc.  All rights reserved.
##
## This program is free software; you can redistribute it and/or modify
## it under the terms of the GNU General Public License as published by
## the Free Software Foundation; version 2 of the License.
##
## This program is distributed in the hope that it will be useful,
## but WITHOUT ANY WARRANTY; without even the implied warranty of
## MERCHANTABILITY or FITNESS FOR A PARTICULAR PURPOSE.  See the
## GNU General Public License for more details.

config DRIVER_AHCI
	bool "AHCI driver"
	default n

config DRIVER_STORAGE_MMC
	bool "Board-specific SD/MMC storage Driver"
	default n
        help
          For platforms with SD/MMC card readers not on USB bus.

config DRIVER_STORAGE_MSHC_S5P
	depends on  DRIVER_STORAGE_MMC
	bool "S5P MSHC/MMC driver"
	default n

config DRIVER_STORAGE_MMC_DW
	depends on DRIVER_STORAGE_MMC
	bool "DesignWare MMC driver"
	default n

config DRIVER_STORAGE_MMC_DW_EXYNOS
	depends on DRIVER_STORAGE_MMC_DW
	bool "DesignWare MMC driver for Exynos"
	default n

config DRIVER_STORAGE_IPQ_806X
	depends on DRIVER_STORAGE_MMC
	bool "Qualcomm MMC driver"
	default n


config DRIVER_STORAGE_IPQ_40XX
	depends on DRIVER_STORAGE_MMC
	bool "QCA MMC driver for IPQ40xx"
	default n

config DRIVER_STORAGE_MMC_MTK
	depends on DRIVER_STORAGE_MMC
	bool "MTK MMC driver"
	default n

config DRIVER_STORAGE_MMC_MVMAP2315
	depends on DRIVER_STORAGE_MMC
	bool "MVMAP2315 MMC driver"
	default n

config DRIVER_STORAGE_MMC_TEGRA
	depends on DRIVER_STORAGE_MMC
	bool "NVIDIA Tegra MMC driver"
	default n

config DRIVER_SDHCI
	depends on DRIVER_STORAGE_MMC
	bool "SDHCI specification compliant eMMC/SD driver"
	default n

config DRIVER_STORAGE_SDHCI_PCI
	depends on ARCH_X86
	depends on DRIVER_SDHCI
	bool "PCI SDHCI based eMMC/SD driver"
	default n

config DRIVER_STORAGE_SDHCI_RK3399
	select DRIVER_SDHCI
	bool "RK3399 sdhci eMMC driver"
	default n

config DRIVER_STORAGE_DWMMC_RK3288
        select DRIVER_STORAGE_MMC_DW
        bool "R3288 DWMMC driver"
        default n

config DRIVER_STORAGE_DWMMC_RK3399
        select DRIVER_STORAGE_MMC_DW
        bool "R3399 DWMMC driver"
        default n

config DRIVER_STORAGE_BAYHUB
        depends on DRIVER_STORAGE_SDHCI_PCI
        bool "Bayhub SD/eMMC driver"
        default n

config DRIVER_STORAGE_SPI_GPT
	bool "Look up a kernel partition from a GPT on SPI"
	default n

config DRIVER_STORAGE_NVME
	bool "NVMe driver"
	default n

config DRIVER_STORAGE_SDHCI_MSM
	depends on DRIVER_STORAGE_MMC
	depends on DRIVER_SDHCI
	bool "MMC driver for Qcom MSM platforms"
	default n

source src/drivers/storage/mtd/Kconfig
```

## src/drivers/storage/mtd/Kconfig
```kconfig
config DRIVER_STORAGE_MTD_STREAM
	bool "Flash stream support"
	default n

source "src/drivers/storage/mtd/nand/Kconfig"
```

## src/drivers/storage/mtd/nand/Kconfig
```kconfig
config DRIVER_STORAGE_MTD_NAND
	bool "NAND Device Support"
	help
	  This enables support for accessing all type of NAND flash
	  devices. For further information see
	  <http://www.linux-mtd.infradead.org/doc/nand.html>.

config DRIVER_STORAGE_MTD_IPQ_NAND
	bool "IPQ NAND support"
	select DRIVER_STORAGE_MTD_NAND

config DRIVER_STORAGE_MTD_SPI_NAND
	bool "SPI NAND devices support"
	select DRIVER_STORAGE_MTD_NAND

config DRIVER_STORAGE_MTD_BCM_NAND
	bool "Broadcom NAND controller support"
	select DRIVER_STORAGE_MTD_NAND
```

## src/drivers/timer/Kconfig
```kconfig
## This file is part of the coreboot project.
##
## Copyright 2013 Google Inc.  All rights reserved.
##
## This program is free software; you can redistribute it and/or modify
## it under the terms of the GNU General Public License as published by
## the Free Software Foundation; version 2 of the License.
##
## This program is distributed in the hope that it will be useful,
## but WITHOUT ANY WARRANTY; without even the implied warranty of
## MERCHANTABILITY or FITNESS FOR A PARTICULAR PURPOSE.  See the
## GNU General Public License for more details.
##
## You should have received a copy of the GNU General Public License
## along with this program; if not, write to the Free Software
## Foundation, Inc., 51 Franklin St, Fifth Floor, Boston, MA 02110-1301 USA

config DRIVER_TIMER_DUMMY
	bool "Dummy timer driver"
	depends on !ARCH_X86
	default n

config DRIVER_TIMER_MCT
	bool "Exynos MCT (multi-core timer) driver"
	depends on ARCH_ARM
	default n

config DRIVER_TIMER_MCT_HZ
	int "Exynos MCT frequency"
	depends on DRIVER_TIMER_MCT
	default 24000000

config DRIVER_TIMER_MCT_ADDRESS
	hex "Exynos MCT base address"
	depends on DRIVER_TIMER_MCT

config DRIVER_TIMER_TEGRA_1US
	bool "Tegra 1us timer driver"
	default n

config DRIVER_TIMER_TEGRA_1US_ADDRESS
	hex "Tegra 1us timer base address"
	depends on DRIVER_TIMER_TEGRA_1US
```

## src/drivers/tpm/Kconfig
```kconfig
##
## Copyright 2013 Google LLC
##
## This program is free software; you can redistribute it and/or modify
## it under the terms of the GNU General Public License as published by
## the Free Software Foundation; version 2 of the License.
##
## This program is distributed in the hope that it will be useful,
## but WITHOUT ANY WARRANTY; without even the implied warranty of
## MERCHANTABILITY or FITNESS FOR A PARTICULAR PURPOSE.  See the
## GNU General Public License for more details.

config DRIVER_TPM_GOOGLE_CR50
	bool "Google Cr50 TPM"
	depends on DRIVER_TPM
	select DRIVER_TPM_GOOGLE
	default n

config DRIVER_TPM_GOOGLE_TI50
	bool "Google Ti50 TPM"
	depends on DRIVER_TPM
	select DRIVER_TPM_GOOGLE
	default n

config DRIVER_TPM_SLB96
	bool "SLB96xx TPM"
	depends on DRIVER_TPM_I2C
	default n

config DRIVER_TPM_GOOGLE
	bool
	default n

config DRIVER_TPM_I2C
	bool "I2C TPM driver"
	select DRIVER_TPM
	default n

config DRIVER_TPM_SPI
	bool "SPI TPM driver"
	# Currently only supported with DRIVER_TPM_GOOGLE
	select DRIVER_TPM
	default n

config DRIVER_TPM_LPC
	bool "LPC TPM driver"
	select DRIVER_TPM
	default n

config DRIVER_TPM
	bool
	default n

if DRIVER_TPM_GOOGLE
source "src/drivers/tpm/google/Kconfig"
endif
```

## src/drivers/tpm/google/Kconfig
```kconfig
# SPDX-License-Identifier: GPL-2.0

config TPM_GOOGLE_SWITCHES
	bool "Reading button state through Google TPM"
	default n

config TPM_GOOGLE_IRQ_TIMEOUT_MS
	int "Timeout in milliseconds for waiting for TPM IRQ"
	default 100 if DRIVER_TPM_GOOGLE_CR50 && DRIVER_TPM_I2C
	default 10 if DRIVER_TPM_GOOGLE_CR50
	default 750
```

## src/drivers/video/Kconfig
```kconfig
##
## Copyright 2013 Google Inc.  All rights reserved.
##
## This program is free software; you can redistribute it and/or modify
## it under the terms of the GNU General Public License as published by
## the Free Software Foundation; version 2 of the License.
##
## This program is distributed in the hope that it will be useful,
## but WITHOUT ANY WARRANTY; without even the implied warranty of
## MERCHANTABILITY or FITNESS FOR A PARTICULAR PURPOSE.  See the
## GNU General Public License for more details.

config DRIVER_VIDEO_EXYNOS5
	bool "Exynos5 video"
	default n

config DRIVER_VIDEO_EXYNOS5_BASE
	hex "Exynos5 video base address"
	depends on DRIVER_VIDEO_EXYNOS5

config DRIVER_VIDEO_INTEL_I915
	bool "Intel i915 video driver"
	default n

config DRIVER_VIDEO_TEGRA132
	bool "tegra132 video settings"
	default n

config DRIVER_VIDEO_TEGRA210
	bool "tegra210 video settings"
	default n

config DRIVER_VIDEO_RK3288
	bool "rk3288 video settings"
	default n

config DRIVER_VIDEO_RK3399
	bool "rk3399 video settings"
	default n

config DRIVER_VIDEO_WW_RING
	bool "Whirlwind LED ring driver"
	default n

config DRIVER_VIDEO_MTK
	bool "MediaTek video settings"
	default n

config DRIVER_VIDEO_EC_PWM_BACKLIGHT
	bool "Control backlight by EC PWM"
	default n
	depends on DRIVER_EC_CROS

config DRIVER_VIDEO_ARCTICSAND_BACKLIGHT
	bool "Arctic Sand backlight controller setting"
	default n

config DRIVER_VIDEO_LP5562
	bool "LP5562 LED driver"
	default n

config DRIVER_VIDEO_SC7180
	bool "sc7180 video settings"
	default n
```

## src/fastboot/Kconfig
```kconfig
##
## Copyright 2021 Google Inc.  All rights reserved.
##
## This program is free software; you can redistribute it and/or modify
## it under the terms of the GNU General Public License as published by
## the Free Software Foundation; version 2 of the License.
##
## This program is distributed in the hope that it will be useful,
## but WITHOUT ANY WARRANTY; without even the implied warranty of
## MERCHANTABILITY or FITNESS FOR A PARTICULAR PURPOSE.  See the
## GNU General Public License for more details.

config FASTBOOT_IN_PROD
	bool "Enable fastboot in production (default depthcharge binary)"
	default n
	help
	  Enable this to compile in support for fastboot into default depthcharge
	  binary. If disabled, fastboot is still available in developer builds.

config FASTBOOT_TCP
	bool "Enable fastboot over TCP"
	default y
	help
	  Enable this to include code for fastboot over TCP.
```

## src/image/Kconfig
```kconfig
##
## Copyright 2012 Google Inc.  All rights reserved.
##
## This program is free software; you can redistribute it and/or modify
## it under the terms of the GNU General Public License as published by
## the Free Software Foundation; version 2 of the License.
##
## This program is distributed in the hope that it will be useful,
## but WITHOUT ANY WARRANTY; without even the implied warranty of
## MERCHANTABILITY or FITNESS FOR A PARTICULAR PURPOSE.  See the
## GNU General Public License for more details.


# Options which are passed to the linker script. When making changes, update
# the list of options in Makefile.inc as well.

config KERNEL_START
	hex "Physical address of the region the kernel image is loaded into"
	default 0x100000
	help
	  The start of a region of memory the kernel image is loaded into from
	  the boot medium (vboot, network, etc.). This image may or may not be
	  a wrapper around the actual kernel code (e.g. FIT) and may or may not
	  require further decompression or relocation.

	  ==== Placement guide (also see kernel/Documentation/<arch>/boot*) ====
	  arm32: Within first 128MB of RAM. Ideally at exactly 32MB. Do not
	  overlap DMA_COHERENT area (from coreboot memlayout)!
	  arm64: Anywhere, but leave as much space as possible empty from the
	  start of RAM (ideally up to 512MB, see KERNEL_FIT_FDT_ADDR help).
	  x86: Do not change, defaults should work fine.

config KERNEL_SIZE
	hex "The size of the region the kernel image is loaded into"
	default 0x08000000 if ARCH_ARM_V7	# kernel ABI limitation
	default 0x20000000
	help
	  The size of the memory region described in KERNEL_START. Note that we
	  want this to be very generous, to have the option of loading recovery
	  kernels with large attached initramfs in the future. While the kernel
	  partition size on the fixed disk is usually much smaller anyway, we
	  can make the partition on the recovery USB stick as big as we want
	  later on. Since recovery firmware cannot be updated, this limit needs
	  to be made sufficiently large in advance.
	  (NOTE: Pre-2018 devices have significantly smaller limits here.)

config BASE_ADDRESS
	hex "The address depthcharge is linked to run at"
	default 0x30000000
	help
	  The address that the the depthcharge code and data is linked to.

config HEAP_SIZE
	hex "The size of the heap in bytes"
	default 0x2000000  # 32 MiB
	help
	  The size of the heap in bytes, minus any padding needed to align it
	  to a 16 byte boundary.

config STACK_SIZE
	hex "The size of the stack in bytes"
	default 0x4000
	help
	  The size of the stack in bytes, minus any padding needed to align it
	  to a 16 byte boundary.

# End of options passed to the linker script.
```
