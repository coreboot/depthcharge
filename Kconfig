## board/dewatt/defconfig
```kconfig
# Arch
CONFIG_ARCH_X86=y

# Board
CONFIG_BOARD_DIR="guybrush"

# Image
CONFIG_HEAP_SIZE=0x01000000

# Vboot
CONFIG_AUXFW_SOFTWARE_SYNC=y
CONFIG_EC_VBOOT_SUPPORT=y
CONFIG_TPM2_MODE=y
CONFIG_TPM_DEBUG_EXTENSIONS=y
CONFIG_NVDATA_CMOS=y
CONFIG_CROSSYSTEM_ACPI=y

# Kernel format
CONFIG_KERNEL_MULTIBOOT=y
CONFIG_KERNEL_MULTIBOOT_ZBI=y
CONFIG_KERNEL_ZIMAGE=y

# Drivers
CONFIG_DRIVER_BUS_I2C_CROS_EC_TUNNEL=y
CONFIG_DRIVER_BUS_I2C_DESIGNWARE=y
CONFIG_DRIVER_EC_ANX3429=y
CONFIG_DRIVER_EC_CROS=y
CONFIG_DRIVER_EC_CROS_LPC=y
CONFIG_DRIVER_EC_PS8751=y
CONFIG_DRIVER_FLASH_MEMMAPPED=y
CONFIG_DRIVER_SOC_CEZANNE=y
CONFIG_DRIVER_INPUT_PS2=y
CONFIG_DRIVER_POWER_FCH=y
CONFIG_DRIVER_SDHCI=y
CONFIG_DRIVER_STORAGE_MMC=y
CONFIG_DRIVER_STORAGE_NVME=y
CONFIG_DRIVER_STORAGE_SDHCI_PCI=y
CONFIG_DRIVER_STORAGE_BAYHUB=y
CONFIG_DRIVER_TPM_CR50_I2C=y

# Cezanne uses 32 MiB + ~2 MiB for coreboot so place the kernel at 64 MiB
CONFIG_KERNEL_START=0x4000000

# Timestamp
CONFIG_TIMESTAMP_RAW=n

# Audio beep
CONFIG_DRIVER_BUS_I2C_DESIGNWARE=y
CONFIG_DRIVER_SOUND_AMD_I2S_SUPPORT=y
CONFIG_DRIVER_SOUND_I2S=y
CONFIG_DRIVER_SOUND_ROUTE=y
CONFIG_DRIVER_SOUND_RT1019=y
CONFIG_DRIVER_SOUND_RT5682=y
CONFIG_DRIVER_SOUND_GPIO_AMP=y
CONFIG_DRIVER_SOUND_GPIO_I2S=y

# Storage
CONFIG_DRIVER_STORAGE_SDHCI_PCI=y
CONFIG_DRIVER_STORAGE_MMC=y
```

## board/elm/defconfig
```kconfig
# Arch
CONFIG_ARCH_ARM=y
CONFIG_ARCH_ARM_V8=y

# Board
CONFIG_BOARD="elm"
CONFIG_BOARD_DIR="oak"

# Image
CONFIG_BASE_ADDRESS=0x48000000
CONFIG_FMAP_OFFSET=0x00100000
CONFIG_HEAP_SIZE=0x00600000
CONFIG_KERNEL_START=0x45000000

# Vboot
CONFIG_VIRTUAL_DEV_SWITCH=y
CONFIG_EC_SOFTWARE_SYNC=y
CONFIG_CROSSYSTEM_FDT=y
CONFIG_NV_STORAGE_FLASH=y

# Kernel format
CONFIG_KERNEL_FIT=y
CONFIG_KERNEL_FIT_FDT_ADDR=0x5ff00000

# Drivers
CONFIG_DRIVER_BUS_I2C_MT8173=y
CONFIG_DRIVER_BUS_I2S_MT8173=y
CONFIG_DRIVER_BUS_SPI_MT8173=y
CONFIG_DRIVER_EC_CROS=y
CONFIG_DRIVER_EC_CROS_PASSTHRU=y
CONFIG_DRIVER_EC_CROS_SPI=y
CONFIG_DRIVER_GPIO_MT8173=y
CONFIG_DRIVER_INPUT_MKBP=y
CONFIG_DRIVER_INPUT_MKBP_KEYMATRIX_STANDARD=y
CONFIG_DRIVER_INPUT_USB=y
CONFIG_DRIVER_POWER_MT6397=y
CONFIG_DRIVER_SOUND_I2S=y
CONFIG_DRIVER_SOUND_RT5645=y
CONFIG_DRIVER_SOUND_RT5677=y
CONFIG_DRIVER_SOUND_ROUTE=y
CONFIG_DRIVER_STORAGE_MMC=y
CONFIG_DRIVER_STORAGE_MMC_MT8173=y
CONFIG_DRIVER_FLASH_NOR_MT8173=y
CONFIG_DRIVER_TPM_SLB9635_I2C=y

# VIDEO
CONFIG_DRIVER_VIDEO_MEDIATEK=y
```

## board/eve/defconfig
```kconfig
# Arch
CONFIG_ARCH_X86=y

# Board
CONFIG_BOARD_DIR="eve"

# Image
CONFIG_HEAP_SIZE=0x00600000

# Vboot
CONFIG_EC_VBOOT_SUPPORT=y
CONFIG_EC_SLOW_UPDATE=y
CONFIG_TPM2_MODE=y
CONFIG_CROSSYSTEM_ACPI=y
CONFIG_NVDATA_CMOS=y
CONFIG_TPM_DEBUG_EXTENSIONS=y

# Kernel format
CONFIG_KERNEL_MULTIBOOT=y
CONFIG_KERNEL_MULTIBOOT_BOOTDATA=y
CONFIG_KERNEL_ZIMAGE=y

# Drivers
CONFIG_DRIVER_BUS_I2C_DESIGNWARE=y
CONFIG_DRIVER_BUS_I2C_DESIGNWARE_PCI=y
CONFIG_DRIVER_EC_CROS=y
CONFIG_DRIVER_EC_CROS_LPC=y
CONFIG_DRIVER_FLASH_MEMMAPPED=y
CONFIG_DRIVER_INPUT_PS2=y
CONFIG_DRIVER_POWER_PCH=y
CONFIG_DRIVER_SDHCI=y
CONFIG_DRIVER_SOC_SKYLAKE=y
CONFIG_DRIVER_SOUND_GPIO_I2S=y
CONFIG_DRIVER_SOUND_MAX98927=y
CONFIG_DRIVER_SOUND_ROUTE=y
CONFIG_DRIVER_STORAGE_MMC=y
CONFIG_DRIVER_STORAGE_NVME=y
CONFIG_DRIVER_STORAGE_SDHCI_PCI=y
CONFIG_DRIVER_TPM_CR50_I2C=y
```

## board/fatcat/defconfig
```kconfig
# Arch
CONFIG_ARCH_X86=y
CONFIG_ARCH_X86_64=y

# Board
CONFIG_BOARD_DIR="fatcat"
CONFIG_VARIANT_NAME="fatcat"

# Image
CONFIG_HEAP_SIZE=0x04000000

# Vboot
CONFIG_CROSSYSTEM_ACPI=y
#TODO (b/368278795): Enable EC software sync
CONFIG_EC_SOFTWARE_SYNC=n
CONFIG_EC_VBOOT_SUPPORT=y
#TODO (b/368296342): Enable PD FW update
CONFIG_AUXFW_SOFTWARE_SYNC=n
CONFIG_BOOTCONFIG=y
CONFIG_ANDROID_BOOT_DEVICES_REMOVABLE="pci0000:00/0000:00:0d.0,pci0000:00/0000:00:14.0"
CONFIG_ANDROID_BOOT_DEVICES_DISK="pci0000:00/0000:00:1c.0,pci0000:00/0000:00:06.0"

# Kernel format
CONFIG_KERNEL_MULTIBOOT=y
CONFIG_KERNEL_MULTIBOOT_ZBI=y
CONFIG_KERNEL_ZIMAGE=y

# Drivers
CONFIG_DRIVER_AHCI=y
CONFIG_DRIVER_BUS_I2C_CROS_EC_TUNNEL=y
CONFIG_DRIVER_BUS_I2C_DESIGNWARE=y
CONFIG_DRIVER_BUS_I2C_DESIGNWARE_PCI=y
CONFIG_DRIVER_EC_CROS=y
CONFIG_DRIVER_EC_CROS_LPC=y
CONFIG_DRIVER_EC_PS8751=y
CONFIG_DRIVER_EC_PS8751_FLASH_WINDOW=y
CONFIG_DRIVER_FLASH_MEMMAPPED=y
CONFIG_DRIVER_GPIO_PANTHERLAKE=y
CONFIG_DRIVER_INPUT_MKBP=y
CONFIG_DRIVER_INPUT_MKBP_KEYMATRIX_STANDARD_V10=y
CONFIG_DRIVER_INPUT_PS2=y
CONFIG_DRIVER_POWER_PCH=y
CONFIG_DRIVER_SOC_PANTHERLAKE=y
CONFIG_DRIVER_STORAGE_NVME=y
CONFIG_DRIVER_STORAGE_COMMON=y
CONFIG_DRIVER_TPM_GOOGLE_TI50=y
CONFIG_DRIVER_TPM_I2C=y

# Storage
CONFIG_DRIVER_STORAGE_SDHCI_PCI=y
CONFIG_DRIVER_SDHCI=y
CONFIG_DRIVER_STORAGE_MMC=y

# Audio
CONFIG_DRIVER_BUS_I2S_INTEL_COMMON_I2S=y
CONFIG_DRIVER_BUS_I2S_INTEL_COMMON_MAX98357A=y
CONFIG_DRIVER_BUS_SOUNDWIRE=y
CONFIG_DRIVER_INTEL_GENERIC_AUDIO=y
CONFIG_DRIVER_SOUND_GPIO_AMP=y
CONFIG_DRIVER_SOUND_I2S=y
CONFIG_DRIVER_SOUND_MAX98363_SNDW=y
CONFIG_DRIVER_SOUND_ROUTE=y

# Aux FW
CONFIG_CROS_EC_PROBE_AUX_FW_INFO=y

# EC
CONFIG_CROS_EC_ENABLE_MEC=y

# USB Type-C
CONFIG_INTEL_TCSS_USE_PDC_PMC_MUX_CONFIG=y
```

## board/fizz/defconfig
```kconfig
# Arch
CONFIG_ARCH_X86=y

# Board
CONFIG_BOARD="fizz"

# Image
CONFIG_HEAP_SIZE=0x00600000

# Vboot
CONFIG_EC_SOFTWARE_SYNC=y
CONFIG_EC_SLOW_UPDATE=y
CONFIG_EC_EFS=y
CONFIG_CROSSYSTEM_ACPI=y
CONFIG_NV_STORAGE_CMOS=y
CONFIG_TPM2_MODE=y
CONFIG_TPM_DEBUG_EXTENSIONS=y

# Kernel format
CONFIG_KERNEL_ZIMAGE=y
CONFIG_KERNEL_MULTIBOOT=y
CONFIG_KERNEL_MULTIBOOT_BOOTDATA=y

# Drivers
CONFIG_DRIVER_AHCI=y
CONFIG_DRIVER_BUS_I2C_DESIGNWARE=y
CONFIG_DRIVER_BUS_I2C_DESIGNWARE_PCI=y
CONFIG_DRIVER_EC_CROS=y
CONFIG_DRIVER_EC_CROS_LPC=y
CONFIG_DRIVER_FLASH_MEMMAPPED=y
CONFIG_DRIVER_INPUT_MKBP=y
CONFIG_DRIVER_INPUT_MKBP_KEYMATRIX_STANDARD=y
CONFIG_DRIVER_INPUT_USB=y
CONFIG_DRIVER_BUS_SPI_INTEL_GSPI=y
CONFIG_DRIVER_POWER_PCH=y
CONFIG_DRIVER_SDHCI=y
CONFIG_DRIVER_SOC_SKYLAKE=y
CONFIG_DRIVER_SOUND_GPIO_EDGE_BUZZER=y
CONFIG_DRIVER_STORAGE_MMC=y
CONFIG_DRIVER_STORAGE_SDHCI_PCI=y
CONFIG_DRIVER_STORAGE_NVME=y
#CONFIG_DRIVER_TPM_CR50_I2C=y
CONFIG_DRIVER_TPM_SPI=y
CONFIG_DRIVER_TPM_CR50_SWITCHES=y
```

## board/fox_wtm2/defconfig
```kconfig
# Arch
CONFIG_ARCH_X86=y

# Board
CONFIG_BOARD="fox_wtm2"

# Image
CONFIG_FMAP_OFFSET=0x610000

# Vboot
# LPC TPM does not work on this board
CONFIG_MOCK_TPM=y

CONFIG_CROSSYSTEM_ACPI=y
CONFIG_NV_STORAGE_CMOS=y

# Kernel format
CONFIG_KERNEL_ZIMAGE=y

# Drivers
CONFIG_DRIVER_AHCI=y
CONFIG_DRIVER_FLASH_MEMMAPPED=y
CONFIG_DRIVER_GPIO_LYNXPOINT_LP=y
CONFIG_DRIVER_INPUT_PS2=y
CONFIG_DRIVER_INPUT_USB=y
CONFIG_DRIVER_NET_ASIX=y
CONFIG_DRIVER_NET_SMSC95XX=y
CONFIG_DRIVER_POWER_PCH=y
CONFIG_DRIVER_SOUND_HDA=y
CONFIG_DRIVER_TPM_LPC=y
```

## board/geralt/defconfig
```kconfig
# Arch
CONFIG_ARCH_ARM=y
CONFIG_ARCH_ARM_V8=y

# Board
CONFIG_BOARD_DIR="geralt"

# Image
CONFIG_BASE_ADDRESS=0xF1000000
CONFIG_KERNEL_START=0xD0000000

# Vboot
CONFIG_EC_VBOOT_SUPPORT=y
CONFIG_EC_SLOW_UPDATE=y
CONFIG_CROSSYSTEM_FDT=y
CONFIG_NVDATA_FLASH=y
CONFIG_WIDEVINE_PROVISION=y

# Kernel format
CONFIG_KERNEL_FIT=y
CONFIG_KERNEL_FIT_FDT_ADDR=0x54660000

# Drivers
CONFIG_DRIVER_BUS_I2C_CROS_EC_TUNNEL=y
CONFIG_DRIVER_BUS_I2C_MT8188=y
CONFIG_DRIVER_BUS_I2S_MT8188=y
CONFIG_DRIVER_BUS_SPI_MTK=y
CONFIG_DRIVER_EC_CROS=y
CONFIG_DRIVER_EC_CROS_SPI=y
CONFIG_DRIVER_FLASH_MTK_SNFC=y
CONFIG_DRIVER_GPIO_MT8188=y
CONFIG_DRIVER_INPUT_MKBP=y
CONFIG_DRIVER_INPUT_MKBP_KEYMATRIX_STANDARD_V10=y
CONFIG_DRIVER_SOUND_I2S=y
CONFIG_DRIVER_SOUND_MAX98390=y
CONFIG_DRIVER_SOUND_NAU8318_BEEP=y
CONFIG_DRIVER_SOUND_ROUTE=y
CONFIG_DRIVER_SOUND_TAS2563=y
CONFIG_DRIVER_STORAGE_MMC=y
CONFIG_DRIVER_STORAGE_MMC_MTK=y
CONFIG_DRIVER_TPM_GOOGLE_TI50=y
CONFIG_DRIVER_TPM_I2C=y
CONFIG_DRIVER_VIDEO_MTK=y
```

## board/gizmo/defconfig
```kconfig
# Arch
CONFIG_ARCH_X86=y

# Board
CONFIG_BOARD="gizmo"

# Image
CONFIG_FMAP_OFFSET=0x000c8000

# Vboot
CONFIG_OPROM_MATTERS=y
CONFIG_RO_NORMAL_SUPPORT=y
CONFIG_MOCK_TPM=y

CONFIG_CROSSYSTEM_ACPI=y
CONFIG_NV_STORAGE_CMOS=y

# Kernel format
CONFIG_KERNEL_ZIMAGE=y

# Drivers
CONFIG_DRIVER_AHCI=y
CONFIG_DRIVER_FLASH_MEMMAPPED=y
CONFIG_DRIVER_INPUT_PS2=y
CONFIG_DRIVER_INPUT_USB=y
CONFIG_DRIVER_NET_ASIX=y
CONFIG_DRIVER_TPM_LPC=y
```

## board/glados/defconfig
```kconfig
# Arch
CONFIG_ARCH_X86=y

# Board
CONFIG_BOARD_DIR="glados"

# Image
CONFIG_HEAP_SIZE=0x00600000

# Vboot
CONFIG_EC_SOFTWARE_SYNC=y
CONFIG_EC_SLOW_UPDATE=y
CONFIG_CROSSYSTEM_ACPI=y
CONFIG_NVDATA_CMOS=y

# Kernel format
CONFIG_KERNEL_ZIMAGE=y

# Drivers
CONFIG_DRIVER_BUS_I2C_DESIGNWARE=y
CONFIG_DRIVER_BUS_I2C_DESIGNWARE_PCI=y
CONFIG_DRIVER_EC_CROS=y
CONFIG_DRIVER_EC_CROS_LPC=y
CONFIG_DRIVER_FLASH_MEMMAPPED=y
CONFIG_DRIVER_INPUT_PS2=y
CONFIG_DRIVER_POWER_PCH=y
CONFIG_DRIVER_SDHCI=y
CONFIG_DRIVER_SOC_SKYLAKE=y
CONFIG_DRIVER_SOUND_GPIO_PDM=y
CONFIG_DRIVER_SOUND_ROUTE=y
CONFIG_DRIVER_SOUND_SSM4567=y
CONFIG_DRIVER_STORAGE_MMC=y
CONFIG_DRIVER_STORAGE_SDHCI_PCI=y
CONFIG_DRIVER_TPM_LPC=y
```
