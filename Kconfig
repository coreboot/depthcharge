## Kconfig
```kconfig
## This file is part of the coreboot project.
##
## Copyright (C) 2012 The ChromiumOS Authors.  All rights reserved.
##
## This program is free software; you can redistribute it and/or modify
## it under the terms of the GNU General Public License as published by
## the Free Software Foundation; version 2 of the License.
##
## This program is distributed in the hope that it will be useful,
## but WITHOUT ANY WARRANTY; without even the implied warranty of
## MERCHANTABILITY or FITNESS FOR A PARTICULAR PURPOSE.  See the
## GNU General Public License for more details.
##
## You should have received a copy of the GNU General Public License
## along with this program; if not, write to the Free Software
## Foundation, Inc., 51 Franklin St, Fifth Floor, Boston, MA 02110-1301 USA

choice
	prompt "Architecture"
	help
	  The architecture depthcharge will run on.

config ARCH_X86
	default n
	bool "X86"

config ARCH_ARM
	default n
	bool "ARM (currently unimplemented)"
	help
	  Support for ARM is not currently implemented.

endchoice

config ARCH
	default ""
	string

config FMAP_ADDRESS
	hex "Physical address the FMAP is mapped to on the target system"
	help
	  This is the physical address the FMAP in the ROM is mapped to as the
	  system boots. The FMAP is not searched for, so if the address isn't
	  correct the system won't boot.

config EC_SOFTWARE_SYNC
	bool "Enable EC software sync"
	help
	  EC software sync is a mechanism where the AP helps the EC verify its
	  firmware similar to how vboot verifies the main system firmware. This
	  option selects whether depthcharge should support EC software sync.

config VIRTUAL_DEV_SWITCH
	bool "Virtual developer switch support"
	help
	  Whether this platform has a virtual developer switch.

config KERNEL_START
	hex "Physical address of the region the kernel is loaded into"
	default 0x100000
	help
	  The start of a region of memory the kernel is loaded into before
	  it's verified or booted. Also, the code which pivots from the
	  read only firmware to one of the read/write versions is loaded here
	  when depthcharge starts.

config KERNEL_SIZE
	hex "The size of the region the kernel is loaded into"
	default 0x800000
	help
	  The size of a region of memroy the kernel is loaded into before
	  it's verified or booted. Also, the code which pivots from the
	  read only firmware to one of the read/write versions is loaded here
	  when depthcharge starts. That code is overwritten when the kernel is
	  loaded, so this should be set to the size of the larger of the two,
	  not their sizes added together.

config BASE_ADDRESS
	hex "The address depthcharge is linked to run at"
	default 0x2000000
	help
	  The address that the main part of depthcharge runs at. That includes
	  everything except the code which pivots between the read only and
	  read/write firmware which is linked to run from the region of memory
	  the kernel is eventually loaded into.

config HEAP_SIZE
	hex "The size of the heap in bytes"
	default 0x200000
	help
	  The size of the heap in bytes, minus any padding needed to align it
	  to a 16 byte boundary.

config STACK_SIZE
	hex "The size of the stack in bytes"
	default 0x4000
	help
	  The size of the stack in bytes, minus any padding needed to align it
	  to a 16 byte boundary.
```

## board/adlrvp/defconfig
```kconfig
# Arch
CONFIG_ARCH_X86=y

CONFIG_BOARD_DIR="adlrvp"
CONFIG_BOARD_ADLRVP_M=y

# Vboot
CONFIG_EC_VBOOT_SUPPORT=n
CONFIG_AUXFW_SOFTWARE_SYNC=n
CONFIG_MOCK_TPM=y

CONFIG_CROSSYSTEM_ACPI=y
CONFIG_NVDATA_CMOS=y

CONFIG_BOOTCONFIG=y
CONFIG_ANDROID_BOOT_DEVICES_REMOVABLE="pci0000:00/0000:00:0d.0,pci0000:00/0000:00:14.0"
CONFIG_ANDROID_BOOT_DEVICES_DISK="pci0000:00/0000:00:06.0,pci0000:00/0000:00:1d.0"

# Kernel format
CONFIG_KERNEL_MULTIBOOT=y
CONFIG_KERNEL_MULTIBOOT_ZBI=y
CONFIG_KERNEL_ZIMAGE=y

# Drivers
CONFIG_DRIVER_SOC_ALDERLAKE=y
CONFIG_DRIVER_BUS_I2C_CROS_EC_TUNNEL=y
CONFIG_DRIVER_BUS_I2C_DESIGNWARE=y
CONFIG_DRIVER_BUS_I2C_DESIGNWARE_PCI=y
CONFIG_DRIVER_BUS_SPI_INTEL_GSPI_VERSION_2=y
CONFIG_DRIVER_EC_CROS=y
CONFIG_DRIVER_EC_CROS_LPC=y
CONFIG_DRIVER_FLASH_MEMMAPPED=y
CONFIG_DRIVER_GPIO_ALDERLAKE=y
CONFIG_DRIVER_INPUT_PS2=y
CONFIG_DRIVER_POWER_PCH=y
CONFIG_DRIVER_STORAGE_NVME=y
CONFIG_DRIVER_AHCI=y
CONFIG_DRIVER_TPM_SPI=n


# Audio beep
CONFIG_ADLRVP_MAX98373_I2S_PORT=2
CONFIG_MAX98373_I2S_BOOTBEEP=y

# cros ec
CONFIG_DRIVER_EC_CROS=n
```

## board/adlrvp_m_ext_ec/defconfig
```kconfig
# Arch
CONFIG_ARCH_X86=y

CONFIG_BOARD_DIR="adlrvp"
# Vboot
CONFIG_EC_VBOOT_SUPPORT=y
CONFIG_AUXFW_SOFTWARE_SYNC=n
CONFIG_MOCK_TPM=y
CONFIG_VBOOT_X86_SHA256_ACCELERATION=y

CONFIG_CROSSYSTEM_ACPI=y
CONFIG_NVDATA_CMOS=y

# Kernel format
CONFIG_KERNEL_MULTIBOOT=y
CONFIG_KERNEL_MULTIBOOT_ZBI=y
CONFIG_KERNEL_ZIMAGE=y

# Drivers
CONFIG_DRIVER_SOC_ALDERLAKE=y
CONFIG_DRIVER_BUS_I2C_CROS_EC_TUNNEL=y
CONFIG_DRIVER_BUS_I2C_DESIGNWARE=y
CONFIG_DRIVER_BUS_I2C_DESIGNWARE_PCI=y
CONFIG_DRIVER_BUS_SPI_INTEL_GSPI_VERSION_2=y
CONFIG_DRIVER_EC_CROS=y
CONFIG_DRIVER_EC_CROS_LPC=y
CONFIG_DRIVER_FLASH_MEMMAPPED=y
CONFIG_DRIVER_GPIO_ALDERLAKE=y
CONFIG_DRIVER_INPUT_PS2=y
CONFIG_DRIVER_POWER_PCH=y
CONFIG_DRIVER_STORAGE_NVME=y
CONFIG_DRIVER_AHCI=y
CONFIG_DRIVER_TPM_SPI=n


# Audio beep
CONFIG_ADLRVP_MAX98373_I2S_PORT=2
CONFIG_MAX98373_I2S_BOOTBEEP=y
```

## board/asurada/defconfig
```kconfig
# Arch
CONFIG_ARCH_ARM=y
CONFIG_ARCH_ARM_V8=y

# Board
CONFIG_BOARD_DIR="asurada"

# Image
CONFIG_BASE_ADDRESS=0x80000000
CONFIG_KERNEL_START=0x60000000

# Vboot
CONFIG_EC_VBOOT_SUPPORT=y
CONFIG_EC_SLOW_UPDATE=y
CONFIG_CROSSYSTEM_FDT=y
CONFIG_NVDATA_FLASH=y

# Kernel format
CONFIG_KERNEL_FIT=y
CONFIG_KERNEL_FIT_FDT_ADDR=0x5f800000

# Drivers
CONFIG_DRIVER_BUS_I2C_CROS_EC_TUNNEL=y
CONFIG_DRIVER_BUS_I2S_MT8192=y
CONFIG_DRIVER_BUS_SPI_MTK=y
CONFIG_DRIVER_EC_CROS=y
CONFIG_DRIVER_EC_CROS_SPI=y
CONFIG_DRIVER_FLASH_MTK_SNFC=y
CONFIG_DRIVER_FLASH_SPI=y
CONFIG_DRIVER_GPIO_MT8192=y
CONFIG_DRIVER_INPUT_MKBP=y
CONFIG_DRIVER_INPUT_MKBP_KEYMATRIX_STANDARD=y
CONFIG_DRIVER_SOUND_I2S=y
CONFIG_DRIVER_SOUND_ROUTE=y
CONFIG_DRIVER_SOUND_RT1015P=y
CONFIG_DRIVER_STORAGE_MMC=y
CONFIG_DRIVER_STORAGE_MMC_MTK=y
CONFIG_DRIVER_TPM_GOOGLE_CR50=y
CONFIG_DRIVER_TPM_SPI=y
CONFIG_DRIVER_VIDEO_MTK=y
```

## board/atlas/defconfig
```kconfig
# Arch
CONFIG_ARCH_X86=y

# Board
CONFIG_BOARD="atlas"

# Image
CONFIG_HEAP_SIZE=0x00600000

# Vboot
CONFIG_CROSSYSTEM_ACPI=y
CONFIG_EC_SOFTWARE_SYNC=y
CONFIG_EC_SLOW_UPDATE=y
CONFIG_NV_STORAGE_CMOS=y
CONFIG_TPM_DEBUG_EXTENSIONS=y
CONFIG_TPM2_MODE=y

# Kernel format
CONFIG_KERNEL_MULTIBOOT=y
CONFIG_KERNEL_MULTIBOOT_BOOTDATA=y
CONFIG_KERNEL_ZIMAGE=y

# Drivers
CONFIG_DRIVER_BUS_I2C_CROS_EC_TUNNEL=y
CONFIG_DRIVER_BUS_I2C_DESIGNWARE=y
CONFIG_DRIVER_BUS_I2C_DESIGNWARE_PCI=y
CONFIG_DRIVER_BUS_SPI_INTEL_GSPI=y
CONFIG_DRIVER_EC_CROS=y
CONFIG_DRIVER_EC_CROS_LPC=y
CONFIG_DRIVER_EC_PS8751=y
CONFIG_DRIVER_FLASH_MEMMAPPED=y
CONFIG_DRIVER_INPUT_PS2=y
CONFIG_DRIVER_INPUT_USB=y
CONFIG_DRIVER_POWER_PCH=y
CONFIG_DRIVER_SDHCI=y
CONFIG_DRIVER_SOC_SKYLAKE=y
CONFIG_DRIVER_SOUND_MAX98373=y
CONFIG_DRIVER_STORAGE_MMC=y
CONFIG_DRIVER_STORAGE_NVME=y
CONFIG_DRIVER_STORAGE_SDHCI_PCI=y
CONFIG_DRIVER_TPM_SPI=y
```

## board/bayleybay/defconfig
```kconfig
# Arch
CONFIG_ARCH_X86=y

# Board
CONFIG_BOARD="bayleybay"

# Image
CONFIG_FMAP_OFFSET=0x610000

# Vboot
CONFIG_OPROM_MATTERS=y
CONFIG_RO_NORMAL_SUPPORT=y
CONFIG_VIRTUAL_DEV_SWITCH=y
# TODO(shawnn): Remove mock TPM once we bring up the real TPM
CONFIG_MOCK_TPM=y

CONFIG_CROSSYSTEM_ACPI=y
CONFIG_NV_STORAGE_CMOS=y

# Kernel format
CONFIG_KERNEL_ZIMAGE=y

# Drivers
CONFIG_DRIVER_AHCI=y
CONFIG_DRIVER_FLASH_MEMMAPPED=y
CONFIG_DRIVER_INPUT_PS2=y
CONFIG_DRIVER_INPUT_USB=y
CONFIG_DRIVER_NET_ASIX=y
CONFIG_DRIVER_POWER_PCH=y
CONFIG_DRIVER_SDHCI=y
CONFIG_DRIVER_SOUND_HDA=y
CONFIG_DRIVER_STORAGE_MMC=y
CONFIG_DRIVER_STORAGE_SDHCI_PCI=y
CONFIG_DRIVER_TPM_LPC=y
```

## board/cheza/defconfig
```kconfig
# Arch
CONFIG_ARCH_ARM=y
CONFIG_ARCH_ARM_V8=y

# Board
CONFIG_BOARD_DIR="cheza"

# Image
CONFIG_BASE_ADDRESS=0xF1000000
CONFIG_HEAP_SIZE=0x01000000
CONFIG_KERNEL_START=0xD0000000

# Vboot
#CONFIG_TPM2_MODE is not set
#CONFIG_MOCK_TPM is not set
CONFIG_CROSSYSTEM_FDT=y
CONFIG_NV_STORAGE_FLASH=y

# Kernel format
CONFIG_KERNEL_FIT=y
CONFIG_KERNEL_FIT_FDT_ADDR=0xF0000000

# Drivers
#CONFIG_DRIVER_TPM_SPI is not set
CONFIG_DRIVER_FLASH_SPI=y
CONFIG_DRIVER_INPUT_MKBP=y
CONFIG_DRIVER_INPUT_MKBP_KEYMATRIX_STANDARD=y

# VIDEO
```

## board/cmlrvp/defconfig
```kconfig
# Arch
CONFIG_ARCH_X86=y

# Board
CONFIG_BOARD="cmlrvp"
CONFIG_BOARD_DIR="cnlrvp"

# Image
CONFIG_HEAP_SIZE=0x00600000

# Vboot
CONFIG_CROSSYSTEM_ACPI=y
CONFIG_NV_STORAGE_CMOS=y
CONFIG_MOCK_TPM=y

# Kernel format
CONFIG_KERNEL_MULTIBOOT=y
CONFIG_KERNEL_MULTIBOOT_BOOTDATA=y
CONFIG_KERNEL_ZIMAGE=y

# Drivers
CONFIG_DRIVER_AHCI=y
CONFIG_DRIVER_FLASH_MEMMAPPED=y
CONFIG_DRIVER_INPUT_PS2=y
CONFIG_DRIVER_INPUT_USB=y
CONFIG_DRIVER_POWER_PCH=y
CONFIG_DRIVER_SOC_CANNONLAKE=y
CONFIG_DRIVER_SDHCI=y
CONFIG_DRIVER_STORAGE_MMC=y
CONFIG_DRIVER_STORAGE_NVME=y
CONFIG_DRIVER_STORAGE_SDHCI_PCI=y
```

## board/cnlrvp/defconfig
```kconfig
# Arch
CONFIG_ARCH_X86=y

# Board
CONFIG_BOARD_DIR="cnlrvp"

# Image

# Vboot
CONFIG_EC_SOFTWARE_SYNC=n

CONFIG_CROSSYSTEM_ACPI=y
CONFIG_NV_STORAGE_CMOS=y

# Kernel format
CONFIG_KERNEL_ZIMAGE=y

# Drivers
CONFIG_DRIVER_BUS_I2C_CROS_EC_TUNNEL=y
CONFIG_DRIVER_BUS_I2C_DESIGNWARE=y
CONFIG_DRIVER_BUS_I2C_DESIGNWARE_PCI=y
CONFIG_DRIVER_EC_CROS=n
CONFIG_DRIVER_EC_CROS_LPC=n
CONFIG_DRIVER_FLASH_MEMMAPPED=y
CONFIG_DRIVER_INPUT_PS2=y
CONFIG_DRIVER_POWER_PCH=y
CONFIG_DRIVER_SDHCI=y
CONFIG_DRIVER_SOUND_GPIO_I2S=y
CONFIG_DRIVER_SOUND_GPIO_PDM=y
CONFIG_DRIVER_SOUND_MAX98357A=y
CONFIG_DRIVER_SOUND_ROUTE=y
CONFIG_DRIVER_SOUND_SSM4567=y
CONFIG_DRIVER_STORAGE_MMC=y
CONFIG_DRIVER_STORAGE_SDHCI_PCI=y
CONFIG_DRIVER_AHCI=y
CONFIG_DRIVER_STORAGE_NVME=y
CONFIG_MOCK_TPM=y
```

## board/corsola/defconfig
```kconfig
# Arch
CONFIG_ARCH_ARM=y
CONFIG_ARCH_ARM_V8=y

# Board
CONFIG_BOARD_DIR="corsola"

# Image
CONFIG_BASE_ADDRESS=0xF1000000
CONFIG_KERNEL_START=0xD0000000

# Vboot
CONFIG_EC_VBOOT_SUPPORT=y
CONFIG_EC_SLOW_UPDATE=y
CONFIG_CROSSYSTEM_FDT=y
CONFIG_NVDATA_FLASH=y
CONFIG_BOOTCONFIG=y
CONFIG_ANDROID_BOOT_DEVICES_REMOVABLE="soc/11280000.usb,soc/11200000.usb"
CONFIG_ANDROID_BOOT_DEVICES_DISK="soc/11230000.mmc,soc/11240000.mmc"

CONFIG_CROS_EC_PROBE_AUX_FW_INFO=y
CONFIG_AUXFW_SOFTWARE_SYNC=y

# Kernel format
CONFIG_KERNEL_FIT=y
CONFIG_KERNEL_FIT_FDT_ADDR=0xF0000000

# Drivers
CONFIG_DRIVER_BUS_I2C_CROS_EC_TUNNEL=y
CONFIG_DRIVER_BUS_I2C_MT8186=y
CONFIG_DRIVER_BUS_I2S_MT8186=y
CONFIG_DRIVER_BUS_SPI_MTK=y
CONFIG_DRIVER_EC_ANX3447=y
CONFIG_DRIVER_EC_CROS=y
CONFIG_DRIVER_EC_CROS_SPI=y
CONFIG_DRIVER_FLASH_MTK_SNFC=y
CONFIG_DRIVER_GPIO_MT8186=y
CONFIG_DRIVER_INPUT_MKBP=y
CONFIG_DRIVER_INPUT_MKBP_KEYMATRIX_STANDARD=y
CONFIG_DRIVER_SOUND_GPIO_AMP=y
CONFIG_DRIVER_SOUND_I2S=y
CONFIG_DRIVER_SOUND_ROUTE=y
CONFIG_DRIVER_SOUND_RT5645=y
CONFIG_DRIVER_STORAGE_MMC=y
CONFIG_DRIVER_STORAGE_MMC_MTK=y
CONFIG_DRIVER_TPM_GOOGLE_TI50=y
CONFIG_DRIVER_TPM_SPI=y
CONFIG_DRIVER_VIDEO_MTK=y
```

## board/cosmos/defconfig
```kconfig
# Arch
CONFIG_ARCH_ARM=y

# Board
CONFIG_BOARD="cosmos"

# Image
CONFIG_BASE_ADDRESS=0x43000000
CONFIG_FMAP_OFFSET=0x00080000
CONFIG_HEAP_SIZE=0x01000000
CONFIG_KERNEL_START=0x2000000

# Vboot
CONFIG_RO_NORMAL_SUPPORT=y
CONFIG_VIRTUAL_DEV_SWITCH=y

CONFIG_CROSSYSTEM_FDT=y

# Kernel format
CONFIG_KERNEL_FIT=y
CONFIG_KERNEL_FIT_FDT_ADDR=0x6400000

# Drivers
CONFIG_DRIVER_FLASH_SPI=y
CONFIG_DRIVER_INPUT_USB=y
CONFIG_DRIVER_TPM_SLB9635_I2C=y

CONFIG_HEADLESS=y
CONFIG_NV_STORAGE_FLASH=y
```

## board/cyan/defconfig
```kconfig
# Arch
CONFIG_ARCH_X86=y

# Board
CONFIG_BOARD="cyan"

# Image
CONFIG_FMAP_OFFSET=0x610000

# Vboot
CONFIG_VIRTUAL_DEV_SWITCH=y

CONFIG_CROSSYSTEM_ACPI=y
CONFIG_NV_STORAGE_CMOS=y

# Kernel format
CONFIG_KERNEL_ZIMAGE=y

# Drivers
CONFIG_DRIVER_EC_CROS=y
CONFIG_DRIVER_EC_CROS_LPC=y
CONFIG_DRIVER_FLASH_MEMMAPPED=y
CONFIG_DRIVER_INPUT_PS2=y
CONFIG_DRIVER_INPUT_USB=y
CONFIG_DRIVER_POWER_PCH=y
CONFIG_DRIVER_SDHCI=y
CONFIG_DRIVER_STORAGE_SDHCI_PCI=y
CONFIG_DRIVER_STORAGE_MMC=y
CONFIG_DRIVER_TPM_LPC=y
CONFIG_DRIVER_BUS_I2S_BRASWELL=y
CONFIG_DRIVER_BUS_I2S_BRASWELL_MAX98090=y
CONFIG_DRIVER_SOUND_MAX98090=y
CONFIG_DRIVER_BUS_I2C_DESIGNWARE=y
CONFIG_DRIVER_SOUND_I2S=y
CONFIG_DRIVER_SOUND_ROUTE=y
```

## board/cyclone/defconfig
```kconfig
# Arch
CONFIG_ARCH_ARM=y

# Board
CONFIG_BOARD="cyclone"
CONFIG_SYS_PROMPT="cyclone_debug: "

# Image
CONFIG_BASE_ADDRESS=0x10000000
CONFIG_FMAP_OFFSET=0x00300000
CONFIG_HEAP_SIZE=0x01000000
CONFIG_KERNEL_START=0x2000000

# vboot
CONFIG_VIRTUAL_DEV_SWITCH=y
CONFIG_USB_BOOT_ON_DEV=y
CONFIG_CROSSYSTEM_FDT=y

# Kernel format
CONFIG_KERNEL_FIT=y
CONFIG_KERNEL_FIT_FDT_ADDR=0x6400000
CONFIG_ATAG_BASE=0x6f00000

# Drivers
CONFIG_DRIVER_BUS_I2C_ARMADA38X=y
CONFIG_DRIVER_BUS_SPI_ARMADA38X_SPI=y
CONFIG_DRIVER_FLASH_SPI=y
CONFIG_DRIVER_INPUT_USB=y
CONFIG_DRIVER_TPM_SLB9635_I2C=y

CONFIG_HEADLESS=y
CONFIG_NV_STORAGE_FLASH=y
```

## board/daisy/defconfig
```kconfig
# Arch
CONFIG_ARCH_ARM=y

# Board
CONFIG_BOARD="daisy"

# Image
CONFIG_BASE_ADDRESS=0x43000000
CONFIG_FMAP_OFFSET=0x00100000
CONFIG_HEAP_SIZE=0x00600000
CONFIG_KERNEL_START=0x42000000

# Vboot
CONFIG_EC_SOFTWARE_SYNC=y
CONFIG_RO_NORMAL_SUPPORT=y
CONFIG_VIRTUAL_DEV_SWITCH=y

CONFIG_CROSSYSTEM_FDT=y
CONFIG_NV_STORAGE_CROS_EC=y

# Kernel format
CONFIG_KERNEL_FIT=y
CONFIG_KERNEL_FIT_COMPAT="google,snow"
CONFIG_KERNEL_FIT_FDT_ADDR=0x5ff00000

# Drivers
CONFIG_DRIVER_BUS_I2C_S3C24X0=y
CONFIG_DRIVER_BUS_I2S_EXYNOS5=y
CONFIG_DRIVER_BUS_SPI_EXYNOS5=y
CONFIG_DRIVER_EC_CROS=y
CONFIG_DRIVER_EC_CROS_I2C=y
CONFIG_DRIVER_FLASH_SPI=y
CONFIG_DRIVER_GPIO_EXYNOS5250=y
CONFIG_DRIVER_INPUT_MKBP=y
CONFIG_DRIVER_INPUT_MKBP_KEYMATRIX_STANDARD=y
CONFIG_DRIVER_INPUT_USB=y
CONFIG_DRIVER_NET_ASIX=y
CONFIG_DRIVER_POWER_EXYNOS=y
CONFIG_DRIVER_SOUND_I2S=y
CONFIG_DRIVER_SOUND_MAX98095=y
CONFIG_DRIVER_SOUND_ROUTE=y
CONFIG_DRIVER_STORAGE_MMC=y
CONFIG_DRIVER_STORAGE_MSHC_S5P=y
CONFIG_DRIVER_TPM_SLB9635_I2C=y
CONFIG_DRIVER_VIDEO_EXYNOS5=y
CONFIG_DRIVER_VIDEO_EXYNOS5_BASE=0x14400000
```

## board/dedede/defconfig
```kconfig
# Arch
CONFIG_ARCH_X86=y

# Board
CONFIG_BOARD_DIR="dedede"

# Drivers
CONFIG_DRIVER_BUS_SPI_INTEL_GSPI_VERSION_2=y
CONFIG_DRIVER_EC_CROS=y
CONFIG_DRIVER_EC_CROS_LPC=y
CONFIG_DRIVER_FLASH_MEMMAPPED=y
CONFIG_DRIVER_INPUT_PS2=y
CONFIG_DRIVER_POWER_PCH=y
CONFIG_DRIVER_SOC_JASPERLAKE=y
CONFIG_DRIVER_SDHCI=y
CONFIG_DRIVER_STORAGE_MMC=y
CONFIG_DRIVER_STORAGE_SDHCI_PCI=y
CONFIG_DRIVER_TPM_SPI=y

# Kernel
CONFIG_KERNEL_MULTIBOOT=y
CONFIG_KERNEL_MULTIBOOT_BOOTDATA=y
CONFIG_KERNEL_ZIMAGE=y

# Vboot
CONFIG_CROSSYSTEM_ACPI=y
CONFIG_NVDATA_CMOS=y
CONFIG_TPM2_MODE=y
CONFIG_TPM_DEBUG_EXTENSIONS=y
```

## board/delbin/defconfig
```kconfig
# Arch
CONFIG_ARCH_X86=y

# Board
CONFIG_BOARD_DIR="volteer"

# Image
CONFIG_HEAP_SIZE=0x02600000

# Vboot
CONFIG_TPM2_MODE=y
CONFIG_CROSSYSTEM_ACPI=y
CONFIG_TPM_DEBUG_EXTENSIONS=y
CONFIG_EC_SOFTWARE_SYNC=y
CONFIG_AUXFW_SOFTWARE_SYNC=y

# Kernel format
CONFIG_KERNEL_MULTIBOOT=y
CONFIG_KERNEL_MULTIBOOT_BOOTDATA=y
CONFIG_KERNEL_ZIMAGE=y

# Drivers
CONFIG_DRIVER_BUS_I2C_CROS_EC_TUNNEL=y
CONFIG_DRIVER_AHCI=y
CONFIG_DRIVER_BUS_I2C_DESIGNWARE=y
CONFIG_DRIVER_BUS_I2C_DESIGNWARE_PCI=y
CONFIG_DRIVER_BUS_SPI_INTEL_GSPI_VERSION_2=y
CONFIG_DRIVER_EC_CROS=y
CONFIG_DRIVER_EC_CROS_LPC=y
CONFIG_DRIVER_EC_PS8751=y
CONFIG_DRIVER_FLASH_MEMMAPPED=y
CONFIG_DRIVER_GPIO_TIGERLAKE=y
CONFIG_DRIVER_INPUT_PS2=y
CONFIG_DRIVER_POWER_PCH=y
CONFIG_DRIVER_SOC_TIGERLAKE=y
CONFIG_DRIVER_TPM_SPI=y
CONFIG_DRIVER_STORAGE_NVME=y

CONFIG_DRIVER_USB_TIGERLAKE_TCSS=y
CONFIG_DRIVER_USB_TIGERLAKE_TCSS_DEBUG=y
CONFIG_DRIVER_SOC_TIGERLAKE_PMC=y
CONFIG_DRIVER_SOC_TIGERLAKE_PMC_DEBUG=y

# Audio
CONFIG_VOLTEER_MAX98373_I2S_PORT=1
CONFIG_MAX98373_I2S_BOOTBEEP=y

# Auxfw
CONFIG_CROS_EC_PROBE_AUX_FW_INFO=y
```
